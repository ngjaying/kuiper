VERSION "ConnectivityCANFD"

NS_ :

BS_ :

BU_ :  ETC IHU TCAM

BO_ 960 DhuConnCANFDFr01 : 64 IHU
 SG_ AccrPedlRat_UB : 7|1@0+ (1,0) [0|1] "" TCAM
 SG_ AccrPedlRatAccrPedlRat : 6|15@0+ (0.00390625,0.0) [0.0|100.0] "%" TCAM
 SG_ AccrPedlRatChks : 23|8@0+ (1.0,0.0) [0.0|255.0] "Unitless" TCAM
 SG_ AccrPedlRatCntr : 31|4@0+ (1.0,0.0) [0.0|15.0] "Unitless" TCAM
 SG_ AmbTIndcdWithUnit_UB : 55|1@0+ (1,0) [0|1] "" TCAM
 SG_ AmbTIndcdWithUnitAmbTIndcd : 35|12@0+ (0.1,-100.0) [-100.0|309.5] "Unitless" TCAM
 SG_ AmbTIndcdWithUnitAmbTIndcdUnit : 39|2@0+ (1,0) [0|3] "" TCAM
 SG_ AmbTIndcdWithUnitQF : 37|2@0+ (1,0) [0|3] "" TCAM
 SG_ BkpOfDstTrvld : 52|21@0+ (1.0,0.0) [0.0|2000000.0] "km" TCAM
 SG_ BkpOfDstTrvld_UB : 53|1@0+ (1,0) [0|1] "" TCAM
 SG_ BkpOfDstTrvldHiResl : 79|25@0+ (0.1,0.0) [0.0|2000000.0] "km" TCAM
 SG_ BkpOfDstTrvldHiResl_UB : 54|1@0+ (1,0) [0|1] "" TCAM
 SG_ BrkFldLvl : 102|1@0+ (1,0) [0|1] "" TCAM
 SG_ BrkFldLvl_UB : 101|1@0+ (1,0) [0|1] "" TCAM
 SG_ BrkFricTqTotAtWhlsAct_UB : 127|1@0+ (1,0) [0|1] "" TCAM
 SG_ BrkFricTqTotAtWhlsActBrkFricTqTotAtWhlsAct : 126|15@0+ (1.0,0.0) [0.0|20000.0] "NewtonMeter" TCAM
 SG_ BrkFricTqTotAtWhlsActChks : 143|8@0+ (1.0,0.0) [0.0|255.0] "Unitless" TCAM
 SG_ BrkFricTqTotAtWhlsActCntr : 151|4@0+ (1.0,0.0) [0.0|15.0] "Unitless" TCAM
 SG_ BrkPedlPsd_UB : 100|1@0+ (1,0) [0|1] "" TCAM
 SG_ BrkPedlPsdBrkPedlNotPsdSafe : 159|1@0+ (1,0) [0|1] "" TCAM
 SG_ BrkPedlPsdBrkPedlPsd : 158|1@0+ (1,0) [0|1] "" TCAM
 SG_ BrkPedlPsdChks : 167|8@0+ (1.0,0.0) [0.0|255.0] "Unitless" TCAM
 SG_ BrkPedlPsdCntr : 155|4@0+ (1.0,0.0) [0.0|15.0] "Unitless" TCAM
 SG_ BrkPedlPsdQf : 157|2@0+ (1,0) [0|3] "" TCAM
 SG_ BrkPedlrRat_UB : 175|1@0+ (1,0) [0|1] "" TCAM
 SG_ BrkPedlrRatPerc : 174|15@0+ (0.00390625,0.0) [0.0|100.0] "%" TCAM
 SG_ BrkPedlrRatQf : 191|2@0+ (1,0) [0|3] "" TCAM
 SG_ BrkPedlTrvl_UB : 226|1@0+ (1,0) [0|1] "" TCAM
 SG_ BrkPedlTrvlAct : 207|13@0+ (0.01,-5.0) [-5.0|47.0] "mm" TCAM
 SG_ BrkPedlTrvlChks : 199|8@0+ (1.0,0.0) [0.0|255.0] "Unitless" TCAM
 SG_ BrkPedlTrvlCntr : 187|4@0+ (1.0,0.0) [0.0|15.0] "Unitless" TCAM
 SG_ BrkPedlTrvlQf : 189|2@0+ (1,0) [0|3] "" TCAM
 SG_ BrkPedlTrvlSt : 208|1@0+ (1,0) [0|1] "" TCAM
 SG_ BrkPedlTrvlStQf : 210|2@0+ (1,0) [0|3] "" TCAM
 SG_ BrkPedlTrvlTar : 223|13@0+ (0.01,-5.0) [-5.0|47.0] "mm" TCAM
 SG_ CnclFaceReqGid1_UB : 99|1@0+ (1,0) [0|1] "" TCAM
 SG_ CnclFaceReqGid1Byte0 : 263|8@0+ (1.0,0.0) [0.0|255.0] "Unitless" TCAM
 SG_ CnclFaceReqGid1Byte1 : 271|8@0+ (1.0,0.0) [0.0|255.0] "Unitless" TCAM
 SG_ CnclFaceReqGid1Byte2 : 279|8@0+ (1.0,0.0) [0.0|255.0] "Unitless" TCAM
 SG_ CnclFaceReqGid1Byte3 : 287|8@0+ (1.0,0.0) [0.0|255.0] "Unitless" TCAM
 SG_ CnclFaceReqGid1Byte4 : 295|8@0+ (1.0,0.0) [0.0|255.0] "Unitless" TCAM
 SG_ CnclFaceReqGid1Byte5 : 303|8@0+ (1.0,0.0) [0.0|255.0] "Unitless" TCAM
 SG_ CnclFaceReqGid1Byte6 : 311|8@0+ (1.0,0.0) [0.0|255.0] "Unitless" TCAM
 SG_ CnclFaceReqGid1Byte7 : 319|8@0+ (1.0,0.0) [0.0|255.0] "Unitless" TCAM
 SG_ CnclFaceReqGid2_UB : 98|1@0+ (1,0) [0|1] "" TCAM
 SG_ CnclFaceReqGid2Byte0 : 327|8@0+ (1.0,0.0) [0.0|255.0] "Unitless" TCAM
 SG_ CnclFaceReqGid2Byte1 : 335|8@0+ (1.0,0.0) [0.0|255.0] "Unitless" TCAM
 SG_ CnclFaceReqGid2Byte2 : 343|8@0+ (1.0,0.0) [0.0|255.0] "Unitless" TCAM
 SG_ CnclFaceReqGid2Byte3 : 351|8@0+ (1.0,0.0) [0.0|255.0] "Unitless" TCAM
 SG_ CnclFaceReqGid2Byte4 : 359|8@0+ (1.0,0.0) [0.0|255.0] "Unitless" TCAM
 SG_ CnclFaceReqGid2Byte5 : 367|8@0+ (1.0,0.0) [0.0|255.0] "Unitless" TCAM
 SG_ CnclFaceReqGid2Byte6 : 375|8@0+ (1.0,0.0) [0.0|255.0] "Unitless" TCAM
 SG_ CnclFaceReqGid2Byte7 : 383|8@0+ (1.0,0.0) [0.0|255.0] "Unitless" TCAM
 SG_ DayToSrv : 225|10@0+ (1.0,0.0) [0.0|750.0] "Days" TCAM
 SG_ DayToSrv_UB : 247|1@0+ (1,0) [0|1] "" TCAM
 SG_ DCChrgnHndlSts : 27|3@0+ (1,0) [0|7] "" TCAM
 SG_ DCChrgnHndlSts_UB : 24|1@0+ (1,0) [0|1] "" TCAM
 SG_ DcDcActvd : 96|1@0+ (1,0) [0|1] "" TCAM
 SG_ DcDcActvd_UB : 97|1@0+ (1,0) [0|1] "" TCAM
 SG_ DispBattEgyIn : 391|8@0+ (0.5,0.0) [0.0|127.5] "Wh" TCAM
 SG_ DispBattEgyIn_UB : 147|1@0+ (1,0) [0|1] "" TCAM
 SG_ DispBattEgyOut : 399|8@0+ (0.5,0.0) [0.0|127.5] "Wh" TCAM
 SG_ DispBattEgyOut_UB : 146|1@0+ (1,0) [0|1] "" TCAM
 SG_ DispHvBattLvlOfChrg : 407|10@0+ (0.1,0.0) [0.0|102.30000000000001] "%" TCAM
 SG_ DispHvBattLvlOfChrg_UB : 413|1@0+ (1,0) [0|1] "" TCAM
 SG_ DstEstimdToEmptyForDrvgElecIndcd_UB : 412|1@0+ (1,0) [0|1] "" TCAM
 SG_ DstEstimdToEmptyForDrvgElecIndcdDstToEmpty : 410|11@0+ (1.0,0.0) [0.0|2000.0] "Unitless" TCAM
 SG_ DstEstimdToEmptyForDrvgElecIndcdDstUnit : 411|1@0+ (1,0) [0|1] "" TCAM
 SG_ DstToEmptyIndcd_UB : 451|1@0+ (1,0) [0|1] "" TCAM
 SG_ DstToEmptyIndcdDstToEmpty : 447|11@0+ (1.0,0.0) [0.0|2000.0] "Unitless" TCAM
 SG_ DstToEmptyIndcdDstUnit : 452|1@0+ (1,0) [0|1] "" TCAM
 SG_ DstToSrv : 431|15@0+ (1.0,0.0) [0.0|32000.0] "km" TCAM
 SG_ DstToSrv_UB : 432|1@0+ (1,0) [0|1] "" TCAM
 SG_ DstTrvld1 : 448|25@0+ (0.1,0.0) [0.0|2000000.0] "km" TCAM
 SG_ DstTrvld1_UB : 449|1@0+ (1,0) [0|1] "" TCAM
 SG_ DstTrvld2 : 487|25@0+ (0.1,0.0) [0.0|2000000.0] "km" TCAM
 SG_ DstTrvld2_UB : 450|1@0+ (1,0) [0|1] "" TCAM
 SG_ FltElecDcDc : 507|1@0+ (1,0) [0|1] "" TCAM
 SG_ FltElecDcDc_UB : 506|1@0+ (1,0) [0|1] "" TCAM
 SG_ FltTDcDc : 505|1@0+ (1,0) [0|1] "" TCAM
 SG_ FltTDcDc_UB : 504|1@0+ (1,0) [0|1] "" TCAM
 SG_ MmedHdPwrMod : 509|2@0+ (1,0) [0|3] "" TCAM
 SG_ MmedHdPwrMod_UB : 510|1@0+ (1,0) [0|1] "" TCAM
 SG_ VehPropSts : 145|1@0+ (1,0) [0|1] "" TCAM
 SG_ VehPropSts_UB : 144|1@0+ (1,0) [0|1] "" TCAM

BO_ 384 DhuConnCANFDFr02 : 64 IHU
 SG_ AlrmSts_UB : 1|1@0+ (1,0) [0|1] "" TCAM
 SG_ AlrmStsAlrmFailr : 12|1@0+ (1,0) [0|1] "" TCAM
 SG_ AlrmStsAlrmSt : 14|2@0+ (1,0) [0|3] "" TCAM
 SG_ AlrmStsAlrmTrgSrc : 11|4@0+ (1,0) [0|15] "" TCAM
 SG_ AlrmStsSnsrInclnFailr : 15|1@0+ (1,0) [0|1] "" TCAM
 SG_ AlrmStsSnsrIntrScanrFailr : 0|1@0+ (1,0) [0|1] "" TCAM
 SG_ AmbTEstimd_UB : 20|1@0+ (1,0) [0|1] "" TCAM
 SG_ AmbTEstimdAmbTEstimd : 18|11@0+ (0.1,-70.0) [-70.0|134.70000000000002] "degC" TCAM
 SG_ AmbTEstimdQf : 19|1@0+ (1,0) [0|1] "" TCAM
 SG_ BattFltStsPrim_UB : 368|1@0+ (1,0) [0|1] "" TCAM
 SG_ BattFltStsPrimBattFltStsPrm : 399|4@0+ (1,0) [0|15] "" TCAM
 SG_ BattFltStsPrimChks : 407|8@0+ (1.0,0.0) [0.0|255.0] "Unitless" TCAM
 SG_ BattFltStsPrimCntr : 395|4@0+ (1.0,0.0) [0.0|15.0] "Unitless" TCAM
 SG_ BltLockStAtDrvr_UB : 21|1@0+ (1,0) [0|1] "" TCAM
 SG_ BltLockStAtDrvrBltLockSt1 : 23|1@0+ (1,0) [0|1] "" TCAM
 SG_ BltLockStAtDrvrBltLockSts : 22|1@0+ (1,0) [0|1] "" TCAM
 SG_ BltLockStAtPass_UB : 5|1@0+ (1,0) [0|1] "" TCAM
 SG_ BltLockStAtPassBltLockSt1 : 7|1@0+ (1,0) [0|1] "" TCAM
 SG_ BltLockStAtPassBltLockSts : 6|1@0+ (1,0) [0|1] "" TCAM
 SG_ CmptmtAirTEstimdExtd_UB : 42|1@0+ (1,0) [0|1] "" TCAM
 SG_ CmptmtAirTEstimdExtdComptmtT : 39|11@0+ (0.1,-60.0) [-60.0|125.0] "degC" TCAM
 SG_ CmptmtAirTEstimdExtdQlyFlg : 44|2@0+ (1,0) [0|3] "" TCAM
 SG_ DigKeyPasEntryDiSts : 41|1@0+ (1,0) [0|1] "" TCAM
 SG_ DigKeyPasEntryDiSts_UB : 40|1@0+ (1,0) [0|1] "" TCAM
 SG_ DlyClsActv : 296|1@0+ (1,0) [0|1] "" TCAM
 SG_ DlyClsActv_UB : 359|1@0+ (1,0) [0|1] "" TCAM
 SG_ FrntLeOfSnsrOfPrkgAssiSide : 55|3@0+ (1,0) [0|7] "" TCAM
 SG_ FrntLeOfSnsrOfPrkgAssiSide_UB : 52|1@0+ (1,0) [0|1] "" TCAM
 SG_ FrntRiOfSnsrOfPrkgAssiSide : 51|3@0+ (1,0) [0|7] "" TCAM
 SG_ FrntRiOfSnsrOfPrkgAssiSide_UB : 48|1@0+ (1,0) [0|1] "" TCAM
 SG_ HvSysRlySts_UB : 62|1@0+ (1,0) [0|1] "" TCAM
 SG_ HvSysRlyStsChks : 71|8@0+ (1.0,0.0) [0.0|255.0] "Unitless" TCAM
 SG_ HvSysRlyStsCntr : 59|4@0+ (1.0,0.0) [0.0|15.0] "Unitless" TCAM
 SG_ HvSysRlyStsHvSysRlySts : 61|2@0+ (1,0) [0|3] "" TCAM
 SG_ ImobRemMgrChk_UB : 74|1@0+ (1,0) [0|1] "" TCAM
 SG_ ImobRemMgrChkImobDataRemMgrChk0 : 87|8@0+ (1.0,0.0) [0.0|255.0] "Unitless" TCAM
 SG_ ImobRemMgrChkImobDataRemMgrChk1 : 95|8@0+ (1.0,0.0) [0.0|255.0] "Unitless" TCAM
 SG_ ImobRemMgrChkImobDataRemMgrChk2 : 103|8@0+ (1.0,0.0) [0.0|255.0] "Unitless" TCAM
 SG_ ImobRemMgrChkImobDataRemMgrChk3 : 111|8@0+ (1.0,0.0) [0.0|255.0] "Unitless" TCAM
 SG_ ImobRemMgrChkImobDataRemMgrChk4 : 119|8@0+ (1.0,0.0) [0.0|255.0] "Unitless" TCAM
 SG_ ImobRemMgrChkSts : 73|2@0+ (1,0) [0|3] "" TCAM
 SG_ ImobVehRemMgrSts1_UB : 122|1@0+ (1,0) [0|1] "" TCAM
 SG_ ImobVehRemMgrSts1ImobVehRemMgrSts : 121|2@0+ (1,0) [0|3] "" TCAM
 SG_ ImobVehRemMgrSts1SpdLimRemMgrSts : 135|8@0+ (1.0,0.0) [0.0|255.0] "Unitless" TCAM
 SG_ InsdLeOfSnsrPrkgAssiFrnt : 143|3@0+ (1,0) [0|7] "" TCAM
 SG_ InsdLeOfSnsrPrkgAssiFrnt_UB : 140|1@0+ (1,0) [0|1] "" TCAM
 SG_ InsdLeOfSnsrPrkgAssiRe : 139|3@0+ (1,0) [0|7] "" TCAM
 SG_ InsdLeOfSnsrPrkgAssiRe_UB : 136|1@0+ (1,0) [0|1] "" TCAM
 SG_ InsdRiOfSnsrPrkgAssiFrnt : 151|3@0+ (1,0) [0|7] "" TCAM
 SG_ InsdRiOfSnsrPrkgAssiFrnt_UB : 148|1@0+ (1,0) [0|1] "" TCAM
 SG_ InsdRiOfSnsrPrkgAssiRe : 147|3@0+ (1,0) [0|7] "" TCAM
 SG_ InsdRiOfSnsrPrkgAssiRe_UB : 144|1@0+ (1,0) [0|1] "" TCAM
 SG_ KeyScanActv : 370|1@0+ (1,0) [0|1] "" TCAM
 SG_ KeyScanActv_UB : 369|1@0+ (1,0) [0|1] "" TCAM
 SG_ MobDevRPAAuthentReq1_UB : 159|1@0+ (1,0) [0|1] "" TCAM
 SG_ MobDevRPAAuthentReq1AuthentSts : 158|3@0+ (1,0) [0|7] "" TCAM
 SG_ MobDevRPAAuthentReq1Chks : 167|8@0+ (1.0,0.0) [0.0|255.0] "Unitless" TCAM
 SG_ MobDevRPAAuthentReq1Cntr : 155|4@0+ (1.0,0.0) [0.0|15.0] "Unitless" TCAM
 SG_ MobDevRPAAuthentReq1RndX : 175|8@0+ (1.0,0.0) [0.0|255.0] "Unitless" TCAM
 SG_ MobDevRPAAuthentReq1RndY : 183|8@0+ (1.0,0.0) [0.0|255.0] "Unitless" TCAM
 SG_ MobDevRPABtnStsToAppGrp_UB : 185|1@0+ (1,0) [0|1] "" TCAM
 SG_ MobDevRPABtnStsToAppGrpPrkgInBtnSts : 191|2@0+ (1,0) [0|3] "" TCAM
 SG_ MobDevRPABtnStsToAppGrpPrkgOutBtnSts : 189|2@0+ (1,0) [0|3] "" TCAM
 SG_ MobDevRPABtnStsToAppGrpRemParkOutCrsSwtRsp : 187|2@0+ (1,0) [0|3] "" TCAM
 SG_ MobDevRPAReqResp : 3|2@0+ (1,0) [0|3] "" TCAM
 SG_ MobDevRPAReqResp_UB : 4|1@0+ (1,0) [0|1] "" TCAM
 SG_ ObstacleMinimumDistanceFrnt_UB : 358|1@0+ (1,0) [0|1] "" TCAM
 SG_ ObstacleMinimumDistanceFrntMinDst : 367|9@0+ (1.0,0.0) [0.0|511.0] "Unitless" TCAM
 SG_ ObstacleMinimumDistanceFrntMinDstPosn : 374|3@0+ (1,0) [0|7] "" TCAM
 SG_ ObstacleMinimumDistanceFrntStopDispReq : 371|1@0+ (1,0) [0|1] "" TCAM
 SG_ ObstacleMinimumDistanceRe_UB : 357|1@0+ (1,0) [0|1] "" TCAM
 SG_ ObstacleMinimumDistanceReMinDst : 383|9@0+ (1.0,0.0) [0.0|511.0] "Unitless" TCAM
 SG_ ObstacleMinimumDistanceReMinDstPosn : 390|3@0+ (1,0) [0|7] "" TCAM
 SG_ ObstacleMinimumDistanceReStopDispReq : 387|1@0+ (1,0) [0|1] "" TCAM
 SG_ OutdLeOfSnsrPrkgAssiFrnt : 199|3@0+ (1,0) [0|7] "" TCAM
 SG_ OutdLeOfSnsrPrkgAssiFrnt_UB : 196|1@0+ (1,0) [0|1] "" TCAM
 SG_ OutdLeOfSnsrPrkgAssiRe : 195|3@0+ (1,0) [0|7] "" TCAM
 SG_ OutdLeOfSnsrPrkgAssiRe_UB : 192|1@0+ (1,0) [0|1] "" TCAM
 SG_ OutdRiOfSnsrPrkgAssiFrnt : 207|3@0+ (1,0) [0|7] "" TCAM
 SG_ OutdRiOfSnsrPrkgAssiFrnt_UB : 204|1@0+ (1,0) [0|1] "" TCAM
 SG_ OutdRiOfSnsrPrkgAssiRe : 203|3@0+ (1,0) [0|7] "" TCAM
 SG_ OutdRiOfSnsrPrkgAssiRe_UB : 200|1@0+ (1,0) [0|1] "" TCAM
 SG_ PanicAlrmSts : 63|1@0+ (1,0) [0|1] "" TCAM
 SG_ PanicAlrmSts_UB : 75|1@0+ (1,0) [0|1] "" TCAM
 SG_ PrkgDispGroup_UB : 184|1@0+ (1,0) [0|1] "" TCAM
 SG_ PrkgDispGroupLeCornrCoornx : 215|12@0+ (1.0,0.0) [0.0|4095.0] "Unitless" TCAM
 SG_ PrkgDispGroupLeCornrCoorny : 219|12@0+ (1.0,0.0) [0.0|4095.0] "Unitless" TCAM
 SG_ PrkgDispGroupLeCornrLocn : 263|3@0+ (1,0) [0|7] "" TCAM
 SG_ PrkgDispGroupPrkgTyp : 260|3@0+ (1,0) [0|7] "" TCAM
 SG_ PrkgDispGroupRiCornrCoornx : 239|12@0+ (1.0,0.0) [0.0|4095.0] "Unitless" TCAM
 SG_ PrkgDispGroupRiCornrCoorny : 243|12@0+ (1.0,0.0) [0.0|4095.0] "Unitless" TCAM
 SG_ PrkgDispGroupStallNr : 257|2@0+ (1.0,0.0) [0.0|3.0] "Unitless" TCAM
 SG_ PrkgModIncln : 79|3@0+ (1,0) [0|7] "" TCAM
 SG_ PrkgModIncln_UB : 76|1@0+ (1,0) [0|1] "" TCAM
 SG_ PrkgOutModBtnStsToAPP_UB : 268|1@0+ (1,0) [0|1] "" TCAM
 SG_ PrkgOutModBtnStsToAPPPrkgOutModBtnSts1 : 267|2@0+ (1,0) [0|3] "" TCAM
 SG_ PrkgOutModBtnStsToAPPPrkgOutModBtnSts2 : 265|2@0+ (1,0) [0|3] "" TCAM
 SG_ PrkgOutModBtnStsToAPPPrkgOutModBtnSts3 : 279|2@0+ (1,0) [0|3] "" TCAM
 SG_ PrkgOutModBtnStsToAPPPrkgOutModBtnSts4 : 277|2@0+ (1,0) [0|3] "" TCAM
 SG_ PrkgOutModBtnStsToAPPPrkgOutModBtnSts5 : 275|2@0+ (1,0) [0|3] "" TCAM
 SG_ PrkgOutModBtnStsToAPPPrkgOutModBtnSts6 : 273|2@0+ (1,0) [0|3] "" TCAM
 SG_ PrkgProcDstDisp : 295|14@0+ (0.1,0.0) [0.0|1000.0] "m" TCAM
 SG_ PrkgProcDstDisp_UB : 297|1@0+ (1,0) [0|1] "" TCAM
 SG_ PrkgProgsDisp : 351|7@0+ (1.0,0.0) [0.0|127.0] "%" TCAM
 SG_ PrkgProgsDisp_UB : 344|1@0+ (1,0) [0|1] "" TCAM
 SG_ ReLeOfSnsrOfPrkgAssiSide : 287|3@0+ (1,0) [0|7] "" TCAM
 SG_ ReLeOfSnsrOfPrkgAssiSide_UB : 284|1@0+ (1,0) [0|1] "" TCAM
 SG_ ReRiOfSnsrOfPrkgAssiSide : 283|3@0+ (1,0) [0|7] "" TCAM
 SG_ ReRiOfSnsrOfPrkgAssiSide_UB : 280|1@0+ (1,0) [0|1] "" TCAM
 SG_ TrOpenerSts : 127|4@0+ (1,0) [0|15] "" TCAM
 SG_ TrOpenerSts_UB : 123|1@0+ (1,0) [0|1] "" TCAM
 SG_ UndoProcSts : 271|2@0+ (1,0) [0|3] "" TCAM
 SG_ UndoProcSts_UB : 269|1@0+ (1,0) [0|1] "" TCAM
 SG_ VehModMngtGlbSafe1_UB : 336|1@0+ (1,0) [0|1] "" TCAM
 SG_ VehModMngtGlbSafe1CarModSts1 : 343|3@0+ (1,0) [0|7] "" TCAM
 SG_ VehModMngtGlbSafe1CarModSubtypWdCarModSubtyp : 340|3@0+ (1.0,0.0) [0.0|7.0] "Unitless" TCAM
 SG_ VehModMngtGlbSafe1Chks : 311|8@0+ (1.0,0.0) [0.0|255.0] "Unitless" TCAM
 SG_ VehModMngtGlbSafe1Cntr : 319|4@0+ (1.0,0.0) [0.0|15.0] "Unitless" TCAM
 SG_ VehModMngtGlbSafe1EgyLvlElecMai : 315|4@0+ (1.0,0.0) [0.0|15.0] "Unitless" TCAM
 SG_ VehModMngtGlbSafe1EgyLvlElecSubtyp : 327|4@0+ (1.0,0.0) [0.0|15.0] "Unitless" TCAM
 SG_ VehModMngtGlbSafe1FltEgyCnsWdSts : 337|1@0+ (1,0) [0|1] "" TCAM
 SG_ VehModMngtGlbSafe1PwrLvlElecMai : 323|4@0+ (1.0,0.0) [0.0|15.0] "Unitless" TCAM
 SG_ VehModMngtGlbSafe1PwrLvlElecSubtyp : 335|4@0+ (1.0,0.0) [0.0|15.0] "Unitless" TCAM
 SG_ VehModMngtGlbSafe1UsgModSts : 331|4@0+ (1,0) [0|15] "" TCAM

BO_ 896 DhuConnCANFDFr03 : 64 IHU
 SG_ AntithftActvnNotif : 97|1@0+ (1,0) [0|1] "" TCAM
 SG_ AntithftActvnNotif_UB : 96|1@0+ (1,0) [0|1] "" TCAM
 SG_ CampMod : 7|1@0+ (1,0) [0|1] "" TCAM
 SG_ CampMod_UB : 6|1@0+ (1,0) [0|1] "" TCAM
 SG_ CampModSocLowRmn : 5|2@0+ (1.0,0.0) [0.0|3.0] "Unitless" TCAM
 SG_ CampModSocLowRmn_UB : 3|1@0+ (1,0) [0|1] "" TCAM
 SG_ CchForFuEco_UB : 27|1@0+ (1,0) [0|1] "" TCAM
 SG_ CchForFuEcoBarForFuEco : 15|10@0+ (0.1,0.0) [0.0|102.30000000000001] "%" TCAM
 SG_ CchForFuEcoGrdForFuEco : 21|10@0+ (0.1,0.0) [0.0|102.30000000000001] "Unitless" TCAM
 SG_ ChrgLidAcSts : 1|2@0+ (1,0) [0|3] "" TCAM
 SG_ ChrgLidAcSts_UB : 2|1@0+ (1,0) [0|1] "" TCAM
 SG_ ChrgLidDCorAcDcSts : 25|2@0+ (1,0) [0|3] "" TCAM
 SG_ ChrgLidDCorAcDcSts_UB : 26|1@0+ (1,0) [0|1] "" TCAM
 SG_ ChrgnByEngCmfdReqToDrvr : 39|1@0+ (1,0) [0|1] "" TCAM
 SG_ ChrgnByEngCmfdReqToDrvr_UB : 38|1@0+ (1,0) [0|1] "" TCAM
 SG_ ChrgnOrDisChrgnStsFb : 36|5@0+ (1,0) [0|31] "" TCAM
 SG_ ChrgnOrDisChrgnStsFb_UB : 37|1@0+ (1,0) [0|1] "" TCAM
 SG_ ChrgnSts : 75|3@0+ (1,0) [0|7] "" TCAM
 SG_ ChrgnSts_UB : 72|1@0+ (1,0) [0|1] "" TCAM
 SG_ CmptmtTFrnt_UB : 386|1@0+ (1,0) [0|1] "" TCAM
 SG_ CmptmtTFrntCmptmtTFrnt : 407|11@0+ (0.1,-60.0) [-60.0|125.0] "degC" TCAM
 SG_ CmptmtTFrntFanForCmptmtTRunng : 412|1@0+ (1,0) [0|1] "" TCAM
 SG_ CmptmtTFrntQf : 411|2@0+ (1,0) [0|3] "" TCAM
 SG_ DchaIAct : 47|11@0+ (0.1,0.0) [0.0|204.70000000000002] "A" TCAM
 SG_ DchaIAct_UB : 52|1@0+ (1,0) [0|1] "" TCAM
 SG_ DchaUAct : 50|11@0+ (0.25,0.0) [0.0|511.0] "Volt" TCAM
 SG_ DchaUAct_UB : 51|1@0+ (1,0) [0|1] "" TCAM
 SG_ DstEstimdToEmptyForDrvgElec : 71|10@0+ (1.0,0.0) [0.0|1023.0] "KiloMtr" TCAM
 SG_ DstEstimdToEmptyForDrvgElec_UB : 77|1@0+ (1,0) [0|1] "" TCAM
 SG_ EcoClimaSts : 101|1@0+ (1,0) [0|1] "" TCAM
 SG_ EcoClimaSts_UB : 100|1@0+ (1,0) [0|1] "" TCAM
 SG_ EngFuCns : 95|8@0+ (200.0,0.0) [0.0|51000.0] "MicroL" TCAM
 SG_ EngFuCns_UB : 103|1@0+ (1,0) [0|1] "" TCAM
 SG_ EngFuCnsFild : 111|8@0+ (200.0,0.0) [0.0|51000.0] "MicroL" TCAM
 SG_ EngFuCnsFild_UB : 102|1@0+ (1,0) [0|1] "" TCAM
 SG_ EngSpdDispd : 119|15@0+ (0.5,0.0) [0.0|16383.5] "rpm" TCAM
 SG_ EngSpdDispd_UB : 120|1@0+ (1,0) [0|1] "" TCAM
 SG_ EngSt1WdSts_UB : 99|1@0+ (1,0) [0|1] "" TCAM
 SG_ EngSt1WdStsChks : 135|8@0+ (1.0,0.0) [0.0|255.0] "Unitless" TCAM
 SG_ EngSt1WdStsCntr : 143|4@0+ (1.0,0.0) [0.0|15.0] "Unitless" TCAM
 SG_ EngSt1WdStsEngSt1WdSts : 139|4@0+ (1,0) [0|15] "" TCAM
 SG_ FileDelSts_UB : 144|1@0+ (1,0) [0|1] "" TCAM
 SG_ FileDelStsID : 151|5@0+ (1.0,0.0) [0.0|31.0] "Unitless" TCAM
 SG_ FileDelStsSts : 146|2@0+ (1,0) [0|3] "" TCAM
 SG_ FileDwnldSts_UB : 98|1@0+ (1,0) [0|1] "" TCAM
 SG_ FileDwnldStsID : 159|5@0+ (1.0,0.0) [0.0|31.0] "Unitless" TCAM
 SG_ FileDwnldStsSts : 154|3@0+ (1,0) [0|7] "" TCAM
 SG_ FltOfFrntTurnIndcrLe : 167|1@0+ (1,0) [0|1] "" TCAM
 SG_ FltOfFrntTurnIndcrLe_UB : 166|1@0+ (1,0) [0|1] "" TCAM
 SG_ FltOfFrntTurnIndcrRi : 165|1@0+ (1,0) [0|1] "" TCAM
 SG_ FltOfFrntTurnIndcrRi_UB : 164|1@0+ (1,0) [0|1] "" TCAM
 SG_ FltOfReTurnIndcrLe : 163|1@0+ (1,0) [0|1] "" TCAM
 SG_ FltOfReTurnIndcrLe_UB : 162|1@0+ (1,0) [0|1] "" TCAM
 SG_ FltOfReTurnIndcrRi : 161|1@0+ (1,0) [0|1] "" TCAM
 SG_ FltOfReTurnIndcrRi_UB : 160|1@0+ (1,0) [0|1] "" TCAM
 SG_ HmiStrangerModMenuSet_UB : 171|1@0+ (1,0) [0|1] "" TCAM
 SG_ HmiStrangerModMenuSetActvInActv : 170|1@0+ (1,0) [0|1] "" TCAM
 SG_ HmiStrangerModMenuSetPasswordSt : 169|1@0+ (1,0) [0|1] "" TCAM
 SG_ HmiStrangerModMenuSetPrivateLockSt : 168|1@0+ (1,0) [0|1] "" TCAM
 SG_ HmiStrangerModMenuSetSpdLim : 183|8@0+ (1.0,0.0) [0.0|255.0] "Unitless" TCAM
 SG_ HvBattChrgnPwrCns1 : 191|11@0+ (100.0,0.0) [0.0|204700.0] "W" TCAM
 SG_ HvBattChrgnPwrCns1_UB : 196|1@0+ (1,0) [0|1] "" TCAM
 SG_ HvBattDchaTiEstimd : 194|11@0+ (1.0,0.0) [0.0|2047.0] "Mins" TCAM
 SG_ HvBattDchaTiEstimd_UB : 195|1@0+ (1,0) [0|1] "" TCAM
 SG_ HvBattIDc1 : 215|15@0+ (0.1,-1638.0) [-1638.0|1638.7000000000003] "A" TCAM
 SG_ HvBattIDc1_UB : 216|1@0+ (1,0) [0|1] "" TCAM
 SG_ HvBattMismatchFlt : 175|1@0+ (1,0) [0|1] "" TCAM
 SG_ HvBattMismatchFlt_UB : 174|1@0+ (1,0) [0|1] "" TCAM
 SG_ HvBattPreHeatFaild : 173|1@0+ (1,0) [0|1] "" TCAM
 SG_ HvBattPreHeatFaild_UB : 172|1@0+ (1,0) [0|1] "" TCAM
 SG_ LVPwrSplyErrSts : 235|4@0+ (1,0) [0|15] "" TCAM
 SG_ LVPwrSplyErrSts_UB : 236|1@0+ (1,0) [0|1] "" TCAM
 SG_ MobileActvnSts_UB : 239|1@0+ (1,0) [0|1] "" TCAM
 SG_ MobileActvnStsID : 231|5@0+ (1.0,0.0) [0.0|31.0] "Unitless" TCAM
 SG_ MobileActvnStsSts : 226|3@0+ (1,0) [0|7] "" TCAM
 SG_ PercOfFuLvlIndcn : 247|8@0+ (1.0,0.0) [0.0|100.0] "%" TCAM
 SG_ PercOfFuLvlIndcn_UB : 238|1@0+ (1,0) [0|1] "" TCAM
 SG_ PetModWarn : 282|2@0+ (1,0) [0|3] "" TCAM
 SG_ PetModWarn_UB : 280|1@0+ (1,0) [0|1] "" TCAM
 SG_ PosnBrief_UB : 352|1@0+ (1,0) [0|1] "" Vector__XXX
 SG_ PosnBriefPosnLat : 295|30@0- (0.000000277778,0.0) [-90.000072|90.000072] "Deg" Vector__XXX
 SG_ PosnBriefPosnLgt : 327|31@0- (0.000000277778,0.0) [-180.000144|180.000144] "Deg" Vector__XXX
 SG_ PrkgCmftModTiCtrl : 255|8@0+ (1.0,0.0) [0.0|255.0] "Unitless" TCAM
 SG_ PrkgCmftModTiCtrl_UB : 237|1@0+ (1,0) [0|1] "" TCAM
 SG_ ScenarioMod : 359|4@0+ (1,0) [0|15] "" TCAM
 SG_ ScenarioMod_UB : 355|1@0+ (1,0) [0|1] "" TCAM
 SG_ SeatOccptAtRowSecDrSide2 : 367|2@0+ (1,0) [0|3] "" TCAM
 SG_ SeatOccptAtRowSecDrSide2_UB : 354|1@0+ (1,0) [0|1] "" TCAM
 SG_ SeatOccptAtRowSecDrSideSnsSts2 : 365|2@0+ (1,0) [0|3] "" TCAM
 SG_ SeatOccptAtRowSecDrSideSnsSts2_UB : 353|1@0+ (1,0) [0|1] "" TCAM
 SG_ SeatOccptAtRowSecMid2 : 363|2@0+ (1,0) [0|3] "" TCAM
 SG_ SeatOccptAtRowSecMid2_UB : 375|1@0+ (1,0) [0|1] "" TCAM
 SG_ SeatOccptAtRowSecMidSnsSts2 : 361|2@0+ (1,0) [0|3] "" TCAM
 SG_ SeatOccptAtRowSecMidSnsSts2_UB : 374|1@0+ (1,0) [0|1] "" TCAM
 SG_ SeatOccptAtRowSecPasSide2 : 383|2@0+ (1,0) [0|3] "" TCAM
 SG_ SeatOccptAtRowSecPasSide2_UB : 373|1@0+ (1,0) [0|1] "" TCAM
 SG_ SeatOccptAtRowSecPasSideSnsSts2 : 381|2@0+ (1,0) [0|3] "" TCAM
 SG_ SeatOccptAtRowSecPasSideSnsSts2_UB : 372|1@0+ (1,0) [0|1] "" TCAM
 SG_ SeatOccptAtRowThrdLe2 : 379|2@0+ (1,0) [0|3] "" TCAM
 SG_ SeatOccptAtRowThrdLe2_UB : 371|1@0+ (1,0) [0|1] "" TCAM
 SG_ SeatOccptAtRowThrdLeSnsSts2 : 377|2@0+ (1,0) [0|3] "" TCAM
 SG_ SeatOccptAtRowThrdLeSnsSts2_UB : 370|1@0+ (1,0) [0|1] "" TCAM
 SG_ SeatOccptAtRowThrdRi2 : 391|2@0+ (1,0) [0|3] "" TCAM
 SG_ SeatOccptAtRowThrdRi2_UB : 369|1@0+ (1,0) [0|1] "" TCAM
 SG_ SeatOccptAtRowThrdRiSnsSts2 : 389|2@0+ (1,0) [0|3] "" TCAM
 SG_ SeatOccptAtRowThrdRiSnsSts2_UB : 368|1@0+ (1,0) [0|1] "" TCAM
 SG_ StrangerModeStateResp : 285|2@0+ (1,0) [0|3] "" TCAM
 SG_ StrangerModeStateResp_UB : 283|1@0+ (1,0) [0|1] "" TCAM
 SG_ TotDstTrvld : 263|25@0+ (0.1,0.0) [0.0|2000000.0] "km" TCAM
 SG_ TotDstTrvld_UB : 286|1@0+ (1,0) [0|1] "" TCAM
 SG_ VSTDFailToOpenToTelm : 399|4@0+ (1.0,0.0) [0.0|15.0] "Unitless" TCAM
 SG_ VSTDFailToOpenToTelm_UB : 387|1@0+ (1,0) [0|1] "" TCAM
 SG_ VstdModeSts : 395|3@0+ (1,0) [0|7] "" TCAM
 SG_ VstdModeSts_UB : 392|1@0+ (1,0) [0|1] "" TCAM
 SG_ VSTDVideoUploadSts : 423|2@0+ (1,0) [0|3] "" TCAM
 SG_ VSTDVideoUploadSts_UB : 421|1@0+ (1,0) [0|1] "" TCAM

BO_ 720 DhuConnCANFDFr04 : 64 IHU
 SG_ BattSocRaw : 7|10@0+ (0.1,0.0) [0.0|100.0] "%" TCAM
 SG_ BattSocRaw_UB : 13|1@0+ (1,0) [0|1] "" TCAM
 SG_ BattURaw : 8|9@0+ (0.025,5.0) [5.0|17.775] "Volt" TCAM
 SG_ BattURaw_UB : 9|1@0+ (1,0) [0|1] "" TCAM
 SG_ BltLockStAtRowSecLe_UB : 28|1@0+ (1,0) [0|1] "" TCAM
 SG_ BltLockStAtRowSecLeBltLockEquid : 31|1@0+ (1,0) [0|1] "" TCAM
 SG_ BltLockStAtRowSecLeBltLockSt1 : 30|1@0+ (1,0) [0|1] "" TCAM
 SG_ BltLockStAtRowSecLeBltLockSts : 29|1@0+ (1,0) [0|1] "" TCAM
 SG_ BltLockStAtRowSecMid_UB : 24|1@0+ (1,0) [0|1] "" TCAM
 SG_ BltLockStAtRowSecMidBltLockEquid : 27|1@0+ (1,0) [0|1] "" TCAM
 SG_ BltLockStAtRowSecMidBltLockSt1 : 26|1@0+ (1,0) [0|1] "" TCAM
 SG_ BltLockStAtRowSecMidBltLockSts : 25|1@0+ (1,0) [0|1] "" TCAM
 SG_ BltLockStAtRowSecRi_UB : 36|1@0+ (1,0) [0|1] "" TCAM
 SG_ BltLockStAtRowSecRiBltLockEquid : 39|1@0+ (1,0) [0|1] "" TCAM
 SG_ BltLockStAtRowSecRiBltLockSt1 : 38|1@0+ (1,0) [0|1] "" TCAM
 SG_ BltLockStAtRowSecRiBltLockSts : 37|1@0+ (1,0) [0|1] "" TCAM
 SG_ BltLockStAtRowThrdLe_UB : 32|1@0+ (1,0) [0|1] "" TCAM
 SG_ BltLockStAtRowThrdLeBltLockEquid : 35|1@0+ (1,0) [0|1] "" TCAM
 SG_ BltLockStAtRowThrdLeBltLockSt1 : 34|1@0+ (1,0) [0|1] "" TCAM
 SG_ BltLockStAtRowThrdLeBltLockSts : 33|1@0+ (1,0) [0|1] "" TCAM
 SG_ BltLockStAtRowThrdRi_UB : 44|1@0+ (1,0) [0|1] "" TCAM
 SG_ BltLockStAtRowThrdRiBltLockEquid : 47|1@0+ (1,0) [0|1] "" TCAM
 SG_ BltLockStAtRowThrdRiBltLockSt1 : 46|1@0+ (1,0) [0|1] "" TCAM
 SG_ BltLockStAtRowThrdRiBltLockSts : 45|1@0+ (1,0) [0|1] "" TCAM
 SG_ BookChrgnStsFb : 11|2@0+ (1,0) [0|3] "" TCAM
 SG_ BookChrgnStsFb_UB : 12|1@0+ (1,0) [0|1] "" TCAM
 SG_ BookTrvlChrgnFb : 127|2@0+ (1,0) [0|3] "" TCAM
 SG_ BookTrvlChrgnFb_UB : 125|1@0+ (1,0) [0|1] "" TCAM
 SG_ BookTrvlChrgnSts : 43|1@0+ (1,0) [0|1] "" TCAM
 SG_ BookTrvlChrgnSts_UB : 42|1@0+ (1,0) [0|1] "" TCAM
 SG_ DchaEgyAct : 271|11@0+ (0.1,0.0) [0.0|204.70000000000002] "KwH_1" TCAM
 SG_ DchaEgyAct_UB : 276|1@0+ (1,0) [0|1] "" TCAM
 SG_ DchaPwrAct : 287|9@0+ (100.0,0.0) [0.0|51100.0] "W" TCAM
 SG_ DchaPwrAct_UB : 294|1@0+ (1,0) [0|1] "" TCAM
 SG_ DchaStopReasonIndcn : 275|3@0+ (1,0) [0|7] "" TCAM
 SG_ DchaStopReasonIndcn_UB : 272|1@0+ (1,0) [0|1] "" TCAM
 SG_ DischrgPwrExceedWarn : 262|1@0+ (1,0) [0|1] "" TCAM
 SG_ DischrgPwrExceedWarn_UB : 261|1@0+ (1,0) [0|1] "" TCAM
 SG_ DrvrSeatInAutMovmt : 260|1@0+ (1,0) [0|1] "" Vector__XXX
 SG_ DrvrSeatInAutMovmt_UB : 259|1@0+ (1,0) [0|1] "" Vector__XXX
 SG_ DrvrSeatSnsrSts : 258|2@0+ (1,0) [0|3] "" TCAM
 SG_ DrvrSeatSnsrSts_UB : 256|1@0+ (1,0) [0|1] "" TCAM
 SG_ DrvrSeatSts : 293|2@0+ (1,0) [0|3] "" TCAM
 SG_ DrvrSeatSts_UB : 291|1@0+ (1,0) [0|1] "" TCAM
 SG_ DstEstimdToEmptyForTarSoc1 : 79|10@0+ (1.0,0.0) [0.0|1023.0] "KiloMtr" TCAM
 SG_ DstEstimdToEmptyForTarSoc1_UB : 85|1@0+ (1,0) [0|1] "" TCAM
 SG_ DstEstimdToEmptyForTarSoc2 : 81|10@0+ (1.0,0.0) [0.0|1023.0] "KiloMtr" TCAM
 SG_ DstEstimdToEmptyForTarSoc2_UB : 82|1@0+ (1,0) [0|1] "" TCAM
 SG_ DstTrvldAct : 40|25@0+ (0.1,0.0) [0.0|2000000.0] "km" TCAM
 SG_ DstTrvldAct_UB : 41|1@0+ (1,0) [0|1] "" TCAM
 SG_ EngCooltLvl : 84|1@0+ (1,0) [0|1] "" TCAM
 SG_ EngCooltLvl_UB : 83|1@0+ (1,0) [0|1] "" TCAM
 SG_ EpbLampReq_UB : 102|1@0+ (1,0) [0|1] "" TCAM
 SG_ EpbLampReqChks : 111|8@0+ (1.0,0.0) [0.0|255.0] "Unitless" TCAM
 SG_ EpbLampReqCntr : 99|4@0+ (1.0,0.0) [0.0|15.0] "Unitless" TCAM
 SG_ EpbLampReqEpbLampReq : 101|2@0+ (1,0) [0|3] "" TCAM
 SG_ ErsDelayTiCfm : 124|1@0+ (1,0) [0|1] "" TCAM
 SG_ ErsDelayTiCfm_UB : 123|1@0+ (1,0) [0|1] "" TCAM
 SG_ ErsStrtApplSts : 121|2@0+ (1,0) [0|3] "" TCAM
 SG_ ErsStrtApplSts_UB : 122|1@0+ (1,0) [0|1] "" TCAM
 SG_ ErsStrtRes : 143|5@0+ (1,0) [0|31] "" TCAM
 SG_ ErsStrtRes_UB : 149|1@0+ (1,0) [0|1] "" TCAM
 SG_ GearLvrIndcn : 138|3@0+ (1,0) [0|7] "" TCAM
 SG_ GearLvrIndcn_UB : 148|1@0+ (1,0) [0|1] "" TCAM
 SG_ HealthOfEngOil : 135|7@0+ (1.0,0.0) [0.0|100.0] "%" TCAM
 SG_ HealthOfEngOil_UB : 128|1@0+ (1,0) [0|1] "" TCAM
 SG_ HvCellTOverFlt : 151|2@0+ (1,0) [0|3] "" TCAM
 SG_ HvCellTOverFlt_UB : 147|1@0+ (1,0) [0|1] "" TCAM
 SG_ NatUsgDayOfOil : 145|10@0+ (1.0,0.0) [0.0|1023.0] "Unitless" TCAM
 SG_ NatUsgDayOfOil_UB : 146|1@0+ (1,0) [0|1] "" TCAM
 SG_ ObdAccrPedRat : 119|8@0+ (0.3921568628,0.0) [0.0|100.00000001400001] "%" TCAM
 SG_ ObdAccrPedRat_UB : 103|1@0+ (1,0) [0|1] "" TCAM
 SG_ PasAcsInHmiReq : 167|1@0+ (1,0) [0|1] "" TCAM
 SG_ PasAcsInHmiReq_UB : 166|1@0+ (1,0) [0|1] "" TCAM
 SG_ PasAcsOutHmiReq : 165|1@0+ (1,0) [0|1] "" TCAM
 SG_ PasAcsOutHmiReq_UB : 164|1@0+ (1,0) [0|1] "" TCAM
 SG_ RemCtrlVehSts : 303|4@0+ (1,0) [0|15] "" TCAM
 SG_ RemCtrlVehSts_UB : 299|1@0+ (1,0) [0|1] "" TCAM
 SG_ SeatOccptAtRowThrdMid : 173|2@0+ (1,0) [0|3] "" TCAM
 SG_ SeatOccptAtRowThrdMid_UB : 168|1@0+ (1,0) [0|1] "" TCAM
 SG_ TotDstTrvldOfEng : 183|25@0+ (0.1,0.0) [0.0|2000000.0] "km" TCAM
 SG_ TotDstTrvldOfEng_UB : 206|1@0+ (1,0) [0|1] "" TCAM
 SG_ TotDstTrvldOfEV : 200|25@0+ (0.1,0.0) [0.0|2000000.0] "km" TCAM
 SG_ TotDstTrvldOfEV_UB : 201|1@0+ (1,0) [0|1] "" TCAM
 SG_ WinFailrStsAtDrvr : 205|1@0+ (1,0) [0|1] "" TCAM
 SG_ WinFailrStsAtDrvr_UB : 204|1@0+ (1,0) [0|1] "" TCAM
 SG_ WinFailrStsAtReLe : 203|1@0+ (1,0) [0|1] "" TCAM
 SG_ WinFailrStsAtReLe_UB : 202|1@0+ (1,0) [0|1] "" TCAM
 SG_ WshrFldTankStsToHMI : 239|1@0+ (1,0) [0|1] "" TCAM
 SG_ WshrFldTankStsToHMI_UB : 238|1@0+ (1,0) [0|1] "" TCAM

BO_ 160 DhuConnCANFDFr05 : 64 IHU
 SG_ BLEKeySearchReq_UB : 16|1@0+ (1,0) [0|1] "" TCAM
 SG_ BLEKeySearchReqKeyLocn : 7|4@0+ (1,0) [0|15] "" TCAM
 SG_ BLEKeySearchReqTirgger : 3|4@0+ (1,0) [0|15] "" TCAM
 SG_ BookTrvlFltSts : 18|1@0+ (1,0) [0|1] "" TCAM
 SG_ BookTrvlFltSts_UB : 17|1@0+ (1,0) [0|1] "" TCAM
 SG_ BookTrvlSetResponse : 51|2@0+ (1,0) [0|3] "" TCAM
 SG_ BookTrvlSetResponse_UB : 52|1@0+ (1,0) [0|1] "" TCAM
 SG_ BookTrvlTiSetReq_UB : 19|1@0+ (1,0) [0|1] "" TCAM
 SG_ BookTrvlTiSetReqBookTrvlChrgnTi : 15|11@0+ (1.0,0.0) [0.0|2047.0] "Mins" TCAM
 SG_ BookTrvlTiSetReqBookTrvlTiSetReq : 20|1@0+ (1,0) [0|1] "" TCAM
 SG_ CrashSts2 : 341|2@0+ (1,0) [0|3] "" TCAM
 SG_ CrashSts2_UB : 339|1@0+ (1,0) [0|1] "" TCAM
 SG_ CrashStsSafe_UB : 29|1@0+ (1,0) [0|1] "" TCAM
 SG_ CrashStsSafeChks : 39|8@0+ (1.0,0.0) [0.0|255.0] "Unitless" TCAM
 SG_ CrashStsSafeCntr : 27|4@0+ (1.0,0.0) [0.0|15.0] "Unitless" TCAM
 SG_ CrashStsSafeSts : 28|1@0+ (1,0) [0|1] "" TCAM
 SG_ DchaChrgnTarVal : 47|10@0+ (0.1,0.0) [0.0|100.0] "%" TCAM
 SG_ DchaChrgnTarVal_UB : 53|1@0+ (1,0) [0|1] "" TCAM
 SG_ DigKeyDataToRemCtrl_UB : 48|1@0+ (1,0) [0|1] "" TCAM
 SG_ DigKeyDataToRemCtrlAcknowledgment : 119|8@0+ (1.0,0.0) [0.0|255.0] "Unitless" TCAM
 SG_ DigKeyDataToRemCtrlDKDataByte1 : 71|8@0+ (1.0,0.0) [0.0|255.0] "Unitless" TCAM
 SG_ DigKeyDataToRemCtrlDKDataByte2 : 79|8@0+ (1.0,0.0) [0.0|255.0] "Unitless" TCAM
 SG_ DigKeyDataToRemCtrlDKDataByte3 : 87|8@0+ (1.0,0.0) [0.0|255.0] "Unitless" TCAM
 SG_ DigKeyDataToRemCtrlDKDataByte4 : 95|8@0+ (1.0,0.0) [0.0|255.0] "Unitless" TCAM
 SG_ DigKeyDataToRemCtrlDKDataByte5 : 103|8@0+ (1.0,0.0) [0.0|255.0] "Unitless" TCAM
 SG_ DigKeyDataToRemCtrlDKDataByte6 : 111|8@0+ (1.0,0.0) [0.0|255.0] "Unitless" TCAM
 SG_ DigKeyDataToRemCtrlHeader : 63|8@0+ (1.0,0.0) [0.0|255.0] "Unitless" TCAM
 SG_ DKDataFromCEM_UB : 49|1@0+ (1,0) [0|1] "" TCAM
 SG_ DKDataFromCEMAcknowledgment : 183|8@0+ (1.0,0.0) [0.0|255.0] "Unitless" TCAM
 SG_ DKDataFromCEMDKDataByte1 : 135|8@0+ (1.0,0.0) [0.0|255.0] "Unitless" TCAM
 SG_ DKDataFromCEMDKDataByte2 : 143|8@0+ (1.0,0.0) [0.0|255.0] "Unitless" TCAM
 SG_ DKDataFromCEMDKDataByte3 : 151|8@0+ (1.0,0.0) [0.0|255.0] "Unitless" TCAM
 SG_ DKDataFromCEMDKDataByte4 : 159|8@0+ (1.0,0.0) [0.0|255.0] "Unitless" TCAM
 SG_ DKDataFromCEMDKDataByte5 : 167|8@0+ (1.0,0.0) [0.0|255.0] "Unitless" TCAM
 SG_ DKDataFromCEMDKDataByte6 : 175|8@0+ (1.0,0.0) [0.0|255.0] "Unitless" TCAM
 SG_ DKDataFromCEMHeader : 127|8@0+ (1.0,0.0) [0.0|255.0] "Unitless" TCAM
 SG_ HmiResetTcamReq : 195|1@0+ (1,0) [0|1] "" TCAM
 SG_ HmiResetTcamReq_UB : 194|1@0+ (1,0) [0|1] "" TCAM
 SG_ LvngObjDetnWarn : 31|1@0+ (1,0) [0|1] "" TCAM
 SG_ LvngObjDetnWarn_UB : 30|1@0+ (1,0) [0|1] "" TCAM
 SG_ MobDevRCVSts : 351|8@0+ (1.0,0.0) [0.0|255.0] "Unitless" TCAM
 SG_ MobDevRCVSts_UB : 338|1@0+ (1,0) [0|1] "" TCAM
 SG_ MobDevRPASts_UB : 198|1@0+ (1,0) [0|1] "" TCAM
 SG_ MobDevRPAStsOnOff1 : 199|1@0+ (1,0) [0|1] "" TCAM
 SG_ MobDevRPAStsUInt8 : 191|8@0+ (1.0,0.0) [0.0|255.0] "Unitless" TCAM
 SG_ NFCAndBLEKeyDiReq_UB : 193|1@0+ (1,0) [0|1] "" TCAM
 SG_ NFCAndBLEKeyDiReqData1 : 207|8@0+ (1.0,0.0) [0.0|255.0] "Unitless" TCAM
 SG_ NFCAndBLEKeyDiReqData10 : 279|8@0+ (1.0,0.0) [0.0|255.0] "Unitless" TCAM
 SG_ NFCAndBLEKeyDiReqData11 : 287|8@0+ (1.0,0.0) [0.0|255.0] "Unitless" TCAM
 SG_ NFCAndBLEKeyDiReqData12 : 295|8@0+ (1.0,0.0) [0.0|255.0] "Unitless" TCAM
 SG_ NFCAndBLEKeyDiReqData13 : 303|8@0+ (1.0,0.0) [0.0|255.0] "Unitless" TCAM
 SG_ NFCAndBLEKeyDiReqData14 : 311|8@0+ (1.0,0.0) [0.0|255.0] "Unitless" TCAM
 SG_ NFCAndBLEKeyDiReqData15 : 319|8@0+ (1.0,0.0) [0.0|255.0] "Unitless" TCAM
 SG_ NFCAndBLEKeyDiReqData16 : 327|8@0+ (1.0,0.0) [0.0|255.0] "Unitless" TCAM
 SG_ NFCAndBLEKeyDiReqData2 : 215|8@0+ (1.0,0.0) [0.0|255.0] "Unitless" TCAM
 SG_ NFCAndBLEKeyDiReqData3 : 223|8@0+ (1.0,0.0) [0.0|255.0] "Unitless" TCAM
 SG_ NFCAndBLEKeyDiReqData4 : 231|8@0+ (1.0,0.0) [0.0|255.0] "Unitless" TCAM
 SG_ NFCAndBLEKeyDiReqData5 : 239|8@0+ (1.0,0.0) [0.0|255.0] "Unitless" TCAM
 SG_ NFCAndBLEKeyDiReqData6 : 247|8@0+ (1.0,0.0) [0.0|255.0] "Unitless" TCAM
 SG_ NFCAndBLEKeyDiReqData7 : 255|8@0+ (1.0,0.0) [0.0|255.0] "Unitless" TCAM
 SG_ NFCAndBLEKeyDiReqData8 : 263|8@0+ (1.0,0.0) [0.0|255.0] "Unitless" TCAM
 SG_ NFCAndBLEKeyDiReqData9 : 271|8@0+ (1.0,0.0) [0.0|255.0] "Unitless" TCAM
 SG_ NFCKeySearchReq_UB : 192|1@0+ (1,0) [0|1] "" TCAM
 SG_ NFCKeySearchReqKeyLocn : 335|4@0+ (1,0) [0|15] "" TCAM
 SG_ NFCKeySearchReqTirgger : 331|4@0+ (1,0) [0|15] "" TCAM
 SG_ PrkgCmftRunRmnReq : 343|1@0+ (1,0) [0|1] "" TCAM
 SG_ PrkgCmftRunRmnReq_UB : 342|1@0+ (1,0) [0|1] "" TCAM

BO_ 528 DhuConnCANFDFr06 : 64 IHU
 SG_ ApproachLiSetReq : 87|2@0+ (1,0) [0|3] "" TCAM
 SG_ ApproachLiSetReq_UB : 85|1@0+ (1,0) [0|1] "" TCAM
 SG_ BrkLiOnReq_UB : 10|1@0+ (1,0) [0|1] "" TCAM
 SG_ BrkLiOnReqChks : 7|8@0+ (1.0,0.0) [0.0|255.0] "Unitless" TCAM
 SG_ BrkLiOnReqCntr : 15|4@0+ (1.0,0.0) [0.0|15.0] "Unitless" TCAM
 SG_ BrkLiOnReqSts : 11|1@0+ (1,0) [0|1] "" TCAM
 SG_ CarCfgInfoToWPC : 23|4@0+ (1.0,0.0) [0.0|15.0] "Unitless" TCAM
 SG_ CarCfgInfoToWPC_UB : 9|1@0+ (1,0) [0|1] "" TCAM
 SG_ DChrgStrtEngRes : 19|4@0+ (1,0) [0|15] "" TCAM
 SG_ DChrgStrtEngRes_UB : 8|1@0+ (1,0) [0|1] "" TCAM
 SG_ DHUConnectionSts : 53|1@0+ (1,0) [0|1] "" TCAM
 SG_ DHUConnectionSts_UB : 52|1@0+ (1,0) [0|1] "" TCAM
 SG_ DstTrvldOfEng : 31|25@0+ (0.1,0.0) [0.0|2000000.0] "km" TCAM
 SG_ DstTrvldOfEng_UB : 54|1@0+ (1,0) [0|1] "" TCAM
 SG_ DstTrvldOfEV : 48|25@0+ (0.1,0.0) [0.0|2000000.0] "km" TCAM
 SG_ DstTrvldOfEV_UB : 49|1@0+ (1,0) [0|1] "" TCAM
 SG_ ExtrLtgSts_UB : 84|1@0+ (1,0) [0|1] "" TCAM
 SG_ ExtrLtgStsAFS : 103|2@0+ (1,0) [0|3] "" TCAM
 SG_ ExtrLtgStsAHBC : 101|2@0+ (1,0) [0|3] "" TCAM
 SG_ ExtrLtgStsAHL : 99|2@0+ (1,0) [0|3] "" TCAM
 SG_ ExtrLtgStsAllWL : 97|2@0+ (1,0) [0|3] "" TCAM
 SG_ ExtrLtgStsApproach : 111|2@0+ (1,0) [0|3] "" TCAM
 SG_ ExtrLtgStsChks : 95|8@0+ (1.0,0.0) [0.0|255.0] "Unitless" TCAM
 SG_ ExtrLtgStsCntr : 83|4@0+ (1.0,0.0) [0.0|15.0] "Unitless" TCAM
 SG_ ExtrLtgStsCornrgLi : 109|2@0+ (1,0) [0|3] "" TCAM
 SG_ ExtrLtgStsDBL : 107|2@0+ (1,0) [0|3] "" TCAM
 SG_ ExtrLtgStsDRL : 105|2@0+ (1,0) [0|3] "" TCAM
 SG_ ExtrLtgStsFlash : 119|2@0+ (1,0) [0|3] "" TCAM
 SG_ ExtrLtgStsFrntFog : 117|2@0+ (1,0) [0|3] "" TCAM
 SG_ ExtrLtgStsGoodbye : 115|2@0+ (1,0) [0|3] "" TCAM
 SG_ ExtrLtgStsHiBeam : 125|2@0+ (1,0) [0|3] "" TCAM
 SG_ ExtrLtgStsHomeSafe : 113|2@0+ (1,0) [0|3] "" TCAM
 SG_ ExtrLtgStsHWL : 127|2@0+ (1,0) [0|3] "" TCAM
 SG_ ExtrLtgStsLoBeam : 123|2@0+ (1,0) [0|3] "" TCAM
 SG_ ExtrLtgStsLtgShow : 121|2@0+ (1,0) [0|3] "" TCAM
 SG_ ExtrLtgStsPosLiFrnt : 135|2@0+ (1,0) [0|3] "" TCAM
 SG_ ExtrLtgStsPosLiRe : 133|2@0+ (1,0) [0|3] "" TCAM
 SG_ ExtrLtgStsReFog : 131|2@0+ (1,0) [0|3] "" TCAM
 SG_ ExtrLtgStsReverseLi : 129|2@0+ (1,0) [0|3] "" TCAM
 SG_ ExtrLtgStsStopLi : 143|2@0+ (1,0) [0|3] "" TCAM
 SG_ ExtrLtgStsTurnIndrLe : 141|2@0+ (1,0) [0|3] "" TCAM
 SG_ ExtrLtgStsTurnIndrRi : 139|2@0+ (1,0) [0|3] "" TCAM
 SG_ ExtrLtgStsWelcome : 137|2@0+ (1,0) [0|3] "" TCAM
 SG_ IndcrSts : 223|2@0+ (1,0) [0|3] "" TCAM
 SG_ IndcrSts_UB : 221|1@0+ (1,0) [0|1] "" TCAM
 SG_ MobDevRCVReqResp : 51|2@0+ (1,0) [0|3] "" TCAM
 SG_ MobDevRCVReqResp_UB : 385|1@0+ (1,0) [0|1] "" TCAM
 SG_ OnBdChrgrRdyTi : 151|7@0+ (100.0,0.0) [0.0|12700.0] "Milliseconds" TCAM
 SG_ OnBdChrgrRdyTi_UB : 144|1@0+ (1,0) [0|1] "" TCAM
 SG_ PassMidSeatSts : 219|2@0+ (1,0) [0|3] "" TCAM
 SG_ PassMidSeatSts_UB : 220|1@0+ (1,0) [0|1] "" TCAM
 SG_ PinionSteerAgGroup_UB : 209|1@0+ (1,0) [0|1] "" TCAM
 SG_ PinionSteerAgGroupChks : 159|8@0+ (1.0,0.0) [0.0|255.0] "Unitless" TCAM
 SG_ PinionSteerAgGroupCntr : 215|4@0+ (1.0,0.0) [0.0|15.0] "Unitless" TCAM
 SG_ PinionSteerAgGroupPinionSteerAg1 : 199|15@0- (0.0009765625,0.0) [-14.5|14.5] "rad" TCAM
 SG_ PinionSteerAgGroupPinionSteerAg1Qf : 167|2@0+ (1,0) [0|3] "" TCAM
 SG_ PinionSteerAgGroupPinionSteerAgSpd1 : 165|14@0- (0.0078125,0.0) [-50.0|50.0] "rad/s" TCAM
 SG_ PinionSteerAgGroupPinionSteerAgSpd1Qf : 183|2@0+ (1,0) [0|3] "" TCAM
 SG_ PinionSteerAgGroupSteerWhlTq : 181|14@0- (0.00390625,0.0) [-30.0|30.0] "NewtonMeter" TCAM
 SG_ PinionSteerAgGroupSteerWhlTqQf : 211|2@0+ (1,0) [0|3] "" TCAM
 SG_ RCVModIncln : 241|2@0+ (1,0) [0|3] "" TCAM
 SG_ RCVModIncln_UB : 242|1@0+ (1,0) [0|1] "" TCAM
 SG_ RestrntSysLampReq : 217|2@0+ (1,0) [0|3] "" TCAM
 SG_ RestrntSysLampReq_UB : 208|1@0+ (1,0) [0|1] "" TCAM
 SG_ RlyPwrDistbnCmd1WdPreBattSaveCmd : 247|1@0+ (1,0) [0|1] "" TCAM
 SG_ RlyPwrDistbnCmd1WdPreBattSaveCmd_UB : 246|1@0+ (1,0) [0|1] "" TCAM
 SG_ SeatOccptAtRowFrthLe : 231|2@0+ (1,0) [0|3] "" TCAM
 SG_ SeatOccptAtRowFrthLe_UB : 229|1@0+ (1,0) [0|1] "" TCAM
 SG_ SeatOccptAtRowFrthMid : 227|2@0+ (1,0) [0|3] "" TCAM
 SG_ SeatOccptAtRowFrthMid_UB : 228|1@0+ (1,0) [0|1] "" TCAM
 SG_ SeatOccptAtRowFrthRi : 225|2@0+ (1,0) [0|3] "" TCAM
 SG_ SeatOccptAtRowFrthRi_UB : 245|1@0+ (1,0) [0|1] "" TCAM
 SG_ TiAndDateIndcn_UB : 255|1@0+ (1,0) [0|1] "" TCAM
 SG_ TiAndDateIndcnDataValid : 254|1@0+ (1,0) [0|1] "" TCAM
 SG_ TiAndDateIndcnDay : 276|5@0+ (1.0,0.0) [1.0|31.0] "Days" TCAM
 SG_ TiAndDateIndcnHr1 : 268|5@0+ (1.0,0.0) [0.0|23.0] "hours" TCAM
 SG_ TiAndDateIndcnMins1 : 261|6@0+ (1.0,0.0) [0.0|59.0] "Mins" TCAM
 SG_ TiAndDateIndcnMth1 : 283|4@0+ (1.0,0.0) [1.0|12.0] "Month" TCAM
 SG_ TiAndDateIndcnSec1 : 253|6@0+ (1.0,0.0) [0.0|59.0] "s" TCAM
 SG_ TiAndDateIndcnYr1 : 294|7@0+ (1.0,0.0) [0.0|99.0] "Year" TCAM
 SG_ VehNotifAndLedFltSts_UB : 243|1@0+ (1,0) [0|1] "" TCAM
 SG_ VehNotifAndLedFltStsByte0 : 303|8@0+ (1.0,0.0) [0.0|255.0] "Unitless" TCAM
 SG_ VehNotifAndLedFltStsByte1 : 311|8@0+ (1.0,0.0) [0.0|255.0] "Unitless" TCAM
 SG_ VehNotifAndLedFltStsByte2 : 319|8@0+ (1.0,0.0) [0.0|255.0] "Unitless" TCAM
 SG_ VehNotifAndLedFltStsByte3 : 327|8@0+ (1.0,0.0) [0.0|255.0] "Unitless" TCAM
 SG_ VehNotifAndLedFltStsByte4 : 335|8@0+ (1.0,0.0) [0.0|255.0] "Unitless" TCAM
 SG_ VehNotifAndLedFltStsByte5 : 343|8@0+ (1.0,0.0) [0.0|255.0] "Unitless" TCAM
 SG_ VehNotifAndLedFltStsByte6 : 351|8@0+ (1.0,0.0) [0.0|255.0] "Unitless" TCAM
 SG_ VehNotifAndLedFltStsByte7 : 359|8@0+ (1.0,0.0) [0.0|255.0] "Unitless" TCAM
 SG_ VehSpdLgt_UB : 367|1@0+ (1,0) [0|1] "" TCAM
 SG_ VehSpdLgtA : 366|15@0+ (0.00391,0.0) [0.0|125.0027] "m/s" TCAM
 SG_ VehSpdLgtChks : 383|8@0+ (1.0,0.0) [0.0|255.0] "Unitless" TCAM
 SG_ VehSpdLgtCntr : 391|4@0+ (1.0,0.0) [0.0|15.0] "Unitless" TCAM
 SG_ VehSpdLgtQf : 387|2@0+ (1,0) [0|3] "" TCAM

CM_ BU_ ETC "External Tester Connector";

CM_ SG_ 960 AccrPedlRatAccrPedlRat "Accelerator Pedal Position with adapted 0 point. Value as percentage of fully pressed pedal";
CM_ SG_ 960 AccrPedlRatChks "Accelerator Pedal Position with adapted 0 point. Value as percentage of fully pressed pedal. Checksum";
CM_ SG_ 960 AccrPedlRatCntr "Accelerator Pedal Position with adapted 0 point. Value as percentage of fully pressed pedal. Counter";
CM_ SG_ 960 AmbTIndcdWithUnitAmbTIndcd "Indicated ambient temperature";
CM_ SG_ 960 AmbTIndcdWithUnitAmbTIndcdUnit "Unit of the indicated temperature";
CM_ SG_ 960 AmbTIndcdWithUnitQF "QF";
CM_ SG_ 960 BkpOfDstTrvld "total traveled distance.";
CM_ SG_ 960 BkpOfDstTrvldHiResl "total driven distance with resolution of 100m.";
CM_ SG_ 960 BrkFldLvl "brake fule level";
CM_ SG_ 960 BrkFricTqTotAtWhlsActBrkFricTqTotAtWhlsAct "Total actual friction brake toque at all four wheels.";
CM_ SG_ 960 BrkFricTqTotAtWhlsActChks "Total actual friction brake toque at all four wheels. Checksum";
CM_ SG_ 960 BrkFricTqTotAtWhlsActCntr "Total actual friction brake toque at all four wheels. Counter";
CM_ SG_ 960 BrkPedlPsdBrkPedlNotPsdSafe "Set to 1 if brake pedal is not pressed, otherwise 0";
CM_ SG_ 960 BrkPedlPsdBrkPedlPsd "Set to 1 if brake pedal is pressed, otherwise 0";
CM_ SG_ 960 BrkPedlPsdChks "Checksum";
CM_ SG_ 960 BrkPedlPsdCntr "Counter";
CM_ SG_ 960 BrkPedlPsdQf "Quality factor";
CM_ SG_ 960 BrkPedlrRatPerc "Brake pedal Ratio in percentage value";
CM_ SG_ 960 BrkPedlrRatQf "quality factor";
CM_ SG_ 960 BrkPedlTrvlAct "Information about driver brake request derived from the travel sensor in the brake booster. Actual value for the output rod";
CM_ SG_ 960 BrkPedlTrvlChks "Information about driver brake request derived from the travel sensor in the brake booster. Checksum";
CM_ SG_ 960 BrkPedlTrvlCntr "Information about driver brake request derived from the travel sensor in the brake booster. Counter";
CM_ SG_ 960 BrkPedlTrvlQf "Information about driver brake request derived from the travel sensor in the brake booster. Travel sensor quality factor";
CM_ SG_ 960 BrkPedlTrvlSt "Information about driver brake request derived from the travel sensor in the brake booster. Brake pedal applied information";
CM_ SG_ 960 BrkPedlTrvlStQf "Information about driver brake request derived from the travel sensor in the brake booster. Brake pedal applied information quality factor";
CM_ SG_ 960 BrkPedlTrvlTar "Information about driver brake request derived from the travel sensor in the brake booster. Target value for the output rod";
CM_ SG_ 960 CnclFaceReqGid1Byte0 "Require for take list for local profile to remove. Byte 0";
CM_ SG_ 960 CnclFaceReqGid1Byte1 "Require for take list for local profile to remove. Byte 1";
CM_ SG_ 960 CnclFaceReqGid1Byte2 "Require for take list for local profile to remove. Byte 2";
CM_ SG_ 960 CnclFaceReqGid1Byte3 "Require for take list for local profile to remove. Byte 3";
CM_ SG_ 960 CnclFaceReqGid1Byte4 "Require for take list for local profile to remove. Byte 4";
CM_ SG_ 960 CnclFaceReqGid1Byte5 "Require for take list for local profile to remove. Byte 5";
CM_ SG_ 960 CnclFaceReqGid1Byte6 "Require for take list for local profile to remove. Byte 6";
CM_ SG_ 960 CnclFaceReqGid1Byte7 "Require for take list for local profile to remove. Byte 7";
CM_ SG_ 960 CnclFaceReqGid2Byte0 "Require for take list for local profile to remove. Byte 0";
CM_ SG_ 960 CnclFaceReqGid2Byte1 "Require for take  one list for local profile to remove. Byte 1";
CM_ SG_ 960 CnclFaceReqGid2Byte2 "Require for take list for local profile to remove. Byte 2";
CM_ SG_ 960 CnclFaceReqGid2Byte3 "Require for take list for local profile to remove. Byte 3";
CM_ SG_ 960 CnclFaceReqGid2Byte4 "Require for take list for local profile to remove. Byte 4";
CM_ SG_ 960 CnclFaceReqGid2Byte5 "Require for take list for local profile to remove. Byte 5";
CM_ SG_ 960 CnclFaceReqGid2Byte6 "Require for take list for local profile to remove. Byte 6";
CM_ SG_ 960 CnclFaceReqGid2Byte7 "Require for take list for local profile to remove. Byte 7";
CM_ SG_ 960 DayToSrv "Days left before service shall be done";
CM_ SG_ 960 DCChrgnHndlSts "Fast charging gun connect state";
CM_ SG_ 960 DcDcActvd "DCDC actived state";
CM_ SG_ 960 DispBattEgyIn "Electric battery energy absorbed by the HV Battery. NB: Only power flowing into HV battery is integrated. Energy=integral( max( battery power flowing in , 0) ).";
CM_ SG_ 960 DispBattEgyOut "Electric battery energy delivered by the HV Battery. NB: Only power flowing out of the HV battery is integrated. Energy=integral( max( battery power flowing out , 0) ).";
CM_ SG_ 960 DispHvBattLvlOfChrg "HV battery State-Of-Charge (SOC) value for display to driver. Note: this value may differ from the actual battery SOC. ";
CM_ SG_ 960 DstEstimdToEmptyForDrvgElecIndcdDstToEmpty "Distance to empty Indicated for electrical drive.";
CM_ SG_ 960 DstEstimdToEmptyForDrvgElecIndcdDstUnit "Distance to unit";
CM_ SG_ 960 DstToEmptyIndcdDstToEmpty "Indicated distance to Empty (D.T.E.) with indicated unit Distance To Empty";
CM_ SG_ 960 DstToEmptyIndcdDstUnit "Indicated distance to Empty (D.T.E.) with indicated unit Indicated distance to empty unit";
CM_ SG_ 960 DstToSrv "Distance (km) left before service shall be done";
CM_ SG_ 960 DstTrvld1 "Trip1 data transmitted";
CM_ SG_ 960 DstTrvld2 "Trip2 data transmitted";
CM_ SG_ 960 FltElecDcDc "The electrical fault indication of DCDC";
CM_ SG_ 960 FltTDcDc "The temperature fault indication of DCDC";
CM_ SG_ 960 MmedHdPwrMod "IHU power mode";
CM_ SG_ 960 VehPropSts "Vehicle propulsion status indicating vehicle is propulsive or not";
CM_ SG_ 384 AlrmStsAlrmFailr "Indicates alarm status, last trigger source and alarm component errors.";
CM_ SG_ 384 AlrmStsAlrmSt "Indicates alarm status, last trigger source and alarm component errors.";
CM_ SG_ 384 AlrmStsAlrmTrgSrc "Indicates alarm status, last trigger source and alarm component errors.";
CM_ SG_ 384 AlrmStsSnsrInclnFailr "Indicates alarm status, last trigger source and alarm component errors.";
CM_ SG_ 384 AlrmStsSnsrIntrScanrFailr "Indicates alarm status, last trigger source and alarm component errors.";
CM_ SG_ 384 AmbTEstimdAmbTEstimd "Estimated/filtered/modelled amibient temperature based on information from ambient temp sensor and all other available temperature sensors and vehicle information.  Estimated ambient temperature";
CM_ SG_ 384 AmbTEstimdQf "Estimated/filtered/modelled amibient temperature based on information from ambient temp sensor and all other available temperature sensors and vehicle information.  Quality factor for estimated signal";
CM_ SG_ 384 BattFltStsPrimBattFltStsPrm "Battery fault status primary.";
CM_ SG_ 384 BattFltStsPrimChks "CheckSum";
CM_ SG_ 384 BattFltStsPrimCntr "Counter";
CM_ SG_ 384 BltLockStAtDrvrBltLockSt1 "State of belt lock at driver seating position Belt lock state, locked/unlocked";
CM_ SG_ 384 BltLockStAtDrvrBltLockSts "State of belt lock at driver seating position Belt lock status, OK/NOK";
CM_ SG_ 384 BltLockStAtPassBltLockSt1 "State of belt lock at passenger seating position Belt lock state, locked/unlocked";
CM_ SG_ 384 BltLockStAtPassBltLockSts "State of belt lock at passenger seating position Belt lock status, OK/NOK";
CM_ SG_ 384 CmptmtAirTEstimdExtdComptmtT "Estimated compartment temperature with quality flag Estimated compartment Temperature";
CM_ SG_ 384 CmptmtAirTEstimdExtdQlyFlg "Estimated compartment temperature with quality flag Quality flag ";
CM_ SG_ 384 DigKeyPasEntryDiSts "Digital Key Passive entry disable status";
CM_ SG_ 384 DlyClsActv "Signal informing Remote Control that a Delay Close of the tailgate is active";
CM_ SG_ 384 FrntLeOfSnsrOfPrkgAssiSide "This is  the detected barriers distance range from front left side sector";
CM_ SG_ 384 FrntRiOfSnsrOfPrkgAssiSide "This is  the detected barriers distance range from front right side sector";
CM_ SG_ 384 HvSysRlyStsChks "Checksum for E2E";
CM_ SG_ 384 HvSysRlyStsCntr "Counter for E2E";
CM_ SG_ 384 HvSysRlyStsHvSysRlySts "Actual state of the main contactors.";
CM_ SG_ 384 ImobRemMgrChkImobDataRemMgrChk0 "Flag to TEM that RVI challenge is available and 5 bytes challenge Challenge byte 0";
CM_ SG_ 384 ImobRemMgrChkImobDataRemMgrChk1 "Flag to TEM that RVI challenge is available and 5 bytes challenge Challenge Byte 1";
CM_ SG_ 384 ImobRemMgrChkImobDataRemMgrChk2 "Flag to TEM that RVI challenge is available and 5 bytes challenge Challenge byte 2";
CM_ SG_ 384 ImobRemMgrChkImobDataRemMgrChk3 "Flag to TEM that RVI challenge is available and 5 bytes challenge Challenge byte 3";
CM_ SG_ 384 ImobRemMgrChkImobDataRemMgrChk4 "Flag to TEM that RVI challenge is available and 5 bytes challenge Challenge byte 4";
CM_ SG_ 384 ImobRemMgrChkSts "Flag to TEM that RVI challenge is available and 5 bytes challenge Challenge available";
CM_ SG_ 384 ImobVehRemMgrSts1ImobVehRemMgrSts "RVI status from CEM to TEM Status for RVI manager";
CM_ SG_ 384 ImobVehRemMgrSts1SpdLimRemMgrSts "RVI status from CEM to TEM Remote vehicle slow down";
CM_ SG_ 384 InsdLeOfSnsrPrkgAssiFrnt "This is the distance of detected barriers from front inside left USS";
CM_ SG_ 384 InsdLeOfSnsrPrkgAssiRe "This is the distance of detected barriers from rear inside left USS";
CM_ SG_ 384 InsdRiOfSnsrPrkgAssiFrnt "This is the distance of detected barriers from front inside right USS";
CM_ SG_ 384 InsdRiOfSnsrPrkgAssiRe "This is the distance of detected barriers from rear inside right USS";
CM_ SG_ 384 KeyScanActv "Signal to inform about if a key search is in progress.
TRUE - Key search ongoing
FALSE - No key search";
CM_ SG_ 384 MobDevRPAAuthentReq1AuthentSts "authentsts";
CM_ SG_ 384 MobDevRPAAuthentReq1Chks "CHKS";
CM_ SG_ 384 MobDevRPAAuthentReq1Cntr "counter";
CM_ SG_ 384 MobDevRPAAuthentReq1RndX "randomx";
CM_ SG_ 384 MobDevRPAAuthentReq1RndY "randomY";
CM_ SG_ 384 MobDevRPABtnStsToAppGrpPrkgInBtnSts "Mobile phone remote parking in button display status";
CM_ SG_ 384 MobDevRPABtnStsToAppGrpPrkgOutBtnSts "Mobile phone remote parking out button display status";
CM_ SG_ 384 MobDevRPABtnStsToAppGrpRemParkOutCrsSwtRsp "The PAS side is opposite to the feedback signal of the cruise button";
CM_ SG_ 384 MobDevRPAReqResp "Parking system feedback on mobile device side commands";
CM_ SG_ 384 ObstacleMinimumDistanceFrntMinDst "Output minimum distance value. Initial value: 511";
CM_ SG_ 384 ObstacleMinimumDistanceFrntMinDstPosn "Minimum Distance Position to DHU.";
CM_ SG_ 384 ObstacleMinimumDistanceFrntStopDispReq "Stop Display Request. Initial value: 0x0: NotReq";
CM_ SG_ 384 ObstacleMinimumDistanceReMinDst "Output minimum distance value. Initial value: 511";
CM_ SG_ 384 ObstacleMinimumDistanceReMinDstPosn "Minimum Distance Position to DHU.";
CM_ SG_ 384 ObstacleMinimumDistanceReStopDispReq "Stop Display Request. Initial value: 0x0: NotReq";
CM_ SG_ 384 OutdLeOfSnsrPrkgAssiFrnt "This is the distance of detected barriers from front outside left USS";
CM_ SG_ 384 OutdLeOfSnsrPrkgAssiRe "This is the distance of detected barriers from rear outside left USS";
CM_ SG_ 384 OutdRiOfSnsrPrkgAssiFrnt "This is the distance of detected barriers from front outside right USS";
CM_ SG_ 384 OutdRiOfSnsrPrkgAssiRe "This is the distance of detected barriers from rear outside right USS";
CM_ SG_ 384 PanicAlrmSts "Notification panic alarm state to telematics";
CM_ SG_ 384 PrkgDispGroupLeCornrCoornx "That's the X-coordinate of point A";
CM_ SG_ 384 PrkgDispGroupLeCornrCoorny "That's the y-coordinate of point A";
CM_ SG_ 384 PrkgDispGroupLeCornrLocn "left point quadrant
Cartesian coordinate system is established with point A as the origin of coordinates.That's where C is relative to A";
CM_ SG_ 384 PrkgDispGroupPrkgTyp "parking slot type";
CM_ SG_ 384 PrkgDispGroupRiCornrCoornx "That's the x-coordinate of point B";
CM_ SG_ 384 PrkgDispGroupRiCornrCoorny "That's the y-coordinate of point B";
CM_ SG_ 384 PrkgDispGroupStallNr "slot number";
CM_ SG_ 384 PrkgModIncln "Parking mode  indication, RPA RSPA RPP";
CM_ SG_ 384 PrkgOutModBtnStsToAPPPrkgOutModBtnSts1 "Vertical parking out front left button status display";
CM_ SG_ 384 PrkgOutModBtnStsToAPPPrkgOutModBtnSts2 "Vertical parking out front right button status display";
CM_ SG_ 384 PrkgOutModBtnStsToAPPPrkgOutModBtnSts3 "Vertical parking out rear left button status display";
CM_ SG_ 384 PrkgOutModBtnStsToAPPPrkgOutModBtnSts4 "Vertical parking out rear right button status display";
CM_ SG_ 384 PrkgOutModBtnStsToAPPPrkgOutModBtnSts5 "Horizontal left parking out button status dispaly";
CM_ SG_ 384 PrkgOutModBtnStsToAPPPrkgOutModBtnSts6 "Horizontal right parking out button status dispaly";
CM_ SG_ 384 PrkgProcDstDisp "Parking distance countdown displayand the scale value is 0.1 m. The main application scenarios are as follows
RPP self searching parking space
RSPA process distance countdown display
In the process of each gear, the single step driving distance countdown";
CM_ SG_ 384 PrkgProgsDisp "Parking progress display:0-100%";
CM_ SG_ 384 ReLeOfSnsrOfPrkgAssiSide "This is  the detected barriers distance range from rear left side sector";
CM_ SG_ 384 ReRiOfSnsrOfPrkgAssiSide "This is  the detected barriers distance range from rear right side sector";
CM_ SG_ 384 TrOpenerSts "To inform about POT status. moving, opened, closed...";
CM_ SG_ 384 UndoProcSts "undo process status: Indicates whether it is in an undo process";
CM_ SG_ 384 VehModMngtGlbSafe1CarModSts1 "CarMode Status";
CM_ SG_ 384 VehModMngtGlbSafe1CarModSubtypWdCarModSubtyp "CarMode substate status";
CM_ SG_ 384 VehModMngtGlbSafe1Chks "Checksum";
CM_ SG_ 384 VehModMngtGlbSafe1Cntr "Counter";
CM_ SG_ 384 VehModMngtGlbSafe1EgyLvlElecMai "Main energy level in the vehicle.";
CM_ SG_ 384 VehModMngtGlbSafe1EgyLvlElecSubtyp "Substate of the energy level in the vehicle.";
CM_ SG_ 384 VehModMngtGlbSafe1FltEgyCnsWdSts "High quiescent current detected by CEM via BMS.";
CM_ SG_ 384 VehModMngtGlbSafe1PwrLvlElecMai "Main Power level in the vehicle.";
CM_ SG_ 384 VehModMngtGlbSafe1PwrLvlElecSubtyp "Substate of the power level in the vehicle.";
CM_ SG_ 384 VehModMngtGlbSafe1UsgModSts "UsageMode Status";
CM_ SG_ 896 AntithftActvnNotif "Request to telematics module to send a theft notification.";
CM_ SG_ 896 CampMod "Camping mode signal";
CM_ SG_ 896 CampModSocLowRmn "SOC Low Remind to TCAM";
CM_ SG_ 896 CchForFuEcoBarForFuEco "Eco Coach data, both calculated instantaneous and grade eco coach data.";
CM_ SG_ 896 CchForFuEcoGrdForFuEco "Eco Coach data, both calculated instantaneous and grade eco coach data.";
CM_ SG_ 896 ChrgLidAcSts "ChrgLidAcSts - Charge lid for Alternating current
Ukwn - Unknown status
Opend - Opened
Clsd - Closed";
CM_ SG_ 896 ChrgLidDCorAcDcSts "ChrgLidDCorAcDcSts - Charge lid Directc current OR Alternating current and  Direct current
Ukwn - Unknown status
Opend - Opened
Clsd - Closed";
CM_ SG_ 896 ChrgnByEngCmfdReqToDrvr "Request to driver to confirm whether he/she wants to start the engine to charge the HV battery during discharging.";
CM_ SG_ 896 ChrgnOrDisChrgnStsFb "Propulsion subsystem feedback charging and discharging status";
CM_ SG_ 896 ChrgnSts "Information of vehicle charging status, which is requested from GB/T 32960.";
CM_ SG_ 896 CmptmtTFrntCmptmtTFrnt "Measured temperature in compartment. ";
CM_ SG_ 896 CmptmtTFrntFanForCmptmtTRunng "Fan for component temperature requirement.";
CM_ SG_ 896 CmptmtTFrntQf "Component temperature sensor signal quality.";
CM_ SG_ 896 DchaIAct "The discharging current of AC";
CM_ SG_ 896 DchaUAct "The discharging voltage of AC";
CM_ SG_ 896 DstEstimdToEmptyForDrvgElec "Estimated remaining driving range in electric only driving for current HV battery energy content.";
CM_ SG_ 896 EcoClimaSts "Eco climate status.";
CM_ SG_ 896 EngFuCns "Engine fuel consumption";
CM_ SG_ 896 EngFuCnsFild "The econometer data signal for used for driver display have the following requirement for Econometer equalization: Deviations from normal data shall be taken care. Extra fuel consumption shall be stored locally in the ECM, to be transmitted as a distributed small added extra consumption data. ";
CM_ SG_ 896 EngSpdDispd "Engine speed value for engine speed meter in the driver information display. Note that this speed value may differ from the real actual engine speed.";
CM_ SG_ 896 EngSt1WdStsChks "checksum";
CM_ SG_ 896 EngSt1WdStsCntr "counter";
CM_ SG_ 896 EngSt1WdStsEngSt1WdSts "Signaling the state of the powerpack";
CM_ SG_ 896 FileDelStsID "Script ID";
CM_ SG_ 896 FileDelStsSts "File Delete Status";
CM_ SG_ 896 FileDwnldStsID "Script ID";
CM_ SG_ 896 FileDwnldStsSts "File download status from cloud";
CM_ SG_ 896 FltOfFrntTurnIndcrLe "Light source failure (open load or short circuit) indication to driver, left front direction indicator.";
CM_ SG_ 896 FltOfFrntTurnIndcrRi "Light source failure (open load or short circuit) indication to driver, right front direction indicator.";
CM_ SG_ 896 FltOfReTurnIndcrLe "Light source failure (open load or short circuit) indication to driver, left rear direction indicator.";
CM_ SG_ 896 FltOfReTurnIndcrRi "Light source failure (open load or short circuit) indication to driver, right rear direction indicator.";
CM_ SG_ 896 HmiStrangerModMenuSetActvInActv "Whether stranger mode is activated or inactive for limit speed states";
CM_ SG_ 896 HmiStrangerModMenuSetPasswordSt "Represents password status,(PasswordSt No:No password set),(PasswordSt Yes: Password set)";
CM_ SG_ 896 HmiStrangerModMenuSetPrivateLockSt "Whether to associate a private lock:(SelectedSt No-Not associated),(SelectedSt Yes-Associated)";
CM_ SG_ 896 HmiStrangerModMenuSetSpdLim "Stranger mode limit speed set Km/h";
CM_ SG_ 896 HvBattChrgnPwrCns1 "Reports the Hv Battery actual power consumption as part of the HVEPM interface.";
CM_ SG_ 896 HvBattDchaTiEstimd "The estimated discharging time left and the signal maximum value indicates an invalid value.";
CM_ SG_ 896 HvBattIDc1 "Hv Battery current. Positive current is discharging the battery.";
CM_ SG_ 896 HvBattMismatchFlt "the fault of BMSH Battery Mismatching";
CM_ SG_ 896 HvBattPreHeatFaild "Hv Battery charging preheating failed due to small charging power of OBC.";
CM_ SG_ 896 LVPwrSplyErrSts "Low voltage power supply error status";
CM_ SG_ 896 MobileActvnStsID "Script ID";
CM_ SG_ 896 MobileActvnStsSts "Mobile active exterior light show status";
CM_ SG_ 896 PercOfFuLvlIndcn "Percentage of Fuel level indicated";
CM_ SG_ 896 PetModWarn "Pet mode warning for user";
CM_ SG_ 896 PosnBriefPosnLat "Latitude";
CM_ SG_ 896 PosnBriefPosnLgt "Longitude";
CM_ SG_ 896 PrkgCmftModTiCtrl "a Timer setting option for Parking Comfort Mode, Parking Comfort Mode means that vehicle will stay in Convenience mode for the set Timer";
CM_ SG_ 896 ScenarioMod "Scenario mode setting, for example rest mdoe, refresh etc.";
CM_ SG_ 896 SeatOccptAtRowSecDrSide2 "Describes if an occupant is detected in the  seat.";
CM_ SG_ 896 SeatOccptAtRowSecDrSideSnsSts2 "Informs if there is a fault on the driver seat sensor is detected through electrical measurements, or plausibility judgement. NotOk means sensor is judged as faulty. Di means that the sensor is not configured.";
CM_ SG_ 896 SeatOccptAtRowSecMid2 "Describes if an occupant is detected in the  seat.";
CM_ SG_ 896 SeatOccptAtRowSecMidSnsSts2 "Informs if there is a fault on the driver seat sensor is detected through electrical measurements, or plausibility judgement. NotOk means sensor is judged as faulty. Di means that the sensor is not configured.";
CM_ SG_ 896 SeatOccptAtRowSecPasSide2 "Describes if an occupant is detected in the  seat.";
CM_ SG_ 896 SeatOccptAtRowSecPasSideSnsSts2 "Informs if there is a fault on the driver seat sensor is detected through electrical measurements, or plausibility judgement. NotOk means sensor is judged as faulty. Di means that the sensor is not configured.";
CM_ SG_ 896 SeatOccptAtRowThrdLe2 "Describes if an occupant is detected in the  seat.";
CM_ SG_ 896 SeatOccptAtRowThrdLeSnsSts2 "Informs if there is a fault on the driver seat sensor is detected through electrical measurements, or plausibility judgement. NotOk means sensor is judged as faulty. Di means that the sensor is not configured.";
CM_ SG_ 896 SeatOccptAtRowThrdRi2 "Describes if an occupant is detected in the  seat.";
CM_ SG_ 896 SeatOccptAtRowThrdRiSnsSts2 "Informs if there is a fault on the driver seat sensor is detected through electrical measurements, or plausibility judgement. NotOk means sensor is judged as faulty. Di means that the sensor is not configured.";
CM_ SG_ 896 StrangerModeStateResp "App requests HMI to open or close Stranger mode, and HMI returns success, failure.";
CM_ SG_ 896 TotDstTrvld "Total driven distance (odometer), in km";
CM_ SG_ 896 VSTDFailToOpenToTelm "VSTD Fail To Open to Telematics";
CM_ SG_ 896 VstdModeSts "Vehicle Sentry and Theft Deterrence States";
CM_ SG_ 896 VSTDVideoUploadSts "The Status of VSTD Video(after Desensitization) Upload to TSP ";
CM_ SG_ 720 BattSocRaw "Battery State of charge from BMS";
CM_ SG_ 720 BattURaw "Battery Voltage From BMS";
CM_ SG_ 720 BltLockStAtRowSecLeBltLockEquid "State of belt lock at seating position at left of second row If the belt lock is equipped";
CM_ SG_ 720 BltLockStAtRowSecLeBltLockSt1 "State of belt lock at seating position at left of second row Belt lock state,  locked/unlocked";
CM_ SG_ 720 BltLockStAtRowSecLeBltLockSts "State of belt lock at seating position at left of second row Belt lock status, OK/NOK";
CM_ SG_ 720 BltLockStAtRowSecMidBltLockEquid "State of belt lock at seating position at middle of second row If the belt lock is equipped";
CM_ SG_ 720 BltLockStAtRowSecMidBltLockSt1 "State of belt lock at seating position at middle of second row Belt lock state,  locked/unlocked";
CM_ SG_ 720 BltLockStAtRowSecMidBltLockSts "State of belt lock at seating position at middle of second row Belt lock status, OK/NOK";
CM_ SG_ 720 BltLockStAtRowSecRiBltLockEquid "State of belt lock at seating position at right of second row If the belt lock is equipped";
CM_ SG_ 720 BltLockStAtRowSecRiBltLockSt1 "State of belt lock at seating position at right of second row Belt lock state,  locked/unlocked";
CM_ SG_ 720 BltLockStAtRowSecRiBltLockSts "State of belt lock at seating position at right of second row Belt lock status, OK/NOK";
CM_ SG_ 720 BltLockStAtRowThrdLeBltLockEquid "State of belt lock at seating position at left of third row If the belt lock is equipped";
CM_ SG_ 720 BltLockStAtRowThrdLeBltLockSt1 "State of belt lock at seating position at left of third row Belt lock state,  locked/unlocked";
CM_ SG_ 720 BltLockStAtRowThrdLeBltLockSts "State of belt lock at seating position at left of third row Belt lock status, OK/NOK";
CM_ SG_ 720 BltLockStAtRowThrdRiBltLockEquid "State of belt lock at seating position at right of third row If the belt lock is equipped";
CM_ SG_ 720 BltLockStAtRowThrdRiBltLockSt1 "State of belt lock at seating position at right of third row Belt lock state,  locked/unlocked";
CM_ SG_ 720 BltLockStAtRowThrdRiBltLockSts "State of belt lock at seating position at right of third row Belt lock status, OK/NOK";
CM_ SG_ 720 BookChrgnStsFb "Feedback status of bookcharging function during charging.";
CM_ SG_ 720 BookTrvlChrgnFb "ECM shall feedback the status of charing";
CM_ SG_ 720 BookTrvlChrgnSts "ECM shall feedback the status of bookcharing";
CM_ SG_ 720 DchaEgyAct "The OBC actual AC output discharging energy and which represents a discharge cycle.";
CM_ SG_ 720 DchaPwrAct "Acutual discharing power ";
CM_ SG_ 720 DchaStopReasonIndcn "Driver indication signal of discharging function stopped due to remaining energy reached.";
CM_ SG_ 720 DischrgPwrExceedWarn "Warning of excessive discharge power";
CM_ SG_ 720 DrvrSeatInAutMovmt "Driver Seat in Automatic Movement";
CM_ SG_ 720 DrvrSeatSnsrSts "Informs if there is a fault on the driver seat sensor is detected through electrical measurements, or plausibility judgement. NotOk means sensor is judged as faulty. Di means that the sensor is not configured.";
CM_ SG_ 720 DrvrSeatSts "Describes if an occupant is detected in the driver seat.";
CM_ SG_ 720 DstEstimdToEmptyForTarSoc1 "Predicted distance till empty in economic driving behavior from the target SOC 20";
CM_ SG_ 720 DstEstimdToEmptyForTarSoc2 "Predicted distance till empty in economic driving behavior from the target SOC 100";
CM_ SG_ 720 DstTrvldAct "Actual Total Travlled Distance after Last Reset, in km";
CM_ SG_ 720 EngCooltLvl "Engine coolant level in traditional car or hyvrid car. In EV vehicle, it represents the coolant level in electric drivetrain cooling circuit.";
CM_ SG_ 720 EpbLampReqChks "check sum";
CM_ SG_ 720 EpbLampReqCntr "counter";
CM_ SG_ 720 EpbLampReqEpbLampReq "E2E secured Epb request to display Red EPB tell tale.
Record has checksum and counter Epb lamp request
";
CM_ SG_ 720 ErsDelayTiCfm "response to Telematics when received the signal TelmEngDelayTi";
CM_ SG_ 720 ErsStrtApplSts "The primary state of the ERS application";
CM_ SG_ 720 ErsStrtRes "Result of the latest ErsOn cmd attempt or, if last ERS run was aborted, the reason for that abort";
CM_ SG_ 720 GearLvrIndcn "Gear lever indication (drivetrain position) to the driver. If drivetrain position is not possible to decide signal is set to undefined. Valid for automatic vehicles.
";
CM_ SG_ 720 HealthOfEngOil "Health of Engine Oil";
CM_ SG_ 720 HvCellTOverFlt "the fault of BMSH Over Temperature";
CM_ SG_ 720 NatUsgDayOfOil "Natural Using Days of Engine Oil after Last Reset";
CM_ SG_ 720 ObdAccrPedRat "PID 49 acording to SAE 1979DA";
CM_ SG_ 720 PasAcsInHmiReq "Set if car unlocks automatically when user walks in the car with key";
CM_ SG_ 720 PasAcsOutHmiReq "Set if car locks automatically when user leave the car with key";
CM_ SG_ 720 RemCtrlVehSts "remote control vehicle state";
CM_ SG_ 720 SeatOccptAtRowThrdMid "Occupant presence status at 3rd row ,  right position.";
CM_ SG_ 720 TotDstTrvldOfEng "Total Travlled Distance(Engine), in km";
CM_ SG_ 720 TotDstTrvldOfEV "Total Travlled Distance(EV), in km";
CM_ SG_ 720 WinFailrStsAtDrvr "Report failure if Window motor is not possible to Run";
CM_ SG_ 720 WinFailrStsAtReLe "Report failure if Window motor is not possible to Run";
CM_ SG_ 720 WshrFldTankStsToHMI "Information regarding if the washer fluid level is low.";
CM_ SG_ 160 BLEKeySearchReqKeyLocn "the zone of key search";
CM_ SG_ 160 BLEKeySearchReqTirgger "which triggered key search";
CM_ SG_ 160 BookTrvlFltSts "ECM shall send fault status to TCAM ";
CM_ SG_ 160 BookTrvlSetResponse "ECM shall feedback status when receives the request to enter book charging mode";
CM_ SG_ 160 BookTrvlTiSetReqBookTrvlChrgnTi "The charging time to target SOC";
CM_ SG_ 160 BookTrvlTiSetReqBookTrvlTiSetReq "ECM shall send the request to calculate charging initial time to TCAM";
CM_ SG_ 160 CrashSts2 "Information if a crash has been detected by SRS.";
CM_ SG_ 160 CrashStsSafeChks "Checksum for E2E";
CM_ SG_ 160 CrashStsSafeCntr "Counter for E2E";
CM_ SG_ 160 CrashStsSafeSts "Information if a crash has been detected by SRS.";
CM_ SG_ 160 DchaChrgnTarVal "DisCharging Target Value Setting";
CM_ SG_ 160 DigKeyDataToRemCtrlAcknowledgment "ACK";
CM_ SG_ 160 DigKeyDataToRemCtrlDKDataByte1 "Data";
CM_ SG_ 160 DigKeyDataToRemCtrlDKDataByte2 "Data";
CM_ SG_ 160 DigKeyDataToRemCtrlDKDataByte3 "Data";
CM_ SG_ 160 DigKeyDataToRemCtrlDKDataByte4 "Data";
CM_ SG_ 160 DigKeyDataToRemCtrlDKDataByte5 "Data";
CM_ SG_ 160 DigKeyDataToRemCtrlDKDataByte6 "Data";
CM_ SG_ 160 DigKeyDataToRemCtrlHeader "Header";
CM_ SG_ 160 DKDataFromCEMAcknowledgment "Packet received acknowledgement";
CM_ SG_ 160 DKDataFromCEMDKDataByte1 "Byte number 1";
CM_ SG_ 160 DKDataFromCEMDKDataByte2 "Byte number 2";
CM_ SG_ 160 DKDataFromCEMDKDataByte3 "Byte number 3";
CM_ SG_ 160 DKDataFromCEMDKDataByte4 "Byte number 4";
CM_ SG_ 160 DKDataFromCEMDKDataByte5 "Byte number 5";
CM_ SG_ 160 DKDataFromCEMDKDataByte6 "Byte number 6";
CM_ SG_ 160 DKDataFromCEMHeader "Packet Header";
CM_ SG_ 160 HmiResetTcamReq "Tcam reset request";
CM_ SG_ 160 LvngObjDetnWarn "The audio warning of the detection of leftovers";
CM_ SG_ 160 MobDevRCVSts "mobile device remote control vehicle state";
CM_ SG_ 160 MobDevRPAStsOnOff1 "undo button display on mobile device";
CM_ SG_ 160 MobDevRPAStsUInt8 "RPA status display on mobile device.";
CM_ SG_ 160 NFCAndBLEKeyDiReqData1 "data";
CM_ SG_ 160 NFCAndBLEKeyDiReqData10 "data";
CM_ SG_ 160 NFCAndBLEKeyDiReqData11 "data";
CM_ SG_ 160 NFCAndBLEKeyDiReqData12 "data";
CM_ SG_ 160 NFCAndBLEKeyDiReqData13 "data";
CM_ SG_ 160 NFCAndBLEKeyDiReqData14 "data";
CM_ SG_ 160 NFCAndBLEKeyDiReqData15 "data";
CM_ SG_ 160 NFCAndBLEKeyDiReqData16 "data";
CM_ SG_ 160 NFCAndBLEKeyDiReqData2 "data";
CM_ SG_ 160 NFCAndBLEKeyDiReqData3 "data";
CM_ SG_ 160 NFCAndBLEKeyDiReqData4 "data";
CM_ SG_ 160 NFCAndBLEKeyDiReqData5 "data";
CM_ SG_ 160 NFCAndBLEKeyDiReqData6 "data";
CM_ SG_ 160 NFCAndBLEKeyDiReqData7 "data";
CM_ SG_ 160 NFCAndBLEKeyDiReqData8 "data";
CM_ SG_ 160 NFCAndBLEKeyDiReqData9 "data";
CM_ SG_ 160 NFCKeySearchReqKeyLocn "the zone of key search ";
CM_ SG_ 160 NFCKeySearchReqTirgger "which triggered key search";
CM_ SG_ 160 PrkgCmftRunRmnReq "Parking Comfort Run Remind Request (will remind once when consumed 10%)";
CM_ SG_ 528 ApproachLiSetReq "this signal is used to set Approach light  for exterior  light systerm ";
CM_ SG_ 528 BrkLiOnReqChks "0: No request for brake light.
1: Brake light illumination shall be requested due to an autonomous brake intervention. Information about driver braking, by brake pedal, is NOT contained in this signal. Checksum for the record";
CM_ SG_ 528 BrkLiOnReqCntr "0: No request for brake light.
1: Brake light illumination shall be requested due to an autonomous brake intervention. Information about driver braking, by brake pedal, is NOT contained in this signal. Counter for the record";
CM_ SG_ 528 BrkLiOnReqSts "0: No request for brake light.
1: Brake light illumination shall be requested due to an autonomous brake intervention. Information about driver braking, by brake pedal, is NOT contained in this signal. Whether brake lights are requested or not. Default is not requested.";
CM_ SG_ 528 CarCfgInfoToWPC "inform WPC the car configuration informtion";
CM_ SG_ 528 DChrgStrtEngRes "Status of the Discharge Start of engine";
CM_ SG_ 528 DHUConnectionSts "DHU connection internet status";
CM_ SG_ 528 DstTrvldOfEng "Travlled Distance after Last Reset (Engine), in km";
CM_ SG_ 528 DstTrvldOfEV "Travlled Distance after Last Reset (EV), in km";
CM_ SG_ 528 ExtrLtgStsAFS "AFS status";
CM_ SG_ 528 ExtrLtgStsAHBC "AHBC Status";
CM_ SG_ 528 ExtrLtgStsAHL "AHL Status";
CM_ SG_ 528 ExtrLtgStsAllWL "All Weather Light Status";
CM_ SG_ 528 ExtrLtgStsApproach "Approach Light Status";
CM_ SG_ 528 ExtrLtgStsChks "Checksum";
CM_ SG_ 528 ExtrLtgStsCntr "Counter";
CM_ SG_ 528 ExtrLtgStsCornrgLi "Cornering Light Status";
CM_ SG_ 528 ExtrLtgStsDBL "DBL Stataus";
CM_ SG_ 528 ExtrLtgStsDRL "DRL Status";
CM_ SG_ 528 ExtrLtgStsFlash "Flash Light Status";
CM_ SG_ 528 ExtrLtgStsFrntFog "Front Fog Light Status";
CM_ SG_ 528 ExtrLtgStsGoodbye "Good Bye Light Status";
CM_ SG_ 528 ExtrLtgStsHiBeam "Hi Beam Status";
CM_ SG_ 528 ExtrLtgStsHomeSafe "Home Safe Light Status";
CM_ SG_ 528 ExtrLtgStsHWL "HWL Status";
CM_ SG_ 528 ExtrLtgStsLoBeam "Low Beam Status";
CM_ SG_ 528 ExtrLtgStsLtgShow "Light Show Status";
CM_ SG_ 528 ExtrLtgStsPosLiFrnt "Position Light Front Status";
CM_ SG_ 528 ExtrLtgStsPosLiRe "Position Light Rear Status";
CM_ SG_ 528 ExtrLtgStsReFog "Rear Fog Light Status";
CM_ SG_ 528 ExtrLtgStsReverseLi "Reverse Light Status";
CM_ SG_ 528 ExtrLtgStsStopLi "Stop Light Status";
CM_ SG_ 528 ExtrLtgStsTurnIndrLe "Turn Indicator Left Status";
CM_ SG_ 528 ExtrLtgStsTurnIndrRi "Turn Indicator Right Status
";
CM_ SG_ 528 ExtrLtgStsWelcome "Welcome Light Status";
CM_ SG_ 528 IndcrSts "Provides the state and not the event of HWL/Direction Indicator.";
CM_ SG_ 528 MobDevRCVReqResp "mobile device remote control vehicle request response";
CM_ SG_ 528 OnBdChrgrRdyTi "The charging ready time";
CM_ SG_ 528 PassMidSeatSts "Occupation status based on occupant detection sensor at front row middle seat. ";
CM_ SG_ 528 PinionSteerAgGroupChks "Checksum for PinionSteerAgGroup";
CM_ SG_ 528 PinionSteerAgGroupCntr "Counter for PinionSteerAgGroup";
CM_ SG_ 528 PinionSteerAgGroupPinionSteerAg1 "Calculated pinion steer angle at the front steering device";
CM_ SG_ 528 PinionSteerAgGroupPinionSteerAg1Qf "Quality factor for PinionSteerAg1";
CM_ SG_ 528 PinionSteerAgGroupPinionSteerAgSpd1 "Calculated pinion steer angle speed at the front steering device ";
CM_ SG_ 528 PinionSteerAgGroupPinionSteerAgSpd1Qf "Quality factor for PinionSteerAgSpd1";
CM_ SG_ 528 PinionSteerAgGroupSteerWhlTq "Torque on steering wheel";
CM_ SG_ 528 PinionSteerAgGroupSteerWhlTqQf "Quality factor for SteerWhlTq";
CM_ SG_ 528 RCVModIncln "remote control vehicle mode Inclination";
CM_ SG_ 528 RestrntSysLampReq "Indication request for SRS faults.";
CM_ SG_ 528 RlyPwrDistbnCmd1WdPreBattSaveCmd "Prewarning that BttrySaver relay will be shut off. the value changes to 1, 30 sec prior the shut off";
CM_ SG_ 528 SeatOccptAtRowFrthLe "Occupation status based on occupant detection sensor at the 4th row outer left seat. ";
CM_ SG_ 528 SeatOccptAtRowFrthMid "Occupation status based on occupant detection sensor at the 4th middle seat. ";
CM_ SG_ 528 SeatOccptAtRowFrthRi "Occupation status based on occupant detection sensor at the 4th row outer right seat. ";
CM_ SG_ 528 TiAndDateIndcnDataValid "Current time (Hr, Min and Sec) and date (Year, Months and days) data for indication. See requirement for more information about the signals. Signal qualifier, No means values should be ignored.";
CM_ SG_ 528 TiAndDateIndcnDay "Current time (Hr, Min and Sec) and date (Year, Months and days) data for indication. See requirement for more information about the signals. Day";
CM_ SG_ 528 TiAndDateIndcnHr1 "Current time (Hr, Min and Sec) and date (Year, Months and days) data for indication. See requirement for more information about the signals. Hour";
CM_ SG_ 528 TiAndDateIndcnMins1 "Current time (Hr, Min and Sec) and date (Year, Months and days) data for indication. See requirement for more information about the signals. Minutes";
CM_ SG_ 528 TiAndDateIndcnMth1 "Current time (Hr, Min and Sec) and date (Year, Months and days) data for indication. See requirement for more information about the signals. Month, 1-12";
CM_ SG_ 528 TiAndDateIndcnSec1 "Current time (Hr, Min and Sec) and date (Year, Months and days) data for indication. See requirement for more information about the signals. Seconds";
CM_ SG_ 528 TiAndDateIndcnYr1 "Current time (Hr, Min and Sec) and date (Year, Months and days) data for indication. See requirement for more information about the signals. Year, 0-99";
CM_ SG_ 528 VehNotifAndLedFltStsByte0 "Vehicle notification and led fault status,Group ID(1-7)";
CM_ SG_ 528 VehNotifAndLedFltStsByte1 "Vehicle notification and led fault status,Fault ID(1-56):Eaceh Bit Value=0(Normal) Value=1(Fault)";
CM_ SG_ 528 VehNotifAndLedFltStsByte2 "Vehicle notification and led fault status,Fault ID(57-122):Eaceh Bit Value=0(Normal) Value=1(Fault)";
CM_ SG_ 528 VehNotifAndLedFltStsByte3 "Vehicle notification and led fault status,Fault ID(169-244):Eaceh Bit Value=0(Normal) Value=1(Fault)";
CM_ SG_ 528 VehNotifAndLedFltStsByte4 "Vehicle notification and led fault status,Fault ID(225-280):Eaceh Bit Value=0(Normal) Value=1(Fault)";
CM_ SG_ 528 VehNotifAndLedFltStsByte5 "Vehicle notification and led fault status,Fault ID(281-336):Eaceh Bit Value=0(Normal) Value=1(Fault)";
CM_ SG_ 528 VehNotifAndLedFltStsByte6 "Vehicle notification and led fault status,Fault ID(337-392):Eaceh Bit Value=0(Normal) Value=1(Fault)";
CM_ SG_ 528 VehNotifAndLedFltStsByte7 "Vehicle notification and led fault status,Fault ID(393-448):Eaceh Bit Value=0(Normal) Value=1(Fault)";
CM_ SG_ 528 VehSpdLgtA "Vehicle speed longitudinal based on wheel speed sensors and longitudinal acceleration.";
CM_ SG_ 528 VehSpdLgtChks "Checksum";
CM_ SG_ 528 VehSpdLgtCntr "Counter";
CM_ SG_ 528 VehSpdLgtQf "Quality factor for vehicle speed as measured by wheel speed sensors and longitudinal acceleration.";

BA_DEF_  "BaudRateCANFD" FLOAT 1000 10000000;
BA_DEF_  "Baudrate" INT 1000 1000000;
BA_DEF_  "BusType" STRING;
BA_DEF_  "DBName" STRING;
BA_DEF_  "ProtocolType" STRING;
BA_DEF_ BU_ "NmAsrNode" ENUM "No","Yes";
BA_DEF_ BU_ "NmAsrNodeIdentifier" INT 0 255;
BA_DEF_ BO_ "CANFD_BRS" ENUM "0","1";
BA_DEF_ BO_ "GenMsgCycleTime" INT 0 65536;
BA_DEF_ BO_ "GenMsgDelayTime" INT 0 65536;
BA_DEF_ BO_ "GenMsgSendType" ENUM "cyclic", "spontaneous", "not-used", "not-used", "not-used", "cyclicAndSpontaneous", "not-used", "cyclicIfActive", "NoMsgSendType";
BA_DEF_ BO_ "GenMsgStartDelayTime" INT 0 65536;
BA_DEF_ BO_ "VFrameFormat" ENUM "StandardCAN","ExtendedCAN","reserved","J1939PG","reserved","reserved","reserved","reserved","reserved","reserved","reserved","reserved","reserved","reserved","StandardCAN_FD","ExtendedCAN_FD";
BA_DEF_ SG_ "GenSigSendType" ENUM "Cyclic","OnWrite","OnWriteWithRepetition","OnChange","OnChangeWithRepetition","IfActive","IfActiveWithRepetition","NoSigSendType";
BA_DEF_ SG_ "GenSigStartValue" HEX 0 80000000;
BA_DEF_ BO_ "GenMsgILSupport" ENUM "No","Yes";
BA_DEF_ BO_ "NmAsrMessage" ENUM "No","Yes";
BA_DEF_  "NmAsrBaseAddress" HEX 0 536870911;
BA_DEF_  "NmAsrMessageCount" INT 0 255;
BA_DEF_ BU_ "NodeLayerModules" STRING;
BA_DEF_ BU_ "ILused" ENUM "No","Yes";
BA_DEF_ SG_ "GenSigFuncType" ENUM "NoFunction","n/a","n/a","n/a","n/a","n/a","n/a","n/a","n/a","n/a","n/a","n/a","n/a","n/a","n/a","CHK","CNTR","n/a","n/a","n/a","CNTR_AR_01","CRC_AR_01_BOTH","CRC_AR_01_ALT","CRC_AR_01_LOW","CRC_AR_01_NIBBLE","CNTR_AR_04","CRC_AR_04A","CNTR_AR_05","CRC_AR_05";
BA_DEF_ SG_ "GenSigDataID" STRING;
BA_DEF_ SG_ "SigGroup" STRING;

BA_DEF_DEF_ "BusType" "";
BA_DEF_DEF_ "DBName" "";
BA_DEF_DEF_ "ProtocolType" "";
BA_DEF_DEF_ "NmAsrNode" "No";
BA_DEF_DEF_ "NmAsrNodeIdentifier" 0;
BA_DEF_DEF_ "CANFD_BRS" "1";
BA_DEF_DEF_ "GenSigStartValue" 0;
BA_DEF_DEF_ "VFrameFormat" "J1939PG";
BA_DEF_DEF_ "GenSigSendType" "NoSigSendType";
BA_DEF_DEF_ "GenMsgCycleTime" 0;
BA_DEF_DEF_ "GenMsgDelayTime" 0;
BA_DEF_DEF_ "GenMsgStartDelayTime" 0;
BA_DEF_DEF_ "GenMsgSendType" "NoMsgSendType";
BA_DEF_DEF_ "GenMsgILSupport" "Yes";
BA_DEF_DEF_ "NmAsrMessage" "No";
BA_DEF_DEF_ "NmAsrBaseAddress" 1280;
BA_DEF_DEF_ "NmAsrMessageCount" 64;
BA_DEF_DEF_ "NodeLayerModules" "CANoeILNLSPA.dll";
BA_DEF_DEF_ "ILused" "Yes";
BA_DEF_DEF_ "GenSigFuncType" "NoFunction";
BA_DEF_DEF_ "GenSigDataID" "";
BA_DEF_DEF_ "SigGroup" "";

BA_ "BaudRateCANFD" 2000000;
BA_ "Baudrate" 500000;
BA_ "BusType" "CAN FD";
BA_ "DBName" "ConnectivityCANFD";
BA_ "ProtocolType" "CAN";

BA_ "ILused" BU_ ETC 0;

BA_ "NmAsrNode" BU_ IHU 1;
BA_ "NmAsrNodeIdentifier" BU_ IHU 1;
BA_ "NodeLayerModules" BU_ IHU "CANoeILNLSPA.dll,AsrNM33.dll";

BA_ "NmAsrNode" BU_ TCAM 1;
BA_ "NmAsrNodeIdentifier" BU_ TCAM 9;
BA_ "NodeLayerModules" BU_ TCAM "CANoeILNLSPA.dll,AsrNM33.dll";

BA_ "GenMsgCycleTime" BO_ 960 400.000;
BA_ "GenMsgSendType" BO_ 960 0;
BA_ "VFrameFormat" BO_ 960 14;

BA_ "GenMsgCycleTime" BO_ 384 40.000;
BA_ "GenMsgSendType" BO_ 384 0;
BA_ "VFrameFormat" BO_ 384 14;

BA_ "GenMsgCycleTime" BO_ 896 250.000;
BA_ "GenMsgSendType" BO_ 896 0;
BA_ "VFrameFormat" BO_ 896 14;

BA_ "GenMsgCycleTime" BO_ 720 100.000;
BA_ "GenMsgSendType" BO_ 720 0;
BA_ "VFrameFormat" BO_ 720 14;

BA_ "GenMsgDelayTime" BO_ 160 10.000;
BA_ "GenMsgSendType" BO_ 160 1;
BA_ "VFrameFormat" BO_ 160 14;

BA_ "GenMsgCycleTime" BO_ 528 60.000;
BA_ "GenMsgSendType" BO_ 528 0;
BA_ "VFrameFormat" BO_ 528 14;
BA_ "GenSigSendType" SG_ 960 AccrPedlRatAccrPedlRat 0;
BA_ "GenSigDataID" SG_ 960 AccrPedlRatChks "0x364";
BA_ "GenSigFuncType" SG_ 960 AccrPedlRatChks 15;
BA_ "GenSigSendType" SG_ 960 AccrPedlRatChks 0;
BA_ "GenSigFuncType" SG_ 960 AccrPedlRatCntr 16;
BA_ "GenSigSendType" SG_ 960 AccrPedlRatCntr 0;
BA_ "GenSigSendType" SG_ 384 AlrmStsAlrmFailr 0;
BA_ "GenSigSendType" SG_ 384 AlrmStsAlrmSt 0;
BA_ "GenSigSendType" SG_ 384 AlrmStsAlrmTrgSrc 0;
BA_ "GenSigSendType" SG_ 384 AlrmStsSnsrInclnFailr 0;
BA_ "GenSigSendType" SG_ 384 AlrmStsSnsrIntrScanrFailr 0;
BA_ "GenSigSendType" SG_ 384 AmbTEstimdAmbTEstimd 0;
BA_ "GenSigStartValue" SG_ 384 AmbTEstimdAmbTEstimd 700;
BA_ "GenSigSendType" SG_ 384 AmbTEstimdQf 0;
BA_ "GenSigSendType" SG_ 960 AmbTIndcdWithUnitAmbTIndcd 0;
BA_ "GenSigStartValue" SG_ 960 AmbTIndcdWithUnitAmbTIndcd 1000;
BA_ "GenSigSendType" SG_ 960 AmbTIndcdWithUnitAmbTIndcdUnit 0;
BA_ "GenSigSendType" SG_ 960 AmbTIndcdWithUnitQF 0;
BA_ "GenSigSendType" SG_ 896 AntithftActvnNotif 0;
BA_ "GenSigSendType" SG_ 528 ApproachLiSetReq 0;
BA_ "GenSigSendType" SG_ 160 BLEKeySearchReqKeyLocn 1;
BA_ "GenSigSendType" SG_ 160 BLEKeySearchReqTirgger 1;
BA_ "GenSigSendType" SG_ 384 BattFltStsPrimBattFltStsPrm 0;
BA_ "GenSigDataID" SG_ 384 BattFltStsPrimChks "0x1784";
BA_ "GenSigFuncType" SG_ 384 BattFltStsPrimChks 15;
BA_ "GenSigSendType" SG_ 384 BattFltStsPrimChks 0;
BA_ "GenSigFuncType" SG_ 384 BattFltStsPrimCntr 16;
BA_ "GenSigSendType" SG_ 384 BattFltStsPrimCntr 0;
BA_ "GenSigSendType" SG_ 720 BattSocRaw 0;
BA_ "GenSigSendType" SG_ 720 BattURaw 0;
BA_ "GenSigSendType" SG_ 960 BkpOfDstTrvld 0;
BA_ "GenSigSendType" SG_ 960 BkpOfDstTrvldHiResl 0;
BA_ "GenSigSendType" SG_ 384 BltLockStAtDrvrBltLockSt1 0;
BA_ "GenSigStartValue" SG_ 384 BltLockStAtDrvrBltLockSt1 1;
BA_ "GenSigSendType" SG_ 384 BltLockStAtDrvrBltLockSts 0;
BA_ "GenSigSendType" SG_ 384 BltLockStAtPassBltLockSt1 0;
BA_ "GenSigStartValue" SG_ 384 BltLockStAtPassBltLockSt1 1;
BA_ "GenSigSendType" SG_ 384 BltLockStAtPassBltLockSts 0;
BA_ "GenSigSendType" SG_ 720 BltLockStAtRowSecLeBltLockEquid 0;
BA_ "GenSigStartValue" SG_ 720 BltLockStAtRowSecLeBltLockEquid 1;
BA_ "GenSigSendType" SG_ 720 BltLockStAtRowSecLeBltLockSt1 0;
BA_ "GenSigSendType" SG_ 720 BltLockStAtRowSecLeBltLockSts 0;
BA_ "GenSigStartValue" SG_ 720 BltLockStAtRowSecLeBltLockSts 1;
BA_ "GenSigSendType" SG_ 720 BltLockStAtRowSecMidBltLockEquid 0;
BA_ "GenSigStartValue" SG_ 720 BltLockStAtRowSecMidBltLockEquid 1;
BA_ "GenSigSendType" SG_ 720 BltLockStAtRowSecMidBltLockSt1 0;
BA_ "GenSigSendType" SG_ 720 BltLockStAtRowSecMidBltLockSts 0;
BA_ "GenSigStartValue" SG_ 720 BltLockStAtRowSecMidBltLockSts 1;
BA_ "GenSigSendType" SG_ 720 BltLockStAtRowSecRiBltLockEquid 0;
BA_ "GenSigStartValue" SG_ 720 BltLockStAtRowSecRiBltLockEquid 1;
BA_ "GenSigSendType" SG_ 720 BltLockStAtRowSecRiBltLockSt1 0;
BA_ "GenSigSendType" SG_ 720 BltLockStAtRowSecRiBltLockSts 0;
BA_ "GenSigStartValue" SG_ 720 BltLockStAtRowSecRiBltLockSts 1;
BA_ "GenSigSendType" SG_ 720 BltLockStAtRowThrdLeBltLockEquid 0;
BA_ "GenSigStartValue" SG_ 720 BltLockStAtRowThrdLeBltLockEquid 1;
BA_ "GenSigSendType" SG_ 720 BltLockStAtRowThrdLeBltLockSt1 0;
BA_ "GenSigSendType" SG_ 720 BltLockStAtRowThrdLeBltLockSts 0;
BA_ "GenSigStartValue" SG_ 720 BltLockStAtRowThrdLeBltLockSts 1;
BA_ "GenSigSendType" SG_ 720 BltLockStAtRowThrdRiBltLockEquid 0;
BA_ "GenSigStartValue" SG_ 720 BltLockStAtRowThrdRiBltLockEquid 1;
BA_ "GenSigSendType" SG_ 720 BltLockStAtRowThrdRiBltLockSt1 0;
BA_ "GenSigSendType" SG_ 720 BltLockStAtRowThrdRiBltLockSts 0;
BA_ "GenSigStartValue" SG_ 720 BltLockStAtRowThrdRiBltLockSts 1;
BA_ "GenSigSendType" SG_ 720 BookChrgnStsFb 0;
BA_ "GenSigSendType" SG_ 720 BookTrvlChrgnFb 0;
BA_ "GenSigSendType" SG_ 720 BookTrvlChrgnSts 0;
BA_ "GenSigSendType" SG_ 160 BookTrvlFltSts 1;
BA_ "GenSigSendType" SG_ 160 BookTrvlSetResponse 1;
BA_ "GenSigSendType" SG_ 160 BookTrvlTiSetReqBookTrvlChrgnTi 1;
BA_ "GenSigStartValue" SG_ 160 BookTrvlTiSetReqBookTrvlChrgnTi 2047;
BA_ "GenSigSendType" SG_ 160 BookTrvlTiSetReqBookTrvlTiSetReq 1;
BA_ "GenSigSendType" SG_ 960 BrkFldLvl 0;
BA_ "GenSigSendType" SG_ 960 BrkFricTqTotAtWhlsActBrkFricTqTotAtWhlsAct 0;
BA_ "GenSigDataID" SG_ 960 BrkFricTqTotAtWhlsActChks "0x7B";
BA_ "GenSigFuncType" SG_ 960 BrkFricTqTotAtWhlsActChks 15;
BA_ "GenSigSendType" SG_ 960 BrkFricTqTotAtWhlsActChks 0;
BA_ "GenSigFuncType" SG_ 960 BrkFricTqTotAtWhlsActCntr 16;
BA_ "GenSigSendType" SG_ 960 BrkFricTqTotAtWhlsActCntr 0;
BA_ "GenSigDataID" SG_ 528 BrkLiOnReqChks "0x49";
BA_ "GenSigFuncType" SG_ 528 BrkLiOnReqChks 15;
BA_ "GenSigSendType" SG_ 528 BrkLiOnReqChks 0;
BA_ "GenSigFuncType" SG_ 528 BrkLiOnReqCntr 16;
BA_ "GenSigSendType" SG_ 528 BrkLiOnReqCntr 0;
BA_ "GenSigSendType" SG_ 528 BrkLiOnReqSts 0;
BA_ "GenSigSendType" SG_ 960 BrkPedlPsdBrkPedlNotPsdSafe 0;
BA_ "GenSigSendType" SG_ 960 BrkPedlPsdBrkPedlPsd 0;
BA_ "GenSigDataID" SG_ 960 BrkPedlPsdChks "0x38";
BA_ "GenSigFuncType" SG_ 960 BrkPedlPsdChks 15;
BA_ "GenSigSendType" SG_ 960 BrkPedlPsdChks 0;
BA_ "GenSigFuncType" SG_ 960 BrkPedlPsdCntr 16;
BA_ "GenSigSendType" SG_ 960 BrkPedlPsdCntr 0;
BA_ "GenSigSendType" SG_ 960 BrkPedlPsdQf 0;
BA_ "GenSigSendType" SG_ 960 BrkPedlTrvlAct 0;
BA_ "GenSigStartValue" SG_ 960 BrkPedlTrvlAct 500;
BA_ "GenSigDataID" SG_ 960 BrkPedlTrvlChks "0xB3";
BA_ "GenSigFuncType" SG_ 960 BrkPedlTrvlChks 15;
BA_ "GenSigSendType" SG_ 960 BrkPedlTrvlChks 0;
BA_ "GenSigStartValue" SG_ 960 BrkPedlTrvlChks 255;
BA_ "GenSigFuncType" SG_ 960 BrkPedlTrvlCntr 16;
BA_ "GenSigSendType" SG_ 960 BrkPedlTrvlCntr 0;
BA_ "GenSigSendType" SG_ 960 BrkPedlTrvlQf 0;
BA_ "GenSigStartValue" SG_ 960 BrkPedlTrvlQf 1;
BA_ "GenSigSendType" SG_ 960 BrkPedlTrvlSt 0;
BA_ "GenSigSendType" SG_ 960 BrkPedlTrvlStQf 0;
BA_ "GenSigStartValue" SG_ 960 BrkPedlTrvlStQf 1;
BA_ "GenSigSendType" SG_ 960 BrkPedlTrvlTar 0;
BA_ "GenSigStartValue" SG_ 960 BrkPedlTrvlTar 500;
BA_ "GenSigSendType" SG_ 960 BrkPedlrRatPerc 0;
BA_ "GenSigSendType" SG_ 960 BrkPedlrRatQf 0;
BA_ "GenSigSendType" SG_ 896 CampMod 0;
BA_ "GenSigSendType" SG_ 896 CampModSocLowRmn 0;
BA_ "GenSigSendType" SG_ 528 CarCfgInfoToWPC 0;
BA_ "GenSigSendType" SG_ 896 ChrgLidAcSts 0;
BA_ "GenSigSendType" SG_ 896 ChrgLidDCorAcDcSts 0;
BA_ "GenSigSendType" SG_ 896 ChrgnOrDisChrgnStsFb 0;
BA_ "GenSigSendType" SG_ 896 ChrgnSts 0;
BA_ "GenSigStartValue" SG_ 896 ChrgnSts 3;
BA_ "GenSigSendType" SG_ 384 CmptmtAirTEstimdExtdComptmtT 0;
BA_ "GenSigStartValue" SG_ 384 CmptmtAirTEstimdExtdComptmtT 600;
BA_ "GenSigSendType" SG_ 384 CmptmtAirTEstimdExtdQlyFlg 0;
BA_ "GenSigSendType" SG_ 896 CmptmtTFrntCmptmtTFrnt 0;
BA_ "GenSigStartValue" SG_ 896 CmptmtTFrntCmptmtTFrnt 600;
BA_ "GenSigSendType" SG_ 896 CmptmtTFrntFanForCmptmtTRunng 0;
BA_ "GenSigSendType" SG_ 896 CmptmtTFrntQf 0;
BA_ "GenSigStartValue" SG_ 896 CmptmtTFrntQf 1;
BA_ "GenSigSendType" SG_ 960 CnclFaceReqGid1Byte0 0;
BA_ "GenSigStartValue" SG_ 960 CnclFaceReqGid1Byte0 32;
BA_ "GenSigSendType" SG_ 960 CnclFaceReqGid1Byte1 0;
BA_ "GenSigStartValue" SG_ 960 CnclFaceReqGid1Byte1 32;
BA_ "GenSigSendType" SG_ 960 CnclFaceReqGid1Byte2 0;
BA_ "GenSigStartValue" SG_ 960 CnclFaceReqGid1Byte2 32;
BA_ "GenSigSendType" SG_ 960 CnclFaceReqGid1Byte3 0;
BA_ "GenSigStartValue" SG_ 960 CnclFaceReqGid1Byte3 32;
BA_ "GenSigSendType" SG_ 960 CnclFaceReqGid1Byte4 0;
BA_ "GenSigStartValue" SG_ 960 CnclFaceReqGid1Byte4 32;
BA_ "GenSigSendType" SG_ 960 CnclFaceReqGid1Byte5 0;
BA_ "GenSigStartValue" SG_ 960 CnclFaceReqGid1Byte5 32;
BA_ "GenSigSendType" SG_ 960 CnclFaceReqGid1Byte6 0;
BA_ "GenSigStartValue" SG_ 960 CnclFaceReqGid1Byte6 32;
BA_ "GenSigSendType" SG_ 960 CnclFaceReqGid1Byte7 0;
BA_ "GenSigStartValue" SG_ 960 CnclFaceReqGid1Byte7 32;
BA_ "GenSigSendType" SG_ 960 CnclFaceReqGid2Byte0 0;
BA_ "GenSigStartValue" SG_ 960 CnclFaceReqGid2Byte0 32;
BA_ "GenSigSendType" SG_ 960 CnclFaceReqGid2Byte1 0;
BA_ "GenSigStartValue" SG_ 960 CnclFaceReqGid2Byte1 32;
BA_ "GenSigSendType" SG_ 960 CnclFaceReqGid2Byte2 0;
BA_ "GenSigStartValue" SG_ 960 CnclFaceReqGid2Byte2 32;
BA_ "GenSigSendType" SG_ 960 CnclFaceReqGid2Byte3 0;
BA_ "GenSigStartValue" SG_ 960 CnclFaceReqGid2Byte3 32;
BA_ "GenSigSendType" SG_ 960 CnclFaceReqGid2Byte4 0;
BA_ "GenSigStartValue" SG_ 960 CnclFaceReqGid2Byte4 32;
BA_ "GenSigSendType" SG_ 960 CnclFaceReqGid2Byte5 0;
BA_ "GenSigStartValue" SG_ 960 CnclFaceReqGid2Byte5 32;
BA_ "GenSigSendType" SG_ 960 CnclFaceReqGid2Byte6 0;
BA_ "GenSigStartValue" SG_ 960 CnclFaceReqGid2Byte6 32;
BA_ "GenSigSendType" SG_ 960 CnclFaceReqGid2Byte7 0;
BA_ "GenSigStartValue" SG_ 960 CnclFaceReqGid2Byte7 32;
BA_ "GenSigSendType" SG_ 160 CrashSts2 1;
BA_ "GenSigDataID" SG_ 160 CrashStsSafeChks "0x40B";
BA_ "GenSigFuncType" SG_ 160 CrashStsSafeChks 15;
BA_ "GenSigSendType" SG_ 160 CrashStsSafeChks 1;
BA_ "GenSigStartValue" SG_ 160 CrashStsSafeChks 255;
BA_ "GenSigFuncType" SG_ 160 CrashStsSafeCntr 16;
BA_ "GenSigSendType" SG_ 160 CrashStsSafeCntr 1;
BA_ "GenSigSendType" SG_ 160 CrashStsSafeSts 1;
BA_ "GenSigSendType" SG_ 960 DCChrgnHndlSts 0;
BA_ "GenSigSendType" SG_ 528 DChrgStrtEngRes 0;
BA_ "GenSigSendType" SG_ 528 DHUConnectionSts 0;
BA_ "GenSigSendType" SG_ 160 DKDataFromCEMAcknowledgment 1;
BA_ "GenSigSendType" SG_ 160 DKDataFromCEMDKDataByte1 1;
BA_ "GenSigSendType" SG_ 160 DKDataFromCEMDKDataByte2 1;
BA_ "GenSigSendType" SG_ 160 DKDataFromCEMDKDataByte3 1;
BA_ "GenSigSendType" SG_ 160 DKDataFromCEMDKDataByte4 1;
BA_ "GenSigSendType" SG_ 160 DKDataFromCEMDKDataByte5 1;
BA_ "GenSigSendType" SG_ 160 DKDataFromCEMDKDataByte6 1;
BA_ "GenSigSendType" SG_ 160 DKDataFromCEMHeader 1;
BA_ "GenSigSendType" SG_ 960 DayToSrv 0;
BA_ "GenSigSendType" SG_ 960 DcDcActvd 0;
BA_ "GenSigSendType" SG_ 160 DchaChrgnTarVal 1;
BA_ "GenSigSendType" SG_ 720 DchaEgyAct 0;
BA_ "GenSigSendType" SG_ 896 DchaIAct 0;
BA_ "GenSigSendType" SG_ 720 DchaPwrAct 0;
BA_ "GenSigSendType" SG_ 720 DchaStopReasonIndcn 0;
BA_ "GenSigSendType" SG_ 896 DchaUAct 0;
BA_ "GenSigSendType" SG_ 160 DigKeyDataToRemCtrlAcknowledgment 1;
BA_ "GenSigSendType" SG_ 160 DigKeyDataToRemCtrlDKDataByte1 1;
BA_ "GenSigSendType" SG_ 160 DigKeyDataToRemCtrlDKDataByte2 1;
BA_ "GenSigSendType" SG_ 160 DigKeyDataToRemCtrlDKDataByte3 1;
BA_ "GenSigSendType" SG_ 160 DigKeyDataToRemCtrlDKDataByte4 1;
BA_ "GenSigSendType" SG_ 160 DigKeyDataToRemCtrlDKDataByte5 1;
BA_ "GenSigSendType" SG_ 160 DigKeyDataToRemCtrlDKDataByte6 1;
BA_ "GenSigSendType" SG_ 160 DigKeyDataToRemCtrlHeader 1;
BA_ "GenSigSendType" SG_ 384 DigKeyPasEntryDiSts 0;
BA_ "GenSigSendType" SG_ 720 DischrgPwrExceedWarn 0;
BA_ "GenSigSendType" SG_ 960 DispBattEgyIn 0;
BA_ "GenSigSendType" SG_ 960 DispBattEgyOut 0;
BA_ "GenSigSendType" SG_ 960 DispHvBattLvlOfChrg 0;
BA_ "GenSigSendType" SG_ 384 DlyClsActv 0;
BA_ "GenSigSendType" SG_ 720 DrvrSeatInAutMovmt 0;
BA_ "GenSigSendType" SG_ 720 DrvrSeatSnsrSts 0;
BA_ "GenSigSendType" SG_ 720 DrvrSeatSts 0;
BA_ "GenSigStartValue" SG_ 720 DrvrSeatSts 1;
BA_ "GenSigSendType" SG_ 896 DstEstimdToEmptyForDrvgElec 0;
BA_ "GenSigSendType" SG_ 960 DstEstimdToEmptyForDrvgElecIndcdDstToEmpty 0;
BA_ "SigGroup" SG_ 960 DstEstimdToEmptyForDrvgElecIndcdDstToEmpty "DstEstimdToEmptyForDrvgElecIndcd";
BA_ "GenSigSendType" SG_ 960 DstEstimdToEmptyForDrvgElecIndcdDstUnit 0;
BA_ "SigGroup" SG_ 960 DstEstimdToEmptyForDrvgElecIndcdDstUnit "DstEstimdToEmptyForDrvgElecIndcd";
BA_ "GenSigSendType" SG_ 720 DstEstimdToEmptyForTarSoc1 0;
BA_ "GenSigSendType" SG_ 720 DstEstimdToEmptyForTarSoc2 0;
BA_ "GenSigSendType" SG_ 960 DstToEmptyIndcdDstToEmpty 0;
BA_ "GenSigSendType" SG_ 960 DstToEmptyIndcdDstUnit 0;
BA_ "GenSigSendType" SG_ 960 DstToSrv 0;
BA_ "GenSigSendType" SG_ 960 DstTrvld1 0;
BA_ "GenSigSendType" SG_ 960 DstTrvld2 0;
BA_ "GenSigSendType" SG_ 896 EcoClimaSts 0;
BA_ "GenSigSendType" SG_ 720 EngCooltLvl 0;
BA_ "GenSigDataID" SG_ 896 EngSt1WdStsChks "0x89";
BA_ "GenSigFuncType" SG_ 896 EngSt1WdStsChks 15;
BA_ "GenSigSendType" SG_ 896 EngSt1WdStsChks 0;
BA_ "GenSigFuncType" SG_ 896 EngSt1WdStsCntr 16;
BA_ "GenSigSendType" SG_ 896 EngSt1WdStsCntr 0;
BA_ "GenSigSendType" SG_ 896 EngSt1WdStsEngSt1WdSts 0;
BA_ "GenSigDataID" SG_ 720 EpbLampReqChks "0x55";
BA_ "GenSigFuncType" SG_ 720 EpbLampReqChks 15;
BA_ "GenSigSendType" SG_ 720 EpbLampReqChks 0;
BA_ "GenSigFuncType" SG_ 720 EpbLampReqCntr 16;
BA_ "GenSigSendType" SG_ 720 EpbLampReqCntr 0;
BA_ "GenSigSendType" SG_ 720 EpbLampReqEpbLampReq 0;
BA_ "GenSigSendType" SG_ 720 ErsDelayTiCfm 0;
BA_ "GenSigSendType" SG_ 720 ErsStrtApplSts 0;
BA_ "GenSigSendType" SG_ 720 ErsStrtRes 0;
BA_ "GenSigSendType" SG_ 528 ExtrLtgStsAFS 0;
BA_ "GenSigSendType" SG_ 528 ExtrLtgStsAHBC 0;
BA_ "GenSigSendType" SG_ 528 ExtrLtgStsAHL 0;
BA_ "GenSigSendType" SG_ 528 ExtrLtgStsAllWL 0;
BA_ "GenSigSendType" SG_ 528 ExtrLtgStsApproach 0;
BA_ "GenSigDataID" SG_ 528 ExtrLtgStsChks "0x44C";
BA_ "GenSigFuncType" SG_ 528 ExtrLtgStsChks 15;
BA_ "GenSigSendType" SG_ 528 ExtrLtgStsChks 0;
BA_ "GenSigFuncType" SG_ 528 ExtrLtgStsCntr 16;
BA_ "GenSigSendType" SG_ 528 ExtrLtgStsCntr 0;
BA_ "GenSigSendType" SG_ 528 ExtrLtgStsCornrgLi 0;
BA_ "GenSigSendType" SG_ 528 ExtrLtgStsDBL 0;
BA_ "GenSigSendType" SG_ 528 ExtrLtgStsDRL 0;
BA_ "GenSigSendType" SG_ 528 ExtrLtgStsFlash 0;
BA_ "GenSigSendType" SG_ 528 ExtrLtgStsFrntFog 0;
BA_ "GenSigSendType" SG_ 528 ExtrLtgStsGoodbye 0;
BA_ "GenSigSendType" SG_ 528 ExtrLtgStsHWL 0;
BA_ "GenSigSendType" SG_ 528 ExtrLtgStsHiBeam 0;
BA_ "GenSigSendType" SG_ 528 ExtrLtgStsHomeSafe 0;
BA_ "GenSigSendType" SG_ 528 ExtrLtgStsLoBeam 0;
BA_ "GenSigSendType" SG_ 528 ExtrLtgStsLtgShow 0;
BA_ "GenSigSendType" SG_ 528 ExtrLtgStsPosLiFrnt 0;
BA_ "GenSigSendType" SG_ 528 ExtrLtgStsPosLiRe 0;
BA_ "GenSigSendType" SG_ 528 ExtrLtgStsReFog 0;
BA_ "GenSigSendType" SG_ 528 ExtrLtgStsReverseLi 0;
BA_ "GenSigSendType" SG_ 528 ExtrLtgStsStopLi 0;
BA_ "GenSigSendType" SG_ 528 ExtrLtgStsTurnIndrLe 0;
BA_ "GenSigSendType" SG_ 528 ExtrLtgStsTurnIndrRi 0;
BA_ "GenSigSendType" SG_ 528 ExtrLtgStsWelcome 0;
BA_ "GenSigSendType" SG_ 896 FileDelStsID 0;
BA_ "GenSigSendType" SG_ 896 FileDelStsSts 0;
BA_ "GenSigSendType" SG_ 896 FileDwnldStsID 0;
BA_ "GenSigSendType" SG_ 896 FileDwnldStsSts 0;
BA_ "GenSigSendType" SG_ 960 FltElecDcDc 0;
BA_ "GenSigSendType" SG_ 896 FltOfFrntTurnIndcrLe 0;
BA_ "GenSigSendType" SG_ 896 FltOfFrntTurnIndcrRi 0;
BA_ "GenSigSendType" SG_ 896 FltOfReTurnIndcrLe 0;
BA_ "GenSigSendType" SG_ 896 FltOfReTurnIndcrRi 0;
BA_ "GenSigSendType" SG_ 960 FltTDcDc 0;
BA_ "GenSigSendType" SG_ 384 FrntLeOfSnsrOfPrkgAssiSide 0;
BA_ "GenSigSendType" SG_ 384 FrntRiOfSnsrOfPrkgAssiSide 0;
BA_ "GenSigSendType" SG_ 720 GearLvrIndcn 0;
BA_ "GenSigStartValue" SG_ 720 GearLvrIndcn 7;
BA_ "GenSigStartValue" SG_ 720 HealthOfEngOil 100;
BA_ "GenSigSendType" SG_ 160 HmiResetTcamReq 1;
BA_ "GenSigSendType" SG_ 896 HmiStrangerModMenuSetActvInActv 0;
BA_ "GenSigSendType" SG_ 896 HmiStrangerModMenuSetPasswordSt 0;
BA_ "GenSigSendType" SG_ 896 HmiStrangerModMenuSetPrivateLockSt 0;
BA_ "GenSigSendType" SG_ 896 HmiStrangerModMenuSetSpdLim 0;
BA_ "GenSigSendType" SG_ 896 HvBattChrgnPwrCns1 0;
BA_ "GenSigSendType" SG_ 896 HvBattDchaTiEstimd 0;
BA_ "GenSigStartValue" SG_ 896 HvBattDchaTiEstimd 2047;
BA_ "GenSigSendType" SG_ 896 HvBattIDc1 0;
BA_ "GenSigStartValue" SG_ 896 HvBattIDc1 16380;
BA_ "GenSigSendType" SG_ 896 HvBattMismatchFlt 0;
BA_ "GenSigSendType" SG_ 896 HvBattPreHeatFaild 0;
BA_ "GenSigSendType" SG_ 720 HvCellTOverFlt 0;
BA_ "GenSigDataID" SG_ 384 HvSysRlyStsChks "0x15";
BA_ "GenSigFuncType" SG_ 384 HvSysRlyStsChks 15;
BA_ "GenSigSendType" SG_ 384 HvSysRlyStsChks 0;
BA_ "GenSigFuncType" SG_ 384 HvSysRlyStsCntr 16;
BA_ "GenSigSendType" SG_ 384 HvSysRlyStsCntr 0;
BA_ "GenSigSendType" SG_ 384 HvSysRlyStsHvSysRlySts 0;
BA_ "GenSigStartValue" SG_ 384 HvSysRlyStsHvSysRlySts 2;
BA_ "GenSigSendType" SG_ 384 ImobRemMgrChkImobDataRemMgrChk0 0;
BA_ "GenSigSendType" SG_ 384 ImobRemMgrChkImobDataRemMgrChk1 0;
BA_ "GenSigSendType" SG_ 384 ImobRemMgrChkImobDataRemMgrChk2 0;
BA_ "GenSigSendType" SG_ 384 ImobRemMgrChkImobDataRemMgrChk3 0;
BA_ "GenSigSendType" SG_ 384 ImobRemMgrChkImobDataRemMgrChk4 0;
BA_ "GenSigSendType" SG_ 384 ImobRemMgrChkSts 0;
BA_ "GenSigSendType" SG_ 384 ImobVehRemMgrSts1ImobVehRemMgrSts 0;
BA_ "GenSigSendType" SG_ 384 ImobVehRemMgrSts1SpdLimRemMgrSts 0;
BA_ "GenSigSendType" SG_ 528 IndcrSts 0;
BA_ "GenSigSendType" SG_ 384 InsdLeOfSnsrPrkgAssiFrnt 0;
BA_ "GenSigSendType" SG_ 384 InsdLeOfSnsrPrkgAssiRe 0;
BA_ "GenSigSendType" SG_ 384 InsdRiOfSnsrPrkgAssiFrnt 0;
BA_ "GenSigSendType" SG_ 384 InsdRiOfSnsrPrkgAssiRe 0;
BA_ "GenSigSendType" SG_ 384 KeyScanActv 0;
BA_ "GenSigSendType" SG_ 896 LVPwrSplyErrSts 0;
BA_ "GenSigSendType" SG_ 160 LvngObjDetnWarn 1;
BA_ "GenSigSendType" SG_ 960 MmedHdPwrMod 0;
BA_ "GenSigSendType" SG_ 528 MobDevRCVReqResp 0;
BA_ "GenSigSendType" SG_ 160 MobDevRCVSts 1;
BA_ "GenSigSendType" SG_ 384 MobDevRPAAuthentReq1AuthentSts 0;
BA_ "GenSigStartValue" SG_ 384 MobDevRPAAuthentReq1AuthentSts 2;
BA_ "GenSigDataID" SG_ 384 MobDevRPAAuthentReq1Chks "0xDD8";
BA_ "GenSigFuncType" SG_ 384 MobDevRPAAuthentReq1Chks 15;
BA_ "GenSigSendType" SG_ 384 MobDevRPAAuthentReq1Chks 0;
BA_ "GenSigFuncType" SG_ 384 MobDevRPAAuthentReq1Cntr 16;
BA_ "GenSigSendType" SG_ 384 MobDevRPAAuthentReq1Cntr 0;
BA_ "GenSigSendType" SG_ 384 MobDevRPAAuthentReq1RndX 0;
BA_ "GenSigSendType" SG_ 384 MobDevRPAAuthentReq1RndY 0;
BA_ "GenSigSendType" SG_ 384 MobDevRPABtnStsToAppGrpPrkgInBtnSts 0;
BA_ "GenSigSendType" SG_ 384 MobDevRPABtnStsToAppGrpPrkgOutBtnSts 0;
BA_ "GenSigSendType" SG_ 384 MobDevRPABtnStsToAppGrpRemParkOutCrsSwtRsp 0;
BA_ "GenSigSendType" SG_ 384 MobDevRPAReqResp 0;
BA_ "GenSigSendType" SG_ 160 MobDevRPAStsOnOff1 1;
BA_ "GenSigSendType" SG_ 160 MobDevRPAStsUInt8 1;
BA_ "GenSigSendType" SG_ 896 MobileActvnStsID 0;
BA_ "GenSigSendType" SG_ 896 MobileActvnStsSts 0;
BA_ "GenSigSendType" SG_ 160 NFCAndBLEKeyDiReqData1 1;
BA_ "GenSigSendType" SG_ 160 NFCAndBLEKeyDiReqData10 1;
BA_ "GenSigSendType" SG_ 160 NFCAndBLEKeyDiReqData11 1;
BA_ "GenSigSendType" SG_ 160 NFCAndBLEKeyDiReqData12 1;
BA_ "GenSigSendType" SG_ 160 NFCAndBLEKeyDiReqData13 1;
BA_ "GenSigSendType" SG_ 160 NFCAndBLEKeyDiReqData14 1;
BA_ "GenSigSendType" SG_ 160 NFCAndBLEKeyDiReqData15 1;
BA_ "GenSigSendType" SG_ 160 NFCAndBLEKeyDiReqData16 1;
BA_ "GenSigSendType" SG_ 160 NFCAndBLEKeyDiReqData2 1;
BA_ "GenSigSendType" SG_ 160 NFCAndBLEKeyDiReqData3 1;
BA_ "GenSigSendType" SG_ 160 NFCAndBLEKeyDiReqData4 1;
BA_ "GenSigSendType" SG_ 160 NFCAndBLEKeyDiReqData5 1;
BA_ "GenSigSendType" SG_ 160 NFCAndBLEKeyDiReqData6 1;
BA_ "GenSigSendType" SG_ 160 NFCAndBLEKeyDiReqData7 1;
BA_ "GenSigSendType" SG_ 160 NFCAndBLEKeyDiReqData8 1;
BA_ "GenSigSendType" SG_ 160 NFCAndBLEKeyDiReqData9 1;
BA_ "GenSigSendType" SG_ 160 NFCKeySearchReqKeyLocn 1;
BA_ "GenSigSendType" SG_ 160 NFCKeySearchReqTirgger 1;
BA_ "GenSigSendType" SG_ 384 ObstacleMinimumDistanceFrntMinDst 0;
BA_ "GenSigStartValue" SG_ 384 ObstacleMinimumDistanceFrntMinDst 511;
BA_ "GenSigSendType" SG_ 384 ObstacleMinimumDistanceFrntMinDstPosn 0;
BA_ "GenSigSendType" SG_ 384 ObstacleMinimumDistanceFrntStopDispReq 0;
BA_ "GenSigSendType" SG_ 384 ObstacleMinimumDistanceReMinDst 0;
BA_ "GenSigStartValue" SG_ 384 ObstacleMinimumDistanceReMinDst 511;
BA_ "GenSigSendType" SG_ 384 ObstacleMinimumDistanceReMinDstPosn 0;
BA_ "GenSigSendType" SG_ 384 ObstacleMinimumDistanceReStopDispReq 0;
BA_ "GenSigSendType" SG_ 528 OnBdChrgrRdyTi 0;
BA_ "GenSigSendType" SG_ 384 OutdLeOfSnsrPrkgAssiFrnt 0;
BA_ "GenSigSendType" SG_ 384 OutdLeOfSnsrPrkgAssiRe 0;
BA_ "GenSigSendType" SG_ 384 OutdRiOfSnsrPrkgAssiFrnt 0;
BA_ "GenSigSendType" SG_ 384 OutdRiOfSnsrPrkgAssiRe 0;
BA_ "GenSigSendType" SG_ 384 PanicAlrmSts 0;
BA_ "GenSigSendType" SG_ 720 PasAcsInHmiReq 0;
BA_ "GenSigSendType" SG_ 720 PasAcsOutHmiReq 0;
BA_ "GenSigSendType" SG_ 528 PassMidSeatSts 0;
BA_ "GenSigSendType" SG_ 896 PercOfFuLvlIndcn 0;
BA_ "GenSigSendType" SG_ 896 PetModWarn 0;
BA_ "GenSigDataID" SG_ 528 PinionSteerAgGroupChks "0x40D";
BA_ "GenSigFuncType" SG_ 528 PinionSteerAgGroupChks 15;
BA_ "GenSigSendType" SG_ 528 PinionSteerAgGroupChks 0;
BA_ "GenSigFuncType" SG_ 528 PinionSteerAgGroupCntr 16;
BA_ "GenSigSendType" SG_ 528 PinionSteerAgGroupCntr 0;
BA_ "GenSigSendType" SG_ 528 PinionSteerAgGroupPinionSteerAg1 0;
BA_ "GenSigSendType" SG_ 528 PinionSteerAgGroupPinionSteerAg1Qf 0;
BA_ "GenSigStartValue" SG_ 528 PinionSteerAgGroupPinionSteerAg1Qf 1;
BA_ "GenSigSendType" SG_ 528 PinionSteerAgGroupPinionSteerAgSpd1 0;
BA_ "GenSigSendType" SG_ 528 PinionSteerAgGroupPinionSteerAgSpd1Qf 0;
BA_ "GenSigStartValue" SG_ 528 PinionSteerAgGroupPinionSteerAgSpd1Qf 1;
BA_ "GenSigSendType" SG_ 528 PinionSteerAgGroupSteerWhlTq 0;
BA_ "GenSigSendType" SG_ 528 PinionSteerAgGroupSteerWhlTqQf 0;
BA_ "GenSigStartValue" SG_ 528 PinionSteerAgGroupSteerWhlTqQf 1;
BA_ "GenSigSendType" SG_ 896 PosnBriefPosnLat 0;
BA_ "GenSigStartValue" SG_ 896 PosnBriefPosnLat 323999740.8002074;
BA_ "GenSigSendType" SG_ 896 PosnBriefPosnLgt 0;
BA_ "GenSigStartValue" SG_ 896 PosnBriefPosnLgt 647999481.6004148;
BA_ "GenSigSendType" SG_ 896 PrkgCmftModTiCtrl 0;
BA_ "GenSigSendType" SG_ 160 PrkgCmftRunRmnReq 1;
BA_ "GenSigSendType" SG_ 384 PrkgDispGroupLeCornrCoornx 0;
BA_ "GenSigSendType" SG_ 384 PrkgDispGroupLeCornrCoorny 0;
BA_ "GenSigSendType" SG_ 384 PrkgDispGroupLeCornrLocn 0;
BA_ "GenSigSendType" SG_ 384 PrkgDispGroupPrkgTyp 0;
BA_ "GenSigSendType" SG_ 384 PrkgDispGroupRiCornrCoornx 0;
BA_ "GenSigSendType" SG_ 384 PrkgDispGroupRiCornrCoorny 0;
BA_ "GenSigSendType" SG_ 384 PrkgDispGroupStallNr 0;
BA_ "GenSigSendType" SG_ 384 PrkgModIncln 0;
BA_ "GenSigSendType" SG_ 384 PrkgOutModBtnStsToAPPPrkgOutModBtnSts1 0;
BA_ "GenSigSendType" SG_ 384 PrkgOutModBtnStsToAPPPrkgOutModBtnSts2 0;
BA_ "GenSigSendType" SG_ 384 PrkgOutModBtnStsToAPPPrkgOutModBtnSts3 0;
BA_ "GenSigSendType" SG_ 384 PrkgOutModBtnStsToAPPPrkgOutModBtnSts4 0;
BA_ "GenSigSendType" SG_ 384 PrkgOutModBtnStsToAPPPrkgOutModBtnSts5 0;
BA_ "GenSigSendType" SG_ 384 PrkgOutModBtnStsToAPPPrkgOutModBtnSts6 0;
BA_ "GenSigSendType" SG_ 384 PrkgProcDstDisp 0;
BA_ "GenSigSendType" SG_ 384 PrkgProgsDisp 0;
BA_ "GenSigSendType" SG_ 528 RCVModIncln 0;
BA_ "GenSigSendType" SG_ 384 ReLeOfSnsrOfPrkgAssiSide 0;
BA_ "GenSigSendType" SG_ 384 ReRiOfSnsrOfPrkgAssiSide 0;
BA_ "GenSigSendType" SG_ 720 RemCtrlVehSts 0;
BA_ "GenSigSendType" SG_ 528 RestrntSysLampReq 0;
BA_ "GenSigSendType" SG_ 528 RlyPwrDistbnCmd1WdPreBattSaveCmd 0;
BA_ "GenSigSendType" SG_ 896 ScenarioMod 0;
BA_ "GenSigSendType" SG_ 528 SeatOccptAtRowFrthLe 0;
BA_ "GenSigSendType" SG_ 528 SeatOccptAtRowFrthMid 0;
BA_ "GenSigSendType" SG_ 528 SeatOccptAtRowFrthRi 0;
BA_ "GenSigSendType" SG_ 896 SeatOccptAtRowSecDrSide2 0;
BA_ "GenSigStartValue" SG_ 896 SeatOccptAtRowSecDrSide2 1;
BA_ "GenSigSendType" SG_ 896 SeatOccptAtRowSecDrSideSnsSts2 0;
BA_ "GenSigSendType" SG_ 896 SeatOccptAtRowSecMid2 0;
BA_ "GenSigStartValue" SG_ 896 SeatOccptAtRowSecMid2 1;
BA_ "GenSigSendType" SG_ 896 SeatOccptAtRowSecMidSnsSts2 0;
BA_ "GenSigSendType" SG_ 896 SeatOccptAtRowSecPasSide2 0;
BA_ "GenSigStartValue" SG_ 896 SeatOccptAtRowSecPasSide2 1;
BA_ "GenSigSendType" SG_ 896 SeatOccptAtRowSecPasSideSnsSts2 0;
BA_ "GenSigStartValue" SG_ 896 SeatOccptAtRowThrdLe2 1;
BA_ "GenSigSendType" SG_ 720 SeatOccptAtRowThrdMid 0;
BA_ "GenSigStartValue" SG_ 896 SeatOccptAtRowThrdRi2 1;
BA_ "GenSigSendType" SG_ 896 StrangerModeStateResp 0;
BA_ "GenSigSendType" SG_ 528 TiAndDateIndcnDataValid 0;
BA_ "GenSigSendType" SG_ 528 TiAndDateIndcnDay 0;
BA_ "GenSigStartValue" SG_ 528 TiAndDateIndcnDay 1;
BA_ "GenSigSendType" SG_ 528 TiAndDateIndcnHr1 0;
BA_ "GenSigSendType" SG_ 528 TiAndDateIndcnMins1 0;
BA_ "GenSigSendType" SG_ 528 TiAndDateIndcnMth1 0;
BA_ "GenSigStartValue" SG_ 528 TiAndDateIndcnMth1 1;
BA_ "GenSigSendType" SG_ 528 TiAndDateIndcnSec1 0;
BA_ "GenSigSendType" SG_ 528 TiAndDateIndcnYr1 0;
BA_ "GenSigSendType" SG_ 896 TotDstTrvld 0;
BA_ "GenSigSendType" SG_ 384 TrOpenerSts 0;
BA_ "GenSigSendType" SG_ 384 UndoProcSts 0;
BA_ "GenSigSendType" SG_ 896 VSTDFailToOpenToTelm 0;
BA_ "GenSigSendType" SG_ 896 VSTDVideoUploadSts 0;
BA_ "GenSigSendType" SG_ 384 VehModMngtGlbSafe1CarModSts1 0;
BA_ "GenSigSendType" SG_ 384 VehModMngtGlbSafe1CarModSubtypWdCarModSubtyp 0;
BA_ "GenSigDataID" SG_ 384 VehModMngtGlbSafe1Chks "0x74";
BA_ "GenSigFuncType" SG_ 384 VehModMngtGlbSafe1Chks 15;
BA_ "GenSigSendType" SG_ 384 VehModMngtGlbSafe1Chks 0;
BA_ "GenSigFuncType" SG_ 384 VehModMngtGlbSafe1Cntr 16;
BA_ "GenSigSendType" SG_ 384 VehModMngtGlbSafe1Cntr 0;
BA_ "GenSigSendType" SG_ 384 VehModMngtGlbSafe1EgyLvlElecMai 0;
BA_ "GenSigSendType" SG_ 384 VehModMngtGlbSafe1EgyLvlElecSubtyp 0;
BA_ "GenSigSendType" SG_ 384 VehModMngtGlbSafe1FltEgyCnsWdSts 0;
BA_ "GenSigSendType" SG_ 384 VehModMngtGlbSafe1PwrLvlElecMai 0;
BA_ "GenSigSendType" SG_ 384 VehModMngtGlbSafe1PwrLvlElecSubtyp 0;
BA_ "GenSigSendType" SG_ 384 VehModMngtGlbSafe1UsgModSts 0;
BA_ "GenSigStartValue" SG_ 384 VehModMngtGlbSafe1UsgModSts 1;
BA_ "GenSigSendType" SG_ 528 VehNotifAndLedFltStsByte0 0;
BA_ "GenSigSendType" SG_ 528 VehNotifAndLedFltStsByte1 0;
BA_ "GenSigSendType" SG_ 528 VehNotifAndLedFltStsByte2 0;
BA_ "GenSigSendType" SG_ 528 VehNotifAndLedFltStsByte3 0;
BA_ "GenSigSendType" SG_ 528 VehNotifAndLedFltStsByte4 0;
BA_ "GenSigSendType" SG_ 528 VehNotifAndLedFltStsByte5 0;
BA_ "GenSigSendType" SG_ 528 VehNotifAndLedFltStsByte6 0;
BA_ "GenSigSendType" SG_ 528 VehNotifAndLedFltStsByte7 0;
BA_ "GenSigSendType" SG_ 960 VehPropSts 0;
BA_ "GenSigSendType" SG_ 528 VehSpdLgtA 0;
BA_ "GenSigDataID" SG_ 528 VehSpdLgtChks "0x37";
BA_ "GenSigFuncType" SG_ 528 VehSpdLgtChks 15;
BA_ "GenSigSendType" SG_ 528 VehSpdLgtChks 0;
BA_ "GenSigFuncType" SG_ 528 VehSpdLgtCntr 16;
BA_ "GenSigSendType" SG_ 528 VehSpdLgtCntr 0;
BA_ "GenSigSendType" SG_ 528 VehSpdLgtQf 0;
BA_ "GenSigStartValue" SG_ 528 VehSpdLgtQf 1;
BA_ "GenSigSendType" SG_ 896 VstdModeSts 0;
BA_ "GenSigSendType" SG_ 720 WinFailrStsAtDrvr 0;
BA_ "GenSigSendType" SG_ 720 WinFailrStsAtReLe 0;
BA_ "GenSigSendType" SG_ 720 WshrFldTankStsToHMI 0;

VAL_ 960 AmbTIndcdWithUnitAmbTIndcdUnit 0 "AmbTIndcdUnit_Celsius" 1 "AmbTIndcdUnit_Fahrenheit" 2 "AmbTIndcdUnit_UkwnUnit";
VAL_ 960 AmbTIndcdWithUnitQF 0 "GenQf1_UndefindDataAccur" 1 "GenQf1_TmpUndefdData" 2 "GenQf1_DataAccurNotWithinSpcn" 3 "GenQf1_AccurData";
VAL_ 960 BrkFldLvl 0 "FldLvl_FldLvlHi" 1 "FldLvl_FldLvlLo";
VAL_ 960 BrkPedlPsdBrkPedlNotPsdSafe 0 "NoYes1_No" 1 "NoYes1_Yes";
VAL_ 960 BrkPedlPsdBrkPedlPsd 0 "NoYes1_No" 1 "NoYes1_Yes";
VAL_ 960 BrkPedlPsdQf 0 "GenQf1_UndefindDataAccur" 1 "GenQf1_TmpUndefdData" 2 "GenQf1_DataAccurNotWithinSpcn" 3 "GenQf1_AccurData";
VAL_ 960 BrkPedlrRatQf 0 "GenQf1_UndefindDataAccur" 1 "GenQf1_TmpUndefdData" 2 "GenQf1_DataAccurNotWithinSpcn" 3 "GenQf1_AccurData";
VAL_ 960 BrkPedlTrvlQf 0 "GenQf1_UndefindDataAccur" 1 "GenQf1_TmpUndefdData" 2 "GenQf1_DataAccurNotWithinSpcn" 3 "GenQf1_AccurData";
VAL_ 960 BrkPedlTrvlSt 0 "PsdNotPsd_NotPsd" 1 "PsdNotPsd_Psd";
VAL_ 960 BrkPedlTrvlStQf 0 "GenQf1_UndefindDataAccur" 1 "GenQf1_TmpUndefdData" 2 "GenQf1_DataAccurNotWithinSpcn" 3 "GenQf1_AccurData";
VAL_ 960 DCChrgnHndlSts 0 "OnBdChrgrHndlSts_Disconnected" 1 "OnBdChrgrHndlSts_ConnectedWithoutPower" 2 "OnBdChrgrHndlSts_PowerAvailableButNotActivated" 3 "OnBdChrgrHndlSts_ConnectedWithPower" 4 "OnBdChrgrHndlSts_Init" 5 "OnBdChrgrHndlSts_Fault";
VAL_ 960 DcDcActvd 0 "DcDcActvd_NoConversionToLVSide" 1 "DcDcActvd_ConversionToLVSide";
VAL_ 960 DstEstimdToEmptyForDrvgElecIndcdDstUnit 0 "DstUnit_km" 1 "DstUnit_miles";
VAL_ 960 DstToEmptyIndcdDstUnit 0 "DstUnit_km" 1 "DstUnit_miles";
VAL_ 960 FltElecDcDc 0 "DevErrSts2_NoFlt" 1 "DevErrSts2_Flt";
VAL_ 960 FltTDcDc 0 "DevErrSts2_NoFlt" 1 "DevErrSts2_Flt";
VAL_ 960 MmedHdPwrMod 0 "MmedMaiPwrMod_IHUStateSleep" 1 "MmedMaiPwrMod_IHUStateStandby" 2 "MmedMaiPwrMod_IHUStatePartial" 3 "MmedMaiPwrMod_IHUStateOn";
VAL_ 960 VehPropSts 0 "Boolean_FALSE" 1 "Boolean_TRUE";
VAL_ 384 AlrmStsAlrmFailr 0 "SnsrSoundrBattBackedFailr_NoFailr" 1 "SnsrSoundrBattBackedFailr_Failr";
VAL_ 384 AlrmStsAlrmSt 0 "AlrmSt_Disarmd" 1 "AlrmSt_Armd" 2 "AlrmSt_Actv";
VAL_ 384 AlrmStsAlrmTrgSrc 0 "AlrmTrgSrc_NoTrigSrc" 1 "AlrmTrgSrc_SnsrSoundrBattBacked" 2 "AlrmTrgSrc_SnsrIncln" 3 "AlrmTrgSrc_SnsrIntrScanr" 4 "AlrmTrgSrc_Hood" 5 "AlrmTrgSrc_Tr" 6 "AlrmTrgSrc_DoorDrvr" 7 "AlrmTrgSrc_DoorPass" 8 "AlrmTrgSrc_DoorReLe" 9 "AlrmTrgSrc_DoorReRi" 10 "AlrmTrgSrc_VehImobnInvld" 11 "AlrmTrgSrc_VSTD" 12 "AlrmTrgSrc_Alcoloch";
VAL_ 384 AlrmStsSnsrInclnFailr 0 "SnsrInclnFailr_NoFailr" 1 "SnsrInclnFailr_Failr";
VAL_ 384 AlrmStsSnsrIntrScanrFailr 0 "SnsrIntrScanrFailr_NoFailr" 1 "SnsrIntrScanrFailr_Failr";
VAL_ 384 AmbTEstimdQf 0 "HvacTIfQf_SnsrDataNotOk" 1 "HvacTIfQf_SnsrDataOk";
VAL_ 384 BattFltStsPrimBattFltStsPrm 0 "BattFltStsPrm_NoFlt_Default" 1 "BattFltStsPrm_QCFlt_QuiescCurrtanomaly" 2 "BattFltStsPrm_LSocFlt_LowSocfault" 3 "BattFltStsPrm_OvFlt_Overvoltagefault" 4 "BattFltStsPrm_UvFlt_Undervoltagefault" 5 "BattFltStsPrm_HiTFlt_Hightemperaturefault" 6 "BattFltStsPrm_OcFlt_Overcurrentfault" 7 "BattFltStsPrm_ScFlt_shortcircuitfault" 11 "BattFltStsPrm_ThermRunawayFlt" 13 "BattFltStsPrm_ResetActvFlg" 14 "BattFltStsPrm_WakeupActvFlg" 15 "BattFltStsPrm_RlyOpenSoonIndcn";
VAL_ 384 BltLockStAtDrvrBltLockSt1 0 "BltLockSt1_Unlock" 1 "BltLockSt1_Lock";
VAL_ 384 BltLockStAtDrvrBltLockSts 0 "DevErrSts2_NoFlt" 1 "DevErrSts2_Flt";
VAL_ 384 BltLockStAtPassBltLockSt1 0 "BltLockSt1_Unlock" 1 "BltLockSt1_Lock";
VAL_ 384 BltLockStAtPassBltLockSts 0 "DevErrSts2_NoFlt" 1 "DevErrSts2_Flt";
VAL_ 384 CmptmtAirTEstimdExtdQlyFlg 0 "GenQf1_UndefindDataAccur" 1 "GenQf1_TmpUndefdData" 2 "GenQf1_DataAccurNotWithinSpcn" 3 "GenQf1_AccurData";
VAL_ 384 DigKeyPasEntryDiSts 0 "OnOff1_Off" 1 "OnOff1_On";
VAL_ 384 DlyClsActv 0 "Boolean_FALSE" 1 "Boolean_TRUE";
VAL_ 384 FrntLeOfSnsrOfPrkgAssiSide 0 "SnsrPrkgAssiFrntSnsrDstInsd_NoDistance" 1 "SnsrPrkgAssiFrntSnsrDstInsd_Range1" 2 "SnsrPrkgAssiFrntSnsrDstInsd_Range2" 3 "SnsrPrkgAssiFrntSnsrDstInsd_Range3" 4 "SnsrPrkgAssiFrntSnsrDstInsd_Range4" 5 "SnsrPrkgAssiFrntSnsrDstInsd_Range5" 6 "SnsrPrkgAssiFrntSnsrDstInsd_Range6" 7 "SnsrPrkgAssiFrntSnsrDstInsd_Range7";
VAL_ 384 FrntRiOfSnsrOfPrkgAssiSide 0 "SnsrPrkgAssiFrntSnsrDstInsd_NoDistance" 1 "SnsrPrkgAssiFrntSnsrDstInsd_Range1" 2 "SnsrPrkgAssiFrntSnsrDstInsd_Range2" 3 "SnsrPrkgAssiFrntSnsrDstInsd_Range3" 4 "SnsrPrkgAssiFrntSnsrDstInsd_Range4" 5 "SnsrPrkgAssiFrntSnsrDstInsd_Range5" 6 "SnsrPrkgAssiFrntSnsrDstInsd_Range6" 7 "SnsrPrkgAssiFrntSnsrDstInsd_Range7";
VAL_ 384 HvSysRlyStsHvSysRlySts 0 "HvActvnSts_Open" 1 "HvActvnSts_Clsd" 2 "HvActvnSts_KeepSt" 3 "HvActvnSts_OpenAndReqActvDcha";
VAL_ 384 ImobRemMgrChkSts 0 "AvlSts1_TmpNotAvl" 1 "AvlSts1_PrmntNotAvl" 2 "AvlSts1_Avl";
VAL_ 384 ImobVehRemMgrSts1ImobVehRemMgrSts 0 "ImobVehRemMgrSts_IdleRemMgrSts" 1 "ImobVehRemMgrSts_ImobnRemMgrSts" 2 "ImobVehRemMgrSts_NoImobnRemMgrSts" 3 "ImobVehRemMgrSts_ImobnStrtDiRemMgrSts";
VAL_ 384 InsdLeOfSnsrPrkgAssiFrnt 0 "SnsrPrkgAssiFrntSnsrDstInsd_NoDistance" 1 "SnsrPrkgAssiFrntSnsrDstInsd_Range1" 2 "SnsrPrkgAssiFrntSnsrDstInsd_Range2" 3 "SnsrPrkgAssiFrntSnsrDstInsd_Range3" 4 "SnsrPrkgAssiFrntSnsrDstInsd_Range4" 5 "SnsrPrkgAssiFrntSnsrDstInsd_Range5" 6 "SnsrPrkgAssiFrntSnsrDstInsd_Range6" 7 "SnsrPrkgAssiFrntSnsrDstInsd_Range7";
VAL_ 384 InsdLeOfSnsrPrkgAssiRe 0 "SnsrPrkgAssiFrntSnsrDstInsd_NoDistance" 1 "SnsrPrkgAssiFrntSnsrDstInsd_Range1" 2 "SnsrPrkgAssiFrntSnsrDstInsd_Range2" 3 "SnsrPrkgAssiFrntSnsrDstInsd_Range3" 4 "SnsrPrkgAssiFrntSnsrDstInsd_Range4" 5 "SnsrPrkgAssiFrntSnsrDstInsd_Range5" 6 "SnsrPrkgAssiFrntSnsrDstInsd_Range6" 7 "SnsrPrkgAssiFrntSnsrDstInsd_Range7";
VAL_ 384 InsdRiOfSnsrPrkgAssiFrnt 0 "SnsrPrkgAssiFrntSnsrDstInsd_NoDistance" 1 "SnsrPrkgAssiFrntSnsrDstInsd_Range1" 2 "SnsrPrkgAssiFrntSnsrDstInsd_Range2" 3 "SnsrPrkgAssiFrntSnsrDstInsd_Range3" 4 "SnsrPrkgAssiFrntSnsrDstInsd_Range4" 5 "SnsrPrkgAssiFrntSnsrDstInsd_Range5" 6 "SnsrPrkgAssiFrntSnsrDstInsd_Range6" 7 "SnsrPrkgAssiFrntSnsrDstInsd_Range7";
VAL_ 384 InsdRiOfSnsrPrkgAssiRe 0 "SnsrPrkgAssiFrntSnsrDstInsd_NoDistance" 1 "SnsrPrkgAssiFrntSnsrDstInsd_Range1" 2 "SnsrPrkgAssiFrntSnsrDstInsd_Range2" 3 "SnsrPrkgAssiFrntSnsrDstInsd_Range3" 4 "SnsrPrkgAssiFrntSnsrDstInsd_Range4" 5 "SnsrPrkgAssiFrntSnsrDstInsd_Range5" 6 "SnsrPrkgAssiFrntSnsrDstInsd_Range6" 7 "SnsrPrkgAssiFrntSnsrDstInsd_Range7";
VAL_ 384 KeyScanActv 0 "Boolean_FALSE" 1 "Boolean_TRUE";
VAL_ 384 MobDevRPAAuthentReq1AuthentSts 0 "Auth_Success" 1 "Auth_Failed" 2 "Auth_None" 3 "Auth_Reserved1";
VAL_ 384 MobDevRPABtnStsToAppGrpPrkgInBtnSts 0 "IdleActRec_Idle" 1 "IdleActRec_Active" 2 "IdleActRec_Deactive" 3 "IdleActRec_Recommand";
VAL_ 384 MobDevRPABtnStsToAppGrpPrkgOutBtnSts 0 "IdleActRec_Idle" 1 "IdleActRec_Active" 2 "IdleActRec_Deactive" 3 "IdleActRec_Recommand";
VAL_ 384 MobDevRPABtnStsToAppGrpRemParkOutCrsSwtRsp 0 "IdleActRec_Idle" 1 "IdleActRec_Active" 2 "IdleActRec_Deactive" 3 "IdleActRec_Recommand";
VAL_ 384 MobDevRPAReqResp 0 "Execution_Default" 1 "Execution_ResultOK" 2 "Execution_ResultError" 3 "Execution_Executing";
VAL_ 384 ObstacleMinimumDistanceFrntMinDstPosn 0 "Position_No" 1 "Position_InsideLeft" 2 "Position_InsideRight" 3 "Position_OutLeft" 4 "Position_OutRight" 5 "Position_SideLeft" 6 "Position_SideRight" 7 "Position_Reserved";
VAL_ 384 ObstacleMinimumDistanceFrntStopDispReq 0 "ReqSts1_NotReqd" 1 "ReqSts1_Reqd";
VAL_ 384 ObstacleMinimumDistanceReMinDstPosn 0 "Position_No" 1 "Position_InsideLeft" 2 "Position_InsideRight" 3 "Position_OutLeft" 4 "Position_OutRight" 5 "Position_SideLeft" 6 "Position_SideRight" 7 "Position_Reserved";
VAL_ 384 ObstacleMinimumDistanceReStopDispReq 0 "ReqSts1_NotReqd" 1 "ReqSts1_Reqd";
VAL_ 384 OutdLeOfSnsrPrkgAssiFrnt 0 "SnsrPrkgAssiFrntSnsrDstInsd_NoDistance" 1 "SnsrPrkgAssiFrntSnsrDstInsd_Range1" 2 "SnsrPrkgAssiFrntSnsrDstInsd_Range2" 3 "SnsrPrkgAssiFrntSnsrDstInsd_Range3" 4 "SnsrPrkgAssiFrntSnsrDstInsd_Range4" 5 "SnsrPrkgAssiFrntSnsrDstInsd_Range5" 6 "SnsrPrkgAssiFrntSnsrDstInsd_Range6" 7 "SnsrPrkgAssiFrntSnsrDstInsd_Range7";
VAL_ 384 OutdLeOfSnsrPrkgAssiRe 0 "SnsrPrkgAssiFrntSnsrDstInsd_NoDistance" 1 "SnsrPrkgAssiFrntSnsrDstInsd_Range1" 2 "SnsrPrkgAssiFrntSnsrDstInsd_Range2" 3 "SnsrPrkgAssiFrntSnsrDstInsd_Range3" 4 "SnsrPrkgAssiFrntSnsrDstInsd_Range4" 5 "SnsrPrkgAssiFrntSnsrDstInsd_Range5" 6 "SnsrPrkgAssiFrntSnsrDstInsd_Range6" 7 "SnsrPrkgAssiFrntSnsrDstInsd_Range7";
VAL_ 384 OutdRiOfSnsrPrkgAssiFrnt 0 "SnsrPrkgAssiFrntSnsrDstInsd_NoDistance" 1 "SnsrPrkgAssiFrntSnsrDstInsd_Range1" 2 "SnsrPrkgAssiFrntSnsrDstInsd_Range2" 3 "SnsrPrkgAssiFrntSnsrDstInsd_Range3" 4 "SnsrPrkgAssiFrntSnsrDstInsd_Range4" 5 "SnsrPrkgAssiFrntSnsrDstInsd_Range5" 6 "SnsrPrkgAssiFrntSnsrDstInsd_Range6" 7 "SnsrPrkgAssiFrntSnsrDstInsd_Range7";
VAL_ 384 OutdRiOfSnsrPrkgAssiRe 0 "SnsrPrkgAssiFrntSnsrDstInsd_NoDistance" 1 "SnsrPrkgAssiFrntSnsrDstInsd_Range1" 2 "SnsrPrkgAssiFrntSnsrDstInsd_Range2" 3 "SnsrPrkgAssiFrntSnsrDstInsd_Range3" 4 "SnsrPrkgAssiFrntSnsrDstInsd_Range4" 5 "SnsrPrkgAssiFrntSnsrDstInsd_Range5" 6 "SnsrPrkgAssiFrntSnsrDstInsd_Range6" 7 "SnsrPrkgAssiFrntSnsrDstInsd_Range7";
VAL_ 384 PanicAlrmSts 0 "OnOff1_Off" 1 "OnOff1_On";
VAL_ 384 PrkgDispGroupLeCornrLocn 0 "CornrLocn_NoQuartile" 1 "CornrLocn_FirstQuartile" 2 "CornrLocn_SecondQuartile" 3 "CornrLocn_ThirdQuartile" 4 "CornrLocn_FouthQuartile" 5 "CornrLocn_Reserved1" 6 "CornrLocn_Reserved2" 7 "CornrLocn_Reserved3";
VAL_ 384 PrkgDispGroupPrkgTyp 0 "PrkgTyp_Default" 1 "PrkgTyp_LeftPerpendicular" 2 "PrkgTyp_LeftParallel" 3 "PrkgTyp_RightPerpendicular" 4 "PrkgTyp_RightParallel" 5 "PrkgTyp_Reserved2" 6 "PrkgTyp_Reserved3" 7 "PrkgTyp_Reserved4";
VAL_ 384 PrkgModIncln 0 "PrkgModIncln_Default" 1 "PrkgModIncln_RPAReqParkingIn" 2 "PrkgModIncln_RPAReqParkingOut" 3 "PrkgModIncln_RPPReqParkingIn" 4 "PrkgModIncln_RPPReqParkingOut" 5 "PrkgModIncln_RSPAReq" 6 "PrkgModIncln_Reserved1" 7 "PrkgModIncln_Reserved2";
VAL_ 384 PrkgOutModBtnStsToAPPPrkgOutModBtnSts1 0 "ActvnAvl4_Idle" 1 "ActvnAvl4_Actvn" 2 "ActvnAvl4_Deactvn" 3 "ActvnAvl4_Recommand";
VAL_ 384 PrkgOutModBtnStsToAPPPrkgOutModBtnSts2 0 "ActvnAvl4_Idle" 1 "ActvnAvl4_Actvn" 2 "ActvnAvl4_Deactvn" 3 "ActvnAvl4_Recommand";
VAL_ 384 PrkgOutModBtnStsToAPPPrkgOutModBtnSts3 0 "ActvnAvl4_Idle" 1 "ActvnAvl4_Actvn" 2 "ActvnAvl4_Deactvn" 3 "ActvnAvl4_Recommand";
VAL_ 384 PrkgOutModBtnStsToAPPPrkgOutModBtnSts4 0 "ActvnAvl4_Idle" 1 "ActvnAvl4_Actvn" 2 "ActvnAvl4_Deactvn" 3 "ActvnAvl4_Recommand";
VAL_ 384 PrkgOutModBtnStsToAPPPrkgOutModBtnSts5 0 "ActvnAvl4_Idle" 1 "ActvnAvl4_Actvn" 2 "ActvnAvl4_Deactvn" 3 "ActvnAvl4_Recommand";
VAL_ 384 PrkgOutModBtnStsToAPPPrkgOutModBtnSts6 0 "ActvnAvl4_Idle" 1 "ActvnAvl4_Actvn" 2 "ActvnAvl4_Deactvn" 3 "ActvnAvl4_Recommand";
VAL_ 384 ReLeOfSnsrOfPrkgAssiSide 0 "SnsrPrkgAssiFrntSnsrDstInsd_NoDistance" 1 "SnsrPrkgAssiFrntSnsrDstInsd_Range1" 2 "SnsrPrkgAssiFrntSnsrDstInsd_Range2" 3 "SnsrPrkgAssiFrntSnsrDstInsd_Range3" 4 "SnsrPrkgAssiFrntSnsrDstInsd_Range4" 5 "SnsrPrkgAssiFrntSnsrDstInsd_Range5" 6 "SnsrPrkgAssiFrntSnsrDstInsd_Range6" 7 "SnsrPrkgAssiFrntSnsrDstInsd_Range7";
VAL_ 384 ReRiOfSnsrOfPrkgAssiSide 0 "SnsrPrkgAssiFrntSnsrDstInsd_NoDistance" 1 "SnsrPrkgAssiFrntSnsrDstInsd_Range1" 2 "SnsrPrkgAssiFrntSnsrDstInsd_Range2" 3 "SnsrPrkgAssiFrntSnsrDstInsd_Range3" 4 "SnsrPrkgAssiFrntSnsrDstInsd_Range4" 5 "SnsrPrkgAssiFrntSnsrDstInsd_Range5" 6 "SnsrPrkgAssiFrntSnsrDstInsd_Range6" 7 "SnsrPrkgAssiFrntSnsrDstInsd_Range7";
VAL_ 384 TrOpenerSts 0 "TrOpenerSts1_Ukwn" 1 "TrOpenerSts1_FullClsd" 2 "TrOpenerSts1_MovgUp" 3 "TrOpenerSts1_MovgUpBrkg" 4 "TrOpenerSts1_StopDurgOpen" 5 "TrOpenerSts1_FullOpend" 6 "TrOpenerSts1_MovgDwn" 7 "TrOpenerSts1_MovgDwnBrkg" 8 "TrOpenerSts1_StopDurgCls" 9 "TrOpenerSts1_HalfClsd" 10 "TrOpenerSts1_StopMinPntForCls";
VAL_ 384 UndoProcSts 0 "SysUndoFctSts_Default" 1 "SysUndoFctSts_UNDOValid" 2 "SysUndoFctSts_UNDOInvalid";
VAL_ 384 VehModMngtGlbSafe1CarModSts1 0 "CarModSts1_CarModNorm" 1 "CarModSts1_CarModTrnsp" 2 "CarModSts1_CarModFcy" 3 "CarModSts1_CarModCrash" 5 "CarModSts1_CarModDyno";
VAL_ 384 VehModMngtGlbSafe1FltEgyCnsWdSts 0 "FltEgyCns1_NoFlt" 1 "FltEgyCns1_Flt";
VAL_ 384 VehModMngtGlbSafe1UsgModSts 0 "UsgModSts1_UsgModAbdnd" 1 "UsgModSts1_UsgModInActv" 2 "UsgModSts1_UsgModCnvinc" 11 "UsgModSts1_UsgModActv" 13 "UsgModSts1_UsgModDrvg";
VAL_ 896 AntithftActvnNotif 0 "AntithftActvnNotif1_NotActvd" 1 "AntithftActvnNotif1_Actvd";
VAL_ 896 CampMod 0 "OnOff1_Off" 1 "OnOff1_On";
VAL_ 896 ChrgLidAcSts 0 "DoorSts2_Ukwn" 1 "DoorSts2_Opend" 2 "DoorSts2_Clsd";
VAL_ 896 ChrgLidDCorAcDcSts 0 "DoorSts2_Ukwn" 1 "DoorSts2_Opend" 2 "DoorSts2_Clsd";
VAL_ 896 ChrgnByEngCmfdReqToDrvr 0 "ReqSts1_NotReqd" 1 "ReqSts1_Reqd";
VAL_ 896 ChrgnOrDisChrgnStsFb 0 "ChrgnSts2_Default" 1 "ChrgnSts2_NoCharging" 2 "ChrgnSts2_ACCharging" 3 "ChrgnSts2_ChargingEnd" 4 "ChrgnSts2_ChargingCmpl" 5 "ChrgnSts2_Heating" 6 "ChrgnSts2_Booking" 7 "ChrgnSts2_NoDischaring" 8 "ChrgnSts2_Discharging" 9 "ChrgnSts2_DischargingEnd" 10 "ChrgnSts2_DischargingCmpl" 11 "ChrgnSts2_Chargingfalut" 12 "ChrgnSts2_DischargingFalut" 14 "ChrgnSts2_ACChrgnFltChrgrSide" 15 "ChrgnSts2_DCCharging" 18 "ChrgnSts2_DCChrgnFltVehSide" 19 "ChrgnSts2_DCChrgnFltChrgrSideTempFlt" 20 "ChrgnSts2_DCChrgnFltChrgrSideConFlt" 21 "ChrgnSts2_DCChrgnFltChrgrSideHwFlt" 22 "ChrgnSts2_DCChrgnFltChrgrSideEmgyFlt" 23 "ChrgnSts2_DCChrgnFltChrgrSideComFlt" 24 "ChrgnSts2_SuperCharging" 25 "ChrgnSts2_ACChargingSuspend" 26 "ChrgnSts2_DCChargingEnd" 27 "ChrgnSts2_ACChrgnFltVehSide" 28 "ChrgnSts2_Boostcharging" 29 "ChrgnSts2_BoostchargingFlt" 30 "ChrgnSts2_WirelessCharging";
VAL_ 896 ChrgnSts 0 "ChrgnSts_Fault" 1 "ChrgnSts_ChargingInParkingState" 2 "ChrgnSts_ChargingInDrivingState" 3 "ChrgnSts_NotCharging" 4 "ChrgnSts_ChargingCompleted" 5 "ChrgnSts_Invalid";
VAL_ 896 CmptmtTFrntFanForCmptmtTRunng 0 "Flg1_Rst" 1 "Flg1_Set";
VAL_ 896 CmptmtTFrntQf 0 "CmptmtTFrntQf_SnsrDataUndefd" 1 "CmptmtTFrntQf_FanNotRunning" 2 "CmptmtTFrntQf_SnsrDataNotOk" 3 "CmptmtTFrntQf_SnsrDataOk";
VAL_ 896 EcoClimaSts 0 "OnOff1_Off" 1 "OnOff1_On";
VAL_ 896 EngSt1WdStsEngSt1WdSts 0 "EngSt1_Ini" 1 "EngSt1_Awake" 2 "EngSt1_Rdy" 3 "EngSt1_PreStrtg" 4 "EngSt1_StrtgInProgs" 5 "EngSt1_RunngRunng" 6 "EngSt1_RunngStb" 7 "EngSt1_RunngStrtgInProgs" 8 "EngSt1_RunngRemStrtd" 9 "EngSt1_AftRun";
VAL_ 896 FileDelStsSts 0 "Sts3_Resd" 1 "Sts3_Cmpl" 2 "Sts3_Failr";
VAL_ 896 FileDwnldStsSts 0 "Sts1_Resd" 1 "Sts1_InProgs" 2 "Sts1_Cmpl" 3 "Sts1_LoPwr" 4 "Sts1_Failr";
VAL_ 896 FltOfFrntTurnIndcrLe 0 "DevErrSts2_NoFlt" 1 "DevErrSts2_Flt";
VAL_ 896 FltOfFrntTurnIndcrRi 0 "DevErrSts2_NoFlt" 1 "DevErrSts2_Flt";
VAL_ 896 FltOfReTurnIndcrLe 0 "DevErrSts2_NoFlt" 1 "DevErrSts2_Flt";
VAL_ 896 FltOfReTurnIndcrRi 0 "DevErrSts2_NoFlt" 1 "DevErrSts2_Flt";
VAL_ 896 HmiStrangerModMenuSetActvInActv 0 "Inact_Inactive" 1 "Inact_Active";
VAL_ 896 HmiStrangerModMenuSetPasswordSt 0 "NoYes1_No" 1 "NoYes1_Yes";
VAL_ 896 HmiStrangerModMenuSetPrivateLockSt 0 "NoYes1_No" 1 "NoYes1_Yes";
VAL_ 896 HvBattMismatchFlt 0 "DevErrSts2_NoFlt" 1 "DevErrSts2_Flt";
VAL_ 896 HvBattPreHeatFaild 0 "OnOff1_Off" 1 "OnOff1_On";
VAL_ 896 LVPwrSplyErrSts 0 "PwrSplyErrSts_SysOk" 1 "PwrSplyErrSts_UhiDurgDrvg" 2 "PwrSplyErrSts_UloDurgdrvg" 3 "PwrSplyErrSts_BattRlyFlt" 4 "PwrSplyErrSts_BattSnsrComFlt" 5 "PwrSplyErrSts_BattSnsrHwFlt" 6 "PwrSplyErrSts_FltComDcDc" 7 "PwrSplyErrSts_FltElecDcDc" 8 "PwrSplyErrSts_FltDcDc" 9 "PwrSplyErrSts_SupCptrHwFlt" 10 "PwrSplyErrSts_AltFltMecl" 11 "PwrSplyErrSts_AltFltElec" 12 "PwrSplyErrSts_AltFltT" 13 "PwrSplyErrSts_AltFltCom" 14 "PwrSplyErrSts_SpprtBattFltChrgn" 15 "PwrSplyErrSts_Spare6";
VAL_ 896 MobileActvnStsSts 0 "Sts2_Resd" 1 "Sts2_ExtrLiErr" 2 "Sts2_PwrErr" 3 "Sts2_FileErr" 4 "Sts2_WinErr" 5 "Sts2_Strt" 6 "Sts2_End";
VAL_ 896 PetModWarn 0 "LvlWarn2_NoWarn" 1 "LvlWarn2_Lvl1" 2 "LvlWarn2_Lvl2" 3 "LvlWarn2_Lvl3";
VAL_ 896 ScenarioMod 0 "SceneMod_Idle" 1 "SceneMod_ChildrenMod" 2 "SceneMod_RefreshMod" 3 "SceneMod_TheaterMod" 4 "SceneMod_RestMod" 5 "SceneMod_ConcertHallMod" 6 "SceneMod_CarWashMod" 7 "SceneMod_SmokingMod" 8 "SceneMod_RomanticMod" 9 "SceneMod_MeditationMod" 10 "SceneMod_SingMod" 11 "SceneMod_PetMod" 12 "SceneMod_Reserved1" 13 "SceneMod_Reserved2" 14 "SceneMod_Reserved3" 15 "SceneMod_Reserved4";
VAL_ 896 SeatOccptAtRowSecDrSide2 0 "OccptPresSt1_Undefd1" 1 "OccptPresSt1_OccptNotPrsnt" 2 "OccptPresSt1_OccptPrsnt" 3 "OccptPresSt1_Undefd2";
VAL_ 896 SeatOccptAtRowSecDrSideSnsSts2 0 "OkNokDi_Ok" 1 "OkNokDi_NotOk" 2 "OkNokDi_Disabled" 3 "OkNokDi_Reserved";
VAL_ 896 SeatOccptAtRowSecMid2 0 "OccptPresSt1_Undefd1" 1 "OccptPresSt1_OccptNotPrsnt" 2 "OccptPresSt1_OccptPrsnt" 3 "OccptPresSt1_Undefd2";
VAL_ 896 SeatOccptAtRowSecMidSnsSts2 0 "OkNokDi_Ok" 1 "OkNokDi_NotOk" 2 "OkNokDi_Disabled" 3 "OkNokDi_Reserved";
VAL_ 896 SeatOccptAtRowSecPasSide2 0 "OccptPresSt1_Undefd1" 1 "OccptPresSt1_OccptNotPrsnt" 2 "OccptPresSt1_OccptPrsnt" 3 "OccptPresSt1_Undefd2";
VAL_ 896 SeatOccptAtRowSecPasSideSnsSts2 0 "OkNokDi_Ok" 1 "OkNokDi_NotOk" 2 "OkNokDi_Disabled" 3 "OkNokDi_Reserved";
VAL_ 896 SeatOccptAtRowThrdLe2 0 "OccptPresSt1_Undefd1" 1 "OccptPresSt1_OccptNotPrsnt" 2 "OccptPresSt1_OccptPrsnt" 3 "OccptPresSt1_Undefd2";
VAL_ 896 SeatOccptAtRowThrdLeSnsSts2 0 "OkNokDi_Ok" 1 "OkNokDi_NotOk" 2 "OkNokDi_Disabled" 3 "OkNokDi_Reserved";
VAL_ 896 SeatOccptAtRowThrdRi2 0 "OccptPresSt1_Undefd1" 1 "OccptPresSt1_OccptNotPrsnt" 2 "OccptPresSt1_OccptPrsnt" 3 "OccptPresSt1_Undefd2";
VAL_ 896 SeatOccptAtRowThrdRiSnsSts2 0 "OkNokDi_Ok" 1 "OkNokDi_NotOk" 2 "OkNokDi_Disabled" 3 "OkNokDi_Reserved";
VAL_ 896 StrangerModeStateResp 0 "ActvnWithMsg_Idle" 1 "ActvnWithMsg_Activation_Successful" 2 "ActvnWithMsg_Activation_Fail";
VAL_ 896 VstdModeSts 0 "Mode5_Off" 1 "Mode5_StandBy" 2 "Mode5_On" 3 "Mode5_Alert" 4 "Mode5_Alarm";
VAL_ 896 VSTDVideoUploadSts 0 "PmSnsrSts_Initial" 1 "PmSnsrSts_Collecting" 2 "PmSnsrSts_Complete" 3 "PmSnsrSts_Error";
VAL_ 720 BltLockStAtRowSecLeBltLockEquid 0 "CptEquid_Equid" 1 "CptEquid_NotEquid";
VAL_ 720 BltLockStAtRowSecLeBltLockSt1 0 "BltLockSt1_Unlock" 1 "BltLockSt1_Lock";
VAL_ 720 BltLockStAtRowSecLeBltLockSts 0 "DevErrSts2_NoFlt" 1 "DevErrSts2_Flt";
VAL_ 720 BltLockStAtRowSecMidBltLockEquid 0 "CptEquid_Equid" 1 "CptEquid_NotEquid";
VAL_ 720 BltLockStAtRowSecMidBltLockSt1 0 "BltLockSt1_Unlock" 1 "BltLockSt1_Lock";
VAL_ 720 BltLockStAtRowSecMidBltLockSts 0 "DevErrSts2_NoFlt" 1 "DevErrSts2_Flt";
VAL_ 720 BltLockStAtRowSecRiBltLockEquid 0 "CptEquid_Equid" 1 "CptEquid_NotEquid";
VAL_ 720 BltLockStAtRowSecRiBltLockSt1 0 "BltLockSt1_Unlock" 1 "BltLockSt1_Lock";
VAL_ 720 BltLockStAtRowSecRiBltLockSts 0 "DevErrSts2_NoFlt" 1 "DevErrSts2_Flt";
VAL_ 720 BltLockStAtRowThrdLeBltLockEquid 0 "CptEquid_Equid" 1 "CptEquid_NotEquid";
VAL_ 720 BltLockStAtRowThrdLeBltLockSt1 0 "BltLockSt1_Unlock" 1 "BltLockSt1_Lock";
VAL_ 720 BltLockStAtRowThrdLeBltLockSts 0 "DevErrSts2_NoFlt" 1 "DevErrSts2_Flt";
VAL_ 720 BltLockStAtRowThrdRiBltLockEquid 0 "CptEquid_Equid" 1 "CptEquid_NotEquid";
VAL_ 720 BltLockStAtRowThrdRiBltLockSt1 0 "BltLockSt1_Unlock" 1 "BltLockSt1_Lock";
VAL_ 720 BltLockStAtRowThrdRiBltLockSts 0 "DevErrSts2_NoFlt" 1 "DevErrSts2_Flt";
VAL_ 720 BookChrgnStsFb 0 "BookChrgnStsFb_Default" 1 "BookChrgnStsFb_Success" 2 "BookChrgnStsFb_Fail" 3 "BookChrgnStsFb_Finished";
VAL_ 720 BookTrvlChrgnFb 0 "BookChrgnStsFb_Default" 1 "BookChrgnStsFb_Success" 2 "BookChrgnStsFb_Fail" 3 "BookChrgnStsFb_Finished";
VAL_ 720 BookTrvlChrgnSts 0 "Boolean_FALSE" 1 "Boolean_TRUE";
VAL_ 720 DchaStopReasonIndcn 0 "DchaStopReasonIndcn_Default" 1 "DchaStopReasonIndcn_StopWhenActvnDcha" 2 "DchaStopReasonIndcn_StopAfterWhile" 3 "DchaStopReasonIndcn_StopAlready";
VAL_ 720 DischrgPwrExceedWarn 0 "Normalwarning_Normal" 1 "Normalwarning_Warning";
VAL_ 720 DrvrSeatInAutMovmt 0 "Boolean_FALSE" 1 "Boolean_TRUE";
VAL_ 720 DrvrSeatSnsrSts 0 "OkNokDi_Ok" 1 "OkNokDi_NotOk" 2 "OkNokDi_Disabled" 3 "OkNokDi_Reserved";
VAL_ 720 DrvrSeatSts 0 "OccptPresSt1_Undefd1" 1 "OccptPresSt1_OccptNotPrsnt" 2 "OccptPresSt1_OccptPrsnt" 3 "OccptPresSt1_Undefd2";
VAL_ 720 EngCooltLvl 0 "FldLvl_FldLvlHi" 1 "FldLvl_FldLvlLo";
VAL_ 720 EpbLampReqEpbLampReq 0 "EpbLampReqType1_On" 1 "EpbLampReqType1_Off" 2 "EpbLampReqType1_Flash2" 3 "EpbLampReqType1_Flash3";
VAL_ 720 ErsDelayTiCfm 0 "NoYes1_No" 1 "NoYes1_Yes";
VAL_ 720 ErsStrtApplSts 0 "ErsStrtApplSts_ErsStsOff" 1 "ErsStrtApplSts_ErsStsStrtg" 2 "ErsStrtApplSts_ErsStsRunng";
VAL_ 720 ErsStrtRes 0 "ErsStrtRes_ErsStrtNotSet" 1 "ErsStrtRes_ErsStrtSuccess" 2 "ErsStrtRes_ErsStrtInhMaxNoStart" 3 "ErsStrtRes_ErsStrtInhCarUnlocked" 4 "ErsStrtRes_ErsStrtInhKeyInCar" 5 "ErsStrtRes_ErsStrtInhDoorOpen" 6 "ErsStrtRes_ErsStrtInhHoodOpen" 7 "ErsStrtRes_ErsStrtInhGearNotP" 8 "ErsStrtRes_ErsStrtInhUserInCar" 9 "ErsStrtRes_ErsStrtInhPedalPressed" 10 "ErsStrtRes_ErsStrtInhLoFuel" 11 "ErsStrtRes_ErsStrtInhLoBatt" 12 "ErsStrtRes_ErsStrtInhEngCoolant" 13 "ErsStrtRes_ErsStrtInhEngFault" 14 "ErsStrtRes_ErsStrtInhOther" 15 "ErsStrtRes_ErsStrtAbrtEngFault" 16 "ErsStrtRes_ErsStrtAbrtEngCoolant" 17 "ErsStrtRes_ErsStrtAbrtLoFuel" 18 "ErsStrtRes_ErsStrtAbrtLoBatt" 19 "ErsStrtRes_ErsStrtAbrtOther";
VAL_ 720 GearLvrIndcn 0 "GearLvrIndcn2_ParkIndcn" 1 "GearLvrIndcn2_RvsIndcn" 2 "GearLvrIndcn2_NeutIndcn" 3 "GearLvrIndcn2_DrvIndcn" 4 "GearLvrIndcn2_ManModeIndcn" 5 "GearLvrIndcn2_Resd1" 6 "GearLvrIndcn2_Resd2" 7 "GearLvrIndcn2_Undefd";
VAL_ 720 HvCellTOverFlt 0 "FauLevel_Normal" 1 "FauLevel_LevelI" 2 "FauLevel_LevelII" 3 "FauLevel_LevelIII";
VAL_ 720 PasAcsInHmiReq 0 "OnOff1_Off" 1 "OnOff1_On";
VAL_ 720 PasAcsOutHmiReq 0 "OnOff1_Off" 1 "OnOff1_On";
VAL_ 720 RemCtrlVehSts 0 "RemCtrlVehSts_OFF" 1 "RemCtrlVehSts_RemParkInStandby" 2 "RemCtrlVehSts_RemParkOutStandby" 3 "RemCtrlVehSts_Searching" 4 "RemCtrlVehSts_RemParkInpreactive" 5 "RemCtrlVehSts_RemParkactive" 6 "RemCtrlVehSts_ParkProcessActive" 7 "RemCtrlVehSts_Suspend" 8 "RemCtrlVehSts_Abort" 9 "RemCtrlVehSts_RemParkInProCompleted" 10 "RemCtrlVehSts_RemParkOutProCompleted" 11 "RemCtrlVehSts_RemParkCompleted" 12 "RemCtrlVehSts_Quit" 13 "RemCtrlVehSts_Failure" 14 "RemCtrlVehSts_Cancel";
VAL_ 720 SeatOccptAtRowThrdMid 0 "PassSeatSts1_Empty" 1 "PassSeatSts1_Fmale" 2 "PassSeatSts1_OccptLrg" 3 "PassSeatSts1_Ukwn";
VAL_ 720 WinFailrStsAtDrvr 0 "Flt_NoFault" 1 "Flt_Fault";
VAL_ 720 WinFailrStsAtReLe 0 "Flt_NoFault" 1 "Flt_Fault";
VAL_ 720 WshrFldTankStsToHMI 0 "OnOff1_Off" 1 "OnOff1_On";
VAL_ 160 BLEKeySearchReqKeyLocn 0 "KeyLocn1_KeyLocnIdle" 1 "KeyLocn1_KeyLocnAll" 2 "KeyLocn1_KeyLocnAllExt" 3 "KeyLocn1_KeyLocnDrvrExt" 4 "KeyLocn1_KeyLocnPassExt" 5 "KeyLocn1_KeyLocnTrExt" 6 "KeyLocn1_KeyLocnAllInt" 7 "KeyLocn1_KeyLocnDrvrInt" 8 "KeyLocn1_KeyLocnPassInt" 9 "KeyLocn1_KeyLocnResvInt" 10 "KeyLocn1_KeyLocnResvIntSimple";
VAL_ 160 BLEKeySearchReqTirgger 0 "Tirgger_Idle" 1 "Tirgger_VMM" 2 "Tirgger_Locking" 3 "Tirgger_KeyRmn" 4 "Tirgger_KeyWrn" 5 "Tirgger_ProfiMgr";
VAL_ 160 BookTrvlFltSts 0 "Boolean_FALSE" 1 "Boolean_TRUE";
VAL_ 160 BookTrvlSetResponse 0 "BookChargeSetResponse_Default" 1 "BookChargeSetResponse_Success" 2 "BookChargeSetResponse_Cancelled" 3 "BookChargeSetResponse_Fail";
VAL_ 160 BookTrvlTiSetReqBookTrvlTiSetReq 0 "ReqSts1_NotReqd" 1 "ReqSts1_Reqd";
VAL_ 160 CrashSts2 0 "CrashSts3_Resd1" 1 "CrashSts3_NoCrash" 2 "CrashSts3_Crash" 3 "CrashSts3_Resd2";
VAL_ 160 CrashStsSafeSts 0 "CrashSts2_NoCrash" 1 "CrashSts2_Crash";
VAL_ 160 HmiResetTcamReq 0 "OnOff1_Off" 1 "OnOff1_On";
VAL_ 160 LvngObjDetnWarn 0 "NotActvActv1_NotActv" 1 "NotActvActv1_Actv";
VAL_ 160 MobDevRPAStsOnOff1 0 "OnOff1_Off" 1 "OnOff1_On";
VAL_ 160 NFCKeySearchReqKeyLocn 0 "KeyLocn1_KeyLocnIdle" 1 "KeyLocn1_KeyLocnAll" 2 "KeyLocn1_KeyLocnAllExt" 3 "KeyLocn1_KeyLocnDrvrExt" 4 "KeyLocn1_KeyLocnPassExt" 5 "KeyLocn1_KeyLocnTrExt" 6 "KeyLocn1_KeyLocnAllInt" 7 "KeyLocn1_KeyLocnDrvrInt" 8 "KeyLocn1_KeyLocnPassInt" 9 "KeyLocn1_KeyLocnResvInt" 10 "KeyLocn1_KeyLocnResvIntSimple";
VAL_ 160 NFCKeySearchReqTirgger 0 "Tirgger_Idle" 1 "Tirgger_VMM" 2 "Tirgger_Locking" 3 "Tirgger_KeyRmn" 4 "Tirgger_KeyWrn" 5 "Tirgger_ProfiMgr";
VAL_ 160 PrkgCmftRunRmnReq 0 "OnOff1_Off" 1 "OnOff1_On";
VAL_ 528 ApproachLiSetReq 0 "ApproachLiSetReq_Off" 1 "ApproachLiSetReq_ONStatic" 2 "ApproachLiSetReq_ONDynamic";
VAL_ 528 BrkLiOnReqSts 0 "ReqSts1_NotReqd" 1 "ReqSts1_Reqd";
VAL_ 528 DChrgStrtEngRes 0 "DChrgStrt_NotSet" 1 "DChrgStrt_Start" 2 "DChrgStrt_Finished" 3 "DChrgStrt_MaxNoStart" 4 "DChrgStrt_HoodOpen" 5 "DChrgStrt_CarUnlocked" 6 "DChrgStrt_ValidKeyInCar" 7 "DChrgStrt_PwrSplyErr" 8 "DChrgStrt_FuelLow" 9 "DChrgStrt_PropFlt" 10 "DChrgStrt_MaxTi" 11 "DChrgStrt_NoValidKeyInCar";
VAL_ 528 DHUConnectionSts 0 "Boolean_FALSE" 1 "Boolean_TRUE";
VAL_ 528 ExtrLtgStsAFS 0 "DevSts4_Off" 1 "DevSts4_On" 2 "DevSts4_Err" 3 "DevSts4_Resd";
VAL_ 528 ExtrLtgStsAHBC 0 "DevSts4_Off" 1 "DevSts4_On" 2 "DevSts4_Err" 3 "DevSts4_Resd";
VAL_ 528 ExtrLtgStsAHL 0 "DevSts4_Off" 1 "DevSts4_On" 2 "DevSts4_Err" 3 "DevSts4_Resd";
VAL_ 528 ExtrLtgStsAllWL 0 "DevSts4_Off" 1 "DevSts4_On" 2 "DevSts4_Err" 3 "DevSts4_Resd";
VAL_ 528 ExtrLtgStsApproach 0 "DevSts4_Off" 1 "DevSts4_On" 2 "DevSts4_Err" 3 "DevSts4_Resd";
VAL_ 528 ExtrLtgStsCornrgLi 0 "DevSts4_Off" 1 "DevSts4_On" 2 "DevSts4_Err" 3 "DevSts4_Resd";
VAL_ 528 ExtrLtgStsDBL 0 "DevSts4_Off" 1 "DevSts4_On" 2 "DevSts4_Err" 3 "DevSts4_Resd";
VAL_ 528 ExtrLtgStsDRL 0 "DevSts4_Off" 1 "DevSts4_On" 2 "DevSts4_Err" 3 "DevSts4_Resd";
VAL_ 528 ExtrLtgStsFlash 0 "DevSts4_Off" 1 "DevSts4_On" 2 "DevSts4_Err" 3 "DevSts4_Resd";
VAL_ 528 ExtrLtgStsFrntFog 0 "DevSts4_Off" 1 "DevSts4_On" 2 "DevSts4_Err" 3 "DevSts4_Resd";
VAL_ 528 ExtrLtgStsGoodbye 0 "DevSts4_Off" 1 "DevSts4_On" 2 "DevSts4_Err" 3 "DevSts4_Resd";
VAL_ 528 ExtrLtgStsHiBeam 0 "DevSts4_Off" 1 "DevSts4_On" 2 "DevSts4_Err" 3 "DevSts4_Resd";
VAL_ 528 ExtrLtgStsHomeSafe 0 "DevSts4_Off" 1 "DevSts4_On" 2 "DevSts4_Err" 3 "DevSts4_Resd";
VAL_ 528 ExtrLtgStsHWL 0 "DevSts4_Off" 1 "DevSts4_On" 2 "DevSts4_Err" 3 "DevSts4_Resd";
VAL_ 528 ExtrLtgStsLoBeam 0 "DevSts4_Off" 1 "DevSts4_On" 2 "DevSts4_Err" 3 "DevSts4_Resd";
VAL_ 528 ExtrLtgStsLtgShow 0 "DevSts4_Off" 1 "DevSts4_On" 2 "DevSts4_Err" 3 "DevSts4_Resd";
VAL_ 528 ExtrLtgStsPosLiFrnt 0 "DevSts4_Off" 1 "DevSts4_On" 2 "DevSts4_Err" 3 "DevSts4_Resd";
VAL_ 528 ExtrLtgStsPosLiRe 0 "DevSts4_Off" 1 "DevSts4_On" 2 "DevSts4_Err" 3 "DevSts4_Resd";
VAL_ 528 ExtrLtgStsReFog 0 "DevSts4_Off" 1 "DevSts4_On" 2 "DevSts4_Err" 3 "DevSts4_Resd";
VAL_ 528 ExtrLtgStsReverseLi 0 "DevSts4_Off" 1 "DevSts4_On" 2 "DevSts4_Err" 3 "DevSts4_Resd";
VAL_ 528 ExtrLtgStsStopLi 0 "DevSts4_Off" 1 "DevSts4_On" 2 "DevSts4_Err" 3 "DevSts4_Resd";
VAL_ 528 ExtrLtgStsTurnIndrLe 0 "DevSts4_Off" 1 "DevSts4_On" 2 "DevSts4_Err" 3 "DevSts4_Resd";
VAL_ 528 ExtrLtgStsTurnIndrRi 0 "DevSts4_Off" 1 "DevSts4_On" 2 "DevSts4_Err" 3 "DevSts4_Resd";
VAL_ 528 ExtrLtgStsWelcome 0 "DevSts4_Off" 1 "DevSts4_On" 2 "DevSts4_Err" 3 "DevSts4_Resd";
VAL_ 528 IndcrSts 0 "IndcrSts1_Off" 1 "IndcrSts1_LeOn" 2 "IndcrSts1_RiOn" 3 "IndcrSts1_LeAndRiOn";
VAL_ 528 MobDevRCVReqResp 0 "MobDevRCVReqResp_Default" 1 "MobDevRCVReqResp_ResultOk" 2 "MobDevRCVReqResp_ResultError" 3 "MobDevRCVReqResp_Executing";
VAL_ 528 PassMidSeatSts 0 "PassSeatSts1_Empty" 1 "PassSeatSts1_Fmale" 2 "PassSeatSts1_OccptLrg" 3 "PassSeatSts1_Ukwn";
VAL_ 528 PinionSteerAgGroupPinionSteerAg1Qf 0 "GenQf1_UndefindDataAccur" 1 "GenQf1_TmpUndefdData" 2 "GenQf1_DataAccurNotWithinSpcn" 3 "GenQf1_AccurData";
VAL_ 528 PinionSteerAgGroupPinionSteerAgSpd1Qf 0 "GenQf1_UndefindDataAccur" 1 "GenQf1_TmpUndefdData" 2 "GenQf1_DataAccurNotWithinSpcn" 3 "GenQf1_AccurData";
VAL_ 528 PinionSteerAgGroupSteerWhlTqQf 0 "GenQf1_UndefindDataAccur" 1 "GenQf1_TmpUndefdData" 2 "GenQf1_DataAccurNotWithinSpcn" 3 "GenQf1_AccurData";
VAL_ 528 RCVModIncln 0 "RCVModIncln_Default" 1 "RCVModIncln_RCVReq";
VAL_ 528 RestrntSysLampReq 0 "RestrntSysLampReq_LampOff" 1 "RestrntSysLampReq_Ukwn" 2 "RestrntSysLampReq_LampFlash" 3 "RestrntSysLampReq_LampOn";
VAL_ 528 RlyPwrDistbnCmd1WdPreBattSaveCmd 0 "OnOff1_Off" 1 "OnOff1_On";
VAL_ 528 SeatOccptAtRowFrthLe 0 "PassSeatSts1_Empty" 1 "PassSeatSts1_Fmale" 2 "PassSeatSts1_OccptLrg" 3 "PassSeatSts1_Ukwn";
VAL_ 528 SeatOccptAtRowFrthMid 0 "PassSeatSts1_Empty" 1 "PassSeatSts1_Fmale" 2 "PassSeatSts1_OccptLrg" 3 "PassSeatSts1_Ukwn";
VAL_ 528 SeatOccptAtRowFrthRi 0 "PassSeatSts1_Empty" 1 "PassSeatSts1_Fmale" 2 "PassSeatSts1_OccptLrg" 3 "PassSeatSts1_Ukwn";
VAL_ 528 TiAndDateIndcnDataValid 0 "NoYes1_No" 1 "NoYes1_Yes";
VAL_ 528 VehSpdLgtQf 0 "GenQf1_UndefindDataAccur" 1 "GenQf1_TmpUndefdData" 2 "GenQf1_DataAccurNotWithinSpcn" 3 "GenQf1_AccurData";
SIG_GROUP_ 960 AccrPedlRat 1 : AccrPedlRatAccrPedlRat AccrPedlRatChks AccrPedlRatCntr;
SIG_GROUP_ 384 AlrmSts 1 : AlrmStsAlrmFailr AlrmStsAlrmSt AlrmStsAlrmTrgSrc AlrmStsSnsrInclnFailr AlrmStsSnsrIntrScanrFailr;
SIG_GROUP_ 384 AmbTEstimd 1 : AmbTEstimdAmbTEstimd AmbTEstimdQf;
SIG_GROUP_ 960 AmbTIndcdWithUnit 1 : AmbTIndcdWithUnitAmbTIndcd AmbTIndcdWithUnitAmbTIndcdUnit AmbTIndcdWithUnitQF;
SIG_GROUP_ 384 BattFltStsPrim 1 : BattFltStsPrimBattFltStsPrm BattFltStsPrimChks BattFltStsPrimCntr;
SIG_GROUP_ 160 BLEKeySearchReq 1 : BLEKeySearchReqKeyLocn BLEKeySearchReqTirgger;
SIG_GROUP_ 384 BltLockStAtDrvr 1 : BltLockStAtDrvrBltLockSt1 BltLockStAtDrvrBltLockSts;
SIG_GROUP_ 384 BltLockStAtPass 1 : BltLockStAtPassBltLockSt1 BltLockStAtPassBltLockSts;
SIG_GROUP_ 720 BltLockStAtRowSecLe 1 : BltLockStAtRowSecLeBltLockEquid BltLockStAtRowSecLeBltLockSt1 BltLockStAtRowSecLeBltLockSts;
SIG_GROUP_ 720 BltLockStAtRowSecMid 1 : BltLockStAtRowSecMidBltLockEquid BltLockStAtRowSecMidBltLockSt1 BltLockStAtRowSecMidBltLockSts;
SIG_GROUP_ 720 BltLockStAtRowSecRi 1 : BltLockStAtRowSecRiBltLockEquid BltLockStAtRowSecRiBltLockSt1 BltLockStAtRowSecRiBltLockSts;
SIG_GROUP_ 720 BltLockStAtRowThrdLe 1 : BltLockStAtRowThrdLeBltLockEquid BltLockStAtRowThrdLeBltLockSt1 BltLockStAtRowThrdLeBltLockSts;
SIG_GROUP_ 720 BltLockStAtRowThrdRi 1 : BltLockStAtRowThrdRiBltLockEquid BltLockStAtRowThrdRiBltLockSt1 BltLockStAtRowThrdRiBltLockSts;
SIG_GROUP_ 160 BookTrvlTiSetReq 1 : BookTrvlTiSetReqBookTrvlChrgnTi BookTrvlTiSetReqBookTrvlTiSetReq;
SIG_GROUP_ 960 BrkFricTqTotAtWhlsAct 1 : BrkFricTqTotAtWhlsActBrkFricTqTotAtWhlsAct BrkFricTqTotAtWhlsActChks BrkFricTqTotAtWhlsActCntr;
SIG_GROUP_ 528 BrkLiOnReq 1 : BrkLiOnReqChks BrkLiOnReqCntr BrkLiOnReqSts;
SIG_GROUP_ 960 BrkPedlPsd 1 : BrkPedlPsdBrkPedlNotPsdSafe BrkPedlPsdBrkPedlPsd BrkPedlPsdChks BrkPedlPsdCntr BrkPedlPsdQf;
SIG_GROUP_ 960 BrkPedlrRat 1 : BrkPedlrRatPerc BrkPedlrRatQf;
SIG_GROUP_ 960 BrkPedlTrvl 1 : BrkPedlTrvlAct BrkPedlTrvlChks BrkPedlTrvlCntr BrkPedlTrvlQf BrkPedlTrvlSt BrkPedlTrvlStQf BrkPedlTrvlTar;
SIG_GROUP_ 896 CchForFuEco 1 : CchForFuEcoBarForFuEco CchForFuEcoGrdForFuEco;
SIG_GROUP_ 384 CmptmtAirTEstimdExtd 1 : CmptmtAirTEstimdExtdComptmtT CmptmtAirTEstimdExtdQlyFlg;
SIG_GROUP_ 896 CmptmtTFrnt 1 : CmptmtTFrntCmptmtTFrnt CmptmtTFrntFanForCmptmtTRunng CmptmtTFrntQf;
SIG_GROUP_ 960 CnclFaceReqGid1 1 : CnclFaceReqGid1Byte0 CnclFaceReqGid1Byte1 CnclFaceReqGid1Byte2 CnclFaceReqGid1Byte3 CnclFaceReqGid1Byte4 CnclFaceReqGid1Byte5 CnclFaceReqGid1Byte6 CnclFaceReqGid1Byte7;
SIG_GROUP_ 960 CnclFaceReqGid2 1 : CnclFaceReqGid2Byte0 CnclFaceReqGid2Byte1 CnclFaceReqGid2Byte2 CnclFaceReqGid2Byte3 CnclFaceReqGid2Byte4 CnclFaceReqGid2Byte5 CnclFaceReqGid2Byte6 CnclFaceReqGid2Byte7;
SIG_GROUP_ 160 CrashStsSafe 1 : CrashStsSafeChks CrashStsSafeCntr CrashStsSafeSts;
SIG_GROUP_ 160 DigKeyDataToRemCtrl 1 : DigKeyDataToRemCtrlAcknowledgment DigKeyDataToRemCtrlDKDataByte1 DigKeyDataToRemCtrlDKDataByte2 DigKeyDataToRemCtrlDKDataByte3 DigKeyDataToRemCtrlDKDataByte4 DigKeyDataToRemCtrlDKDataByte5 DigKeyDataToRemCtrlDKDataByte6 DigKeyDataToRemCtrlHeader;
SIG_GROUP_ 160 DKDataFromCEM 1 : DKDataFromCEMAcknowledgment DKDataFromCEMDKDataByte1 DKDataFromCEMDKDataByte2 DKDataFromCEMDKDataByte3 DKDataFromCEMDKDataByte4 DKDataFromCEMDKDataByte5 DKDataFromCEMDKDataByte6 DKDataFromCEMHeader;
SIG_GROUP_ 960 DstEstimdToEmptyForDrvgElecIndcd 1 : DstEstimdToEmptyForDrvgElecIndcdDstToEmpty DstEstimdToEmptyForDrvgElecIndcdDstUnit;
SIG_GROUP_ 960 DstToEmptyIndcd 1 : DstToEmptyIndcdDstToEmpty DstToEmptyIndcdDstUnit;
SIG_GROUP_ 896 EngSt1WdSts 1 : EngSt1WdStsChks EngSt1WdStsCntr EngSt1WdStsEngSt1WdSts;
SIG_GROUP_ 720 EpbLampReq 1 : EpbLampReqChks EpbLampReqCntr EpbLampReqEpbLampReq;
SIG_GROUP_ 528 ExtrLtgSts 1 : ExtrLtgStsAFS ExtrLtgStsAHBC ExtrLtgStsAHL ExtrLtgStsAllWL ExtrLtgStsApproach ExtrLtgStsChks ExtrLtgStsCntr ExtrLtgStsCornrgLi ExtrLtgStsDBL ExtrLtgStsDRL ExtrLtgStsFlash ExtrLtgStsFrntFog ExtrLtgStsGoodbye ExtrLtgStsHiBeam ExtrLtgStsHomeSafe ExtrLtgStsHWL ExtrLtgStsLoBeam ExtrLtgStsLtgShow ExtrLtgStsPosLiFrnt ExtrLtgStsPosLiRe ExtrLtgStsReFog ExtrLtgStsReverseLi ExtrLtgStsStopLi ExtrLtgStsTurnIndrLe ExtrLtgStsTurnIndrRi ExtrLtgStsWelcome;
SIG_GROUP_ 896 FileDelSts 1 : FileDelStsID FileDelStsSts;
SIG_GROUP_ 896 FileDwnldSts 1 : FileDwnldStsID FileDwnldStsSts;
SIG_GROUP_ 896 HmiStrangerModMenuSet 1 : HmiStrangerModMenuSetActvInActv HmiStrangerModMenuSetPasswordSt HmiStrangerModMenuSetPrivateLockSt HmiStrangerModMenuSetSpdLim;
SIG_GROUP_ 384 HvSysRlySts 1 : HvSysRlyStsChks HvSysRlyStsCntr HvSysRlyStsHvSysRlySts;
SIG_GROUP_ 384 ImobRemMgrChk 1 : ImobRemMgrChkImobDataRemMgrChk0 ImobRemMgrChkImobDataRemMgrChk1 ImobRemMgrChkImobDataRemMgrChk2 ImobRemMgrChkImobDataRemMgrChk3 ImobRemMgrChkImobDataRemMgrChk4 ImobRemMgrChkSts;
SIG_GROUP_ 384 ImobVehRemMgrSts1 1 : ImobVehRemMgrSts1ImobVehRemMgrSts ImobVehRemMgrSts1SpdLimRemMgrSts;
SIG_GROUP_ 384 MobDevRPAAuthentReq1 1 : MobDevRPAAuthentReq1AuthentSts MobDevRPAAuthentReq1Chks MobDevRPAAuthentReq1Cntr MobDevRPAAuthentReq1RndX MobDevRPAAuthentReq1RndY;
SIG_GROUP_ 384 MobDevRPABtnStsToAppGrp 1 : MobDevRPABtnStsToAppGrpPrkgInBtnSts MobDevRPABtnStsToAppGrpPrkgOutBtnSts MobDevRPABtnStsToAppGrpRemParkOutCrsSwtRsp;
SIG_GROUP_ 160 MobDevRPASts 1 : MobDevRPAStsOnOff1 MobDevRPAStsUInt8;
SIG_GROUP_ 896 MobileActvnSts 1 : MobileActvnStsID MobileActvnStsSts;
SIG_GROUP_ 160 NFCAndBLEKeyDiReq 1 : NFCAndBLEKeyDiReqData1 NFCAndBLEKeyDiReqData10 NFCAndBLEKeyDiReqData11 NFCAndBLEKeyDiReqData12 NFCAndBLEKeyDiReqData13 NFCAndBLEKeyDiReqData14 NFCAndBLEKeyDiReqData15 NFCAndBLEKeyDiReqData16 NFCAndBLEKeyDiReqData2 NFCAndBLEKeyDiReqData3 NFCAndBLEKeyDiReqData4 NFCAndBLEKeyDiReqData5 NFCAndBLEKeyDiReqData6 NFCAndBLEKeyDiReqData7 NFCAndBLEKeyDiReqData8 NFCAndBLEKeyDiReqData9;
SIG_GROUP_ 160 NFCKeySearchReq 1 : NFCKeySearchReqKeyLocn NFCKeySearchReqTirgger;
SIG_GROUP_ 384 ObstacleMinimumDistanceFrnt 1 : ObstacleMinimumDistanceFrntMinDst ObstacleMinimumDistanceFrntMinDstPosn ObstacleMinimumDistanceFrntStopDispReq;
SIG_GROUP_ 384 ObstacleMinimumDistanceRe 1 : ObstacleMinimumDistanceReMinDst ObstacleMinimumDistanceReMinDstPosn ObstacleMinimumDistanceReStopDispReq;
SIG_GROUP_ 528 PinionSteerAgGroup 1 : PinionSteerAgGroupChks PinionSteerAgGroupCntr PinionSteerAgGroupPinionSteerAg1 PinionSteerAgGroupPinionSteerAg1Qf PinionSteerAgGroupPinionSteerAgSpd1 PinionSteerAgGroupPinionSteerAgSpd1Qf PinionSteerAgGroupSteerWhlTq PinionSteerAgGroupSteerWhlTqQf;
SIG_GROUP_ 896 PosnBrief 1 : PosnBriefPosnLat PosnBriefPosnLgt;
SIG_GROUP_ 384 PrkgDispGroup 1 : PrkgDispGroupLeCornrCoornx PrkgDispGroupLeCornrCoorny PrkgDispGroupLeCornrLocn PrkgDispGroupPrkgTyp PrkgDispGroupRiCornrCoornx PrkgDispGroupRiCornrCoorny PrkgDispGroupStallNr;
SIG_GROUP_ 384 PrkgOutModBtnStsToAPP 1 : PrkgOutModBtnStsToAPPPrkgOutModBtnSts1 PrkgOutModBtnStsToAPPPrkgOutModBtnSts2 PrkgOutModBtnStsToAPPPrkgOutModBtnSts3 PrkgOutModBtnStsToAPPPrkgOutModBtnSts4 PrkgOutModBtnStsToAPPPrkgOutModBtnSts5 PrkgOutModBtnStsToAPPPrkgOutModBtnSts6;
SIG_GROUP_ 528 TiAndDateIndcn 1 : TiAndDateIndcnDataValid TiAndDateIndcnDay TiAndDateIndcnHr1 TiAndDateIndcnMins1 TiAndDateIndcnMth1 TiAndDateIndcnSec1 TiAndDateIndcnYr1;
SIG_GROUP_ 384 VehModMngtGlbSafe1 1 : VehModMngtGlbSafe1CarModSts1 VehModMngtGlbSafe1CarModSubtypWdCarModSubtyp VehModMngtGlbSafe1Chks VehModMngtGlbSafe1Cntr VehModMngtGlbSafe1EgyLvlElecMai VehModMngtGlbSafe1EgyLvlElecSubtyp VehModMngtGlbSafe1FltEgyCnsWdSts VehModMngtGlbSafe1PwrLvlElecMai VehModMngtGlbSafe1PwrLvlElecSubtyp VehModMngtGlbSafe1UsgModSts;
SIG_GROUP_ 528 VehNotifAndLedFltSts 1 : VehNotifAndLedFltStsByte0 VehNotifAndLedFltStsByte1 VehNotifAndLedFltStsByte2 VehNotifAndLedFltStsByte3 VehNotifAndLedFltStsByte4 VehNotifAndLedFltStsByte5 VehNotifAndLedFltStsByte6 VehNotifAndLedFltStsByte7;
SIG_GROUP_ 528 VehSpdLgt 1 : VehSpdLgtA VehSpdLgtChks VehSpdLgtCntr VehSpdLgtQf;
