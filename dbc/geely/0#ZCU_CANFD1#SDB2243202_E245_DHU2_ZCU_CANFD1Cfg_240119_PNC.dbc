VERSION "ZCU_CANFD1"

NS_ :

BS_ :

BU_ :  ASDM BBM ETC IHU ZCUD ZCUP

BO_ 306 AdcuToDhuSecOCFr01 : 64 ASDM
 SG_ AsyLgtCtrlTakeOverReq : 6|1@0+ (1,0) [0|1] "" IHU
 SG_ AsyLgtCtrlTakeOverReq_UB : 7|1@0+ (1,0) [0|1] "" IHU

BO_ 448 AdcuZCUCANFD1Fr01 : 64 ASDM
 SG_ AsySteerWhlHptcWarnReq : 8|1@0+ (1,0) [0|1] "" BBM,IHU
 SG_ AsySteerWhlHptcWarnReq_UB : 23|1@0+ (1,0) [0|1] "" BBM,IHU
 SG_ CllsnFwdWarn : 22|3@0+ (1,0) [0|7] "" IHU,ZCUD
 SG_ CllsnFwdWarn_UB : 19|1@0+ (1,0) [0|1] "" IHU,ZCUD
 SG_ LaneChgWarnSts : 18|1@0+ (1,0) [0|1] "" IHU
 SG_ LaneChgWarnSts_UB : 17|1@0+ (1,0) [0|1] "" IHU

BO_ 496 AdcuZCUCANFD1Fr02 : 64 ASDM
 SG_ ADDimLight : 45|3@0+ (1,0) [0|7] "" IHU
 SG_ ADDimLight_UB : 42|1@0+ (1,0) [0|1] "" IHU
 SG_ AsyAutDrvCtrlTyp : 71|3@0+ (1,0) [0|7] "" IHU,ZCUD
 SG_ AsyAutDrvCtrlTyp_UB : 40|1@0+ (1,0) [0|1] "" IHU,ZCUD
 SG_ AsyAutDrvgAvlSound : 68|5@0+ (1,0) [0|31] "" IHU
 SG_ AsyAutDrvgAvlSound_UB : 76|1@0+ (1,0) [0|1] "" IHU
 SG_ AsyEmgyLaneKeepAidSts : 79|3@0+ (1,0) [0|7] "" IHU,ZCUD
 SG_ AsyEmgyLaneKeepAidSts_UB : 75|1@0+ (1,0) [0|1] "" IHU,ZCUD
 SG_ AsyLanChgColorDsp : 74|3@0+ (1.0,0.0) [0.0|7.0] "Unitless" IHU
 SG_ AsyLanChgColorDsp_UB : 87|1@0+ (1,0) [0|1] "" IHU
 SG_ AsyLanChgMesg : 95|5@0+ (1.0,0.0) [0.0|31.0] "Unitless" IHU
 SG_ AsyLanChgMesg_UB : 86|1@0+ (1,0) [0|1] "" IHU
 SG_ AsyLanChgSod : 103|5@0+ (1.0,0.0) [0.0|31.0] "Unitless" IHU
 SG_ AsyLanChgSod_UB : 85|1@0+ (1,0) [0|1] "" IHU
 SG_ AsyLaneKeepAidSts : 90|3@0+ (1,0) [0|7] "" IHU
 SG_ AsyLaneKeepAidSts_UB : 84|1@0+ (1,0) [0|1] "" IHU
 SG_ AsyLatDegSts : 98|1@0+ (1,0) [0|1] "" IHU
 SG_ AsyLatDegSts_UB : 83|1@0+ (1,0) [0|1] "" IHU
 SG_ AsyLe2FirstEnd : 111|8@0+ (1.0,-30.0) [-30.0|225.0] "m" IHU
 SG_ AsyLe2FirstEnd_UB : 82|1@0+ (1,0) [0|1] "" IHU
 SG_ AsyLe2FirstStrt : 119|8@0+ (1.0,-30.0) [-30.0|225.0] "m" IHU
 SG_ AsyLe2FirstStrt_UB : 81|1@0+ (1,0) [0|1] "" IHU
 SG_ AsyLe2SecEnd : 127|8@0+ (1.0,-30.0) [-30.0|225.0] "m" IHU
 SG_ AsyLe2SecEnd_UB : 80|1@0+ (1,0) [0|1] "" IHU
 SG_ AsyLe2SecStrt : 135|8@0+ (1.0,-30.0) [-30.0|225.0] "m" IHU
 SG_ AsyLe2SecStrt_UB : 97|1@0+ (1,0) [0|1] "" IHU
 SG_ AsyLeFirstEnd : 143|8@0+ (1.0,-30.0) [-30.0|225.0] "m" IHU
 SG_ AsyLeFirstEnd_UB : 96|1@0+ (1,0) [0|1] "" IHU
 SG_ AsyLeFirstStrt : 151|8@0+ (1.0,-30.0) [-30.0|225.0] "m" IHU
 SG_ AsyLeFirstStrt_UB : 175|1@0+ (1,0) [0|1] "" IHU
 SG_ AsyLeSecEnd : 159|8@0+ (1.0,-30.0) [-30.0|225.0] "m" IHU
 SG_ AsyLeSecEnd_UB : 174|1@0+ (1,0) [0|1] "" IHU
 SG_ AsyLeSecStrt : 167|8@0+ (1.0,-30.0) [-30.0|225.0] "m" IHU
 SG_ AsyLeSecStrt_UB : 173|1@0+ (1,0) [0|1] "" IHU
 SG_ AsyLineDstLe : 183|8@0+ (0.1,-12.7) [-12.7|12.700000000000003] "m" IHU
 SG_ AsyLineDstLe_UB : 195|1@0+ (1,0) [0|1] "" IHU
 SG_ AsyLineDstRi : 191|8@0+ (0.1,-12.7) [-12.7|12.700000000000003] "m" IHU
 SG_ AsyLineDstRi_UB : 194|1@0+ (1,0) [0|1] "" IHU
 SG_ AsyLineLe2Color : 199|4@0+ (1,0) [0|15] "" IHU
 SG_ AsyLineLe2Color_UB : 193|1@0+ (1,0) [0|1] "" IHU
 SG_ AsyLineLe2Pah_UB : 192|1@0+ (1,0) [0|1] "" IHU
 SG_ AsyLineLe2Pah2_UB : 240|1@0+ (1,0) [0|1] "" IHU
 SG_ AsyLineLe2Pah2PrmA : 255|13@0+ (0.01,-30.0) [-30.0|30.0] "m" IHU
 SG_ AsyLineLe2Pah2PrmB : 279|12@0+ (0.001,-1.6) [-1.6|1.6] "rad" IHU
 SG_ AsyLineLe2Pah2PrmC : 258|11@0+ (0.0001,-0.1) [-0.1|0.1] "1/m" IHU
 SG_ AsyLineLe2Pah2PrmD : 283|11@0+ (0.000001,-0.001) [-0.001|0.001] "1/m^2" IHU
 SG_ AsyLineLe2PahPrmA : 207|13@0+ (0.01,-30.0) [-30.0|30.0] "m" IHU
 SG_ AsyLineLe2PahPrmB : 231|12@0+ (0.001,-1.6) [-1.6|1.6] "rad" IHU
 SG_ AsyLineLe2PahPrmC : 210|11@0+ (0.0001,-0.1) [-0.1|0.1] "1/m" IHU
 SG_ AsyLineLe2PahPrmD : 235|11@0+ (0.000001,-0.001) [-0.001|0.001] "1/m^2" IHU
 SG_ AsyLineLe2RampPosn : 303|8@0+ (1.0,-30.0) [-30.0|225.0] "m" IHU
 SG_ AsyLineLe2RampPosn_UB : 288|1@0+ (1,0) [0|1] "" IHU
 SG_ AsyLineLe2RampTyp : 311|3@0+ (1,0) [0|7] "" IHU
 SG_ AsyLineLe2RampTyp_UB : 308|1@0+ (1,0) [0|1] "" IHU
 SG_ AsyLineLe2Typ : 307|4@0+ (1,0) [0|15] "" IHU
 SG_ AsyLineLe2Typ_UB : 315|1@0+ (1,0) [0|1] "" IHU
 SG_ AsyLineLeColor : 319|4@0+ (1,0) [0|15] "" IHU
 SG_ AsyLineLeColor_UB : 314|1@0+ (1,0) [0|1] "" IHU
 SG_ AsyLineLePah_UB : 313|1@0+ (1,0) [0|1] "" IHU
 SG_ AsyLineLePah2_UB : 360|1@0+ (1,0) [0|1] "" IHU
 SG_ AsyLineLePah2PrmA : 375|13@0+ (0.01,-30.0) [-30.0|30.0] "m" IHU
 SG_ AsyLineLePah2PrmB : 399|12@0+ (0.001,-1.6) [-1.6|1.6] "rad" IHU
 SG_ AsyLineLePah2PrmC : 378|11@0+ (0.0001,-0.1) [-0.1|0.1] "1/m" IHU
 SG_ AsyLineLePah2PrmD : 403|11@0+ (0.000001,-0.001) [-0.001|0.001] "1/m^2" IHU
 SG_ AsyLineLePahPrmA : 327|13@0+ (0.01,-30.0) [-30.0|30.0] "m" IHU
 SG_ AsyLineLePahPrmB : 351|12@0+ (0.001,-1.6) [-1.6|1.6] "rad" IHU
 SG_ AsyLineLePahPrmC : 330|11@0+ (0.0001,-0.1) [-0.1|0.1] "1/m" IHU
 SG_ AsyLineLePahPrmD : 355|11@0+ (0.000001,-0.001) [-0.001|0.001] "1/m^2" IHU
 SG_ AsyLineLeRampPosn : 423|8@0+ (1.0,-30.0) [-30.0|225.0] "m" IHU
 SG_ AsyLineLeRampPosn_UB : 408|1@0+ (1,0) [0|1] "" IHU
 SG_ AsyLineLeRampTyp : 431|3@0+ (1,0) [0|7] "" IHU
 SG_ AsyLineLeRampTyp_UB : 428|1@0+ (1,0) [0|1] "" IHU
 SG_ AsyLineLeTyp : 427|4@0+ (1,0) [0|15] "" IHU
 SG_ AsyLineLeTyp_UB : 480|1@0+ (1,0) [0|1] "" IHU
 SG_ AsyLineRi2Color : 439|4@0+ (1,0) [0|15] "" IHU
 SG_ AsyLineRi2Color_UB : 312|1@0+ (1,0) [0|1] "" IHU
 SG_ AsyLineRi2Pah_UB : 435|1@0+ (1,0) [0|1] "" IHU
 SG_ AsyLineRi2PahPrmA : 447|13@0+ (0.01,-30.0) [-30.0|30.0] "m" IHU
 SG_ AsyLineRi2PahPrmB : 471|12@0+ (0.001,-1.6) [-1.6|1.6] "rad" IHU
 SG_ AsyLineRi2PahPrmC : 450|11@0+ (0.0001,-0.1) [-0.1|0.1] "1/m" IHU
 SG_ AsyLineRi2PahPrmD : 475|11@0+ (0.000001,-0.001) [-0.001|0.001] "1/m^2" IHU
 SG_ AsyLineRi2RampPosn : 495|8@0+ (1.0,-30.0) [-30.0|225.0] "m" IHU
 SG_ AsyLineRi2RampPosn_UB : 434|1@0+ (1,0) [0|1] "" IHU
 SG_ AsyLineRi2RampTyp : 503|3@0+ (1,0) [0|7] "" IHU
 SG_ AsyLineRi2RampTyp_UB : 500|1@0+ (1,0) [0|1] "" IHU
 SG_ AsyLineRi2Typ : 499|4@0+ (1,0) [0|15] "" IHU
 SG_ AsyLineRi2Typ_UB : 433|1@0+ (1,0) [0|1] "" IHU
 SG_ AsyLineRiColor : 511|4@0+ (1,0) [0|15] "" IHU
 SG_ AsyLineRiColor_UB : 432|1@0+ (1,0) [0|1] "" IHU
 SG_ AsyLineRiRampTyp : 507|3@0+ (1,0) [0|7] "" IHU
 SG_ AsyLineRiRampTyp_UB : 504|1@0+ (1,0) [0|1] "" IHU
 SG_ AsyNoaActvSuggest : 170|1@0+ (1,0) [0|1] "" IHU
 SG_ AsyNoaActvSuggest_UB : 169|1@0+ (1,0) [0|1] "" IHU

BO_ 752 AdcuZCUCANFD1Fr03 : 64 ASDM
 SG_ AccFusnTrfcSgn : 7|1@0+ (1,0) [0|1] "" IHU
 SG_ AccFusnTrfcSgn_UB : 6|1@0+ (1,0) [0|1] "" IHU
 SG_ ActvSafeCtrlrSts : 5|3@0+ (1,0) [0|7] "" IHU
 SG_ ActvSafeCtrlrSts_UB : 2|1@0+ (1,0) [0|1] "" IHU
 SG_ AsyEmgyLaneKeepAid : 31|1@0+ (1,0) [0|1] "" IHU
 SG_ AsyEmgyLaneKeepAid_UB : 30|1@0+ (1,0) [0|1] "" IHU
 SG_ AsyEmgyManoeuvreAidSts : 29|3@0+ (1,0) [0|7] "" IHU
 SG_ AsyEmgyManoeuvreAidSts_UB : 26|1@0+ (1,0) [0|1] "" IHU
 SG_ AsyFctnIhbtByTrlr : 25|1@0+ (1,0) [0|1] "" IHU
 SG_ AsyFctnIhbtByTrlr_UB : 24|1@0+ (1,0) [0|1] "" IHU
 SG_ AsyLaneChgWarnMod : 39|2@0+ (1,0) [0|3] "" IHU
 SG_ AsyLaneChgWarnMod_UB : 37|1@0+ (1,0) [0|1] "" IHU
 SG_ AsySftyFctStsToEDR_UB : 137|1@0+ (1,0) [0|1] "" ZCUD
 SG_ AsySftyFctStsToEDRACCFctSTs : 111|3@0+ (1,0) [0|7] "" ZCUD
 SG_ AsySftyFctStsToEDRACSFB1FctSts : 108|3@0+ (1,0) [0|7] "" ZCUD
 SG_ AsySftyFctStsToEDRACSFB2FctSts : 119|3@0+ (1,0) [0|7] "" ZCUD
 SG_ AsySftyFctStsToEDRACSFCFctSts : 116|3@0+ (1,0) [0|7] "" ZCUD
 SG_ AsySftyFctStsToEDRACSFDFctSts : 127|3@0+ (1,0) [0|7] "" ZCUD
 SG_ AsySftyFctStsToEDRACSFEFctSts : 124|3@0+ (1,0) [0|7] "" ZCUD
 SG_ AsySftyFctStsToEDRAEBSFctSts : 135|3@0+ (1,0) [0|7] "" ZCUD
 SG_ AsySftyFctStsToEDRCSFFctSts : 132|3@0+ (1,0) [0|7] "" ZCUD
 SG_ AsySftyFctStsToEDRESFFctSts : 143|3@0+ (1,0) [0|7] "" ZCUD
 SG_ AsySftyFctStsToEDRLDWSFctSts : 140|3@0+ (1,0) [0|7] "" ZCUD
 SG_ AsySftyHWLReq : 36|2@0+ (1,0) [0|3] "" IHU,ZCUD
 SG_ AsySftyHWLReq_UB : 34|1@0+ (1,0) [0|1] "" IHU,ZCUD
 SG_ CllsnAidPostEMA : 55|1@0+ (1,0) [0|1] "" IHU
 SG_ CllsnAidPostEMA_UB : 54|1@0+ (1,0) [0|1] "" IHU
 SG_ CllsnMtgtnFctSts : 53|3@0+ (1,0) [0|7] "" IHU,ZCUD
 SG_ CllsnMtgtnFctSts_UB : 50|1@0+ (1,0) [0|1] "" IHU,ZCUD
 SG_ CllsnMtgtnWarnSts : 63|3@0+ (1,0) [0|7] "" IHU
 SG_ CllsnMtgtnWarnSts_UB : 60|1@0+ (1,0) [0|1] "" IHU
 SG_ CllsnWarnReOn1 : 59|2@0+ (1,0) [0|3] "" IHU
 SG_ CllsnWarnReOn1_UB : 57|1@0+ (1,0) [0|1] "" IHU
 SG_ CpmOn1 : 49|1@0+ (1,0) [0|1] "" IHU
 SG_ CpmOn1_UB : 48|1@0+ (1,0) [0|1] "" IHU
 SG_ CtraOn1 : 71|2@0+ (1,0) [0|3] "" IHU
 SG_ CtraOn1_UB : 56|1@0+ (1,0) [0|1] "" IHU
 SG_ CtryForRoadSgnInfo : 65|10@0+ (1.0,0.0) [0.0|1023.0] "Unitless" IHU
 SG_ CtryForRoadSgnInfo_UB : 69|1@0+ (1,0) [0|1] "" IHU
 SG_ DoorOpenwarnOn1 : 41|2@0+ (1,0) [0|3] "" IHU
 SG_ DoorOpenwarnOn1_UB : 32|1@0+ (1,0) [0|1] "" IHU
 SG_ LaneChgAutActvSts : 68|1@0+ (1,0) [0|1] "" IHU
 SG_ LaneChgAutActvSts_UB : 67|1@0+ (1,0) [0|1] "" IHU
 SG_ LcmaAudWarn : 66|1@0+ (1,0) [0|1] "" IHU
 SG_ LcmaAudWarn_UB : 0|1@0+ (1,0) [0|1] "" IHU
 SG_ RoadMiscSgnInfoSts : 87|1@0+ (1,0) [0|1] "" IHU
 SG_ RoadMiscSgnInfoSts_UB : 86|1@0+ (1,0) [0|1] "" IHU
 SG_ RsdsSysSts : 85|3@0+ (1,0) [0|7] "" IHU
 SG_ RsdsSysSts_UB : 82|1@0+ (1,0) [0|1] "" IHU
 SG_ SpdAlrmActvSts : 81|2@0+ (1,0) [0|3] "" IHU
 SG_ SpdAlrmActvSts_UB : 95|1@0+ (1,0) [0|1] "" IHU
 SG_ SpdLimCamFirst : 94|1@0+ (1,0) [0|1] "" IHU
 SG_ SpdLimCamFirst_UB : 93|1@0+ (1,0) [0|1] "" IHU
 SG_ SpdLimUnit : 92|1@0+ (1,0) [0|1] "" BBM,IHU,ZCUD
 SG_ SpdLimUnit_UB : 91|1@0+ (1,0) [0|1] "" BBM,IHU,ZCUD
 SG_ TrfcInfoMiscFirst : 102|4@0+ (1,0) [0|15] "" IHU
 SG_ TrfcInfoMiscFirst_UB : 98|1@0+ (1,0) [0|1] "" IHU

BO_ 416 AdcuZCUCANFD1Fr04 : 64 ASDM
 SG_ AdjSpdLimnActvnOk : 167|1@0+ (1,0) [0|1] "" IHU
 SG_ AdjSpdLimnActvnOk_UB : 166|1@0+ (1,0) [0|1] "" IHU
 SG_ AdjSpdLimnMsg : 165|2@0+ (1,0) [0|3] "" IHU
 SG_ AdjSpdLimnMsg_UB : 163|1@0+ (1,0) [0|1] "" IHU
 SG_ AdjSpdLimnStbOk : 339|1@0+ (1,0) [0|1] "" IHU
 SG_ AdjSpdLimnStbOk_UB : 338|1@0+ (1,0) [0|1] "" IHU
 SG_ AdjSpdLimnSts : 343|3@0+ (1,0) [0|7] "" IHU
 SG_ AdjSpdLimnSts_UB : 340|1@0+ (1,0) [0|1] "" IHU
 SG_ ADThemeDisp : 7|2@0+ (1,0) [0|3] "" IHU
 SG_ ADThemeDisp_UB : 5|1@0+ (1,0) [0|1] "" IHU
 SG_ AsyALgtCtrlMod_UB : 242|1@0+ (1,0) [0|1] "" BBM,IHU
 SG_ AsyALgtCtrlMod1 : 255|4@0+ (1,0) [0|15] "" BBM,IHU
 SG_ AsyALgtCtrlModChks : 263|8@0+ (1.0,0.0) [0.0|255.0] "Unitless" BBM,IHU
 SG_ AsyALgtCtrlModCntr : 251|4@0+ (1.0,0.0) [0.0|15.0] "Unitless" BBM,IHU
 SG_ AsyALgtReqForCmft_UB : 241|1@0+ (1,0) [0|1] "" BBM,IHU
 SG_ AsyALgtReqForCmftAsyCmftLgtNegLimForJerk : 271|13@0+ (0.01,-30.0) [-30.0|30.0] "m/s^3" BBM,IHU
 SG_ AsyALgtReqForCmftAsyCmftLgtPosLimForJerk : 287|13@0+ (0.01,-30.0) [-30.0|30.0] "m/s^3" BBM,IHU
 SG_ AsyALgtReqForCmftMax : 303|12@0+ (0.01,-12.0) [-12.0|12.0] "m/s^2" BBM,IHU
 SG_ AsyALgtReqForCmftMin : 307|12@0+ (0.01,-12.0) [-12.0|12.0] "m/s^2" BBM,IHU
 SG_ AsyALgtSts_UB : 240|1@0+ (1,0) [0|1] "" BBM,IHU,ZCUD
 SG_ AsyALgtStsAsyALgtSts : 327|4@0+ (1,0) [0|15] "" BBM,IHU,ZCUD
 SG_ AsyALgtStsChks : 335|8@0+ (1.0,0.0) [0.0|255.0] "Unitless" BBM,IHU,ZCUD
 SG_ AsyALgtStsCntr : 323|4@0+ (1.0,0.0) [0.0|15.0] "Unitless" BBM,IHU,ZCUD
 SG_ AsyLatCtrlModReqGroup_UB : 4|1@0+ (1,0) [0|1] "" BBM,IHU
 SG_ AsyLatCtrlModReqGroupAsyLatCtrlModReq : 15|4@0+ (1,0) [0|15] "" BBM,IHU
 SG_ AsyLatCtrlModReqGroupChks : 23|8@0+ (1.0,0.0) [0.0|255.0] "Unitless" BBM,IHU
 SG_ AsyLatCtrlModReqGroupCntr : 11|4@0+ (1.0,0.0) [0.0|15.0] "Unitless" BBM,IHU
 SG_ AsySftyEnaDecelByDBS_UB : 178|1@0+ (1,0) [0|1] "" BBM,IHU
 SG_ AsySftyEnaDecelByDBSAsySftyEnaDecelByDBS : 179|1@0+ (1,0) [0|1] "" BBM,IHU
 SG_ AsySftyEnaDecelByDBSChks : 175|8@0+ (1.0,0.0) [0.0|255.0] "Unitless" BBM,IHU
 SG_ AsySftyEnaDecelByDBSCntr : 183|4@0+ (1.0,0.0) [0.0|15.0] "Unitless" BBM,IHU
 SG_ AsyStandStillReqForCmft : 337|1@0+ (1,0) [0|1] "" BBM,IHU
 SG_ AsyStandStillReqForCmft_UB : 336|1@0+ (1,0) [0|1] "" BBM,IHU
 SG_ BrkHptcWarnReqForAutDrv_UB : 162|1@0+ (1,0) [0|1] "" BBM,IHU
 SG_ BrkHptcWarnReqForAutDrvBrkHptcWarnReqForAutDrv : 177|2@0+ (1,0) [0|3] "" BBM,IHU
 SG_ BrkHptcWarnReqForAutDrvChks : 191|8@0+ (1.0,0.0) [0.0|255.0] "Unitless" BBM,IHU
 SG_ BrkHptcWarnReqForAutDrvCntr : 199|4@0+ (1.0,0.0) [0.0|15.0] "Unitless" BBM,IHU
 SG_ CllsnThreat : 217|2@0+ (1,0) [0|3] "" IHU,ZCUD
 SG_ CllsnThreat_UB : 218|1@0+ (1,0) [0|1] "" IHU,ZCUD
 SG_ CnclWarnForAutDrv : 3|2@0+ (1,0) [0|3] "" IHU
 SG_ CnclWarnForAutDrv_UB : 1|1@0+ (1,0) [0|1] "" IHU
 SG_ DispSpdSetForLgtCtrl : 195|12@0+ (0.03125,0.0) [0.0|125.0] "m/s" IHU
 SG_ DispSpdSetForLgtCtrl_UB : 161|1@0+ (1,0) [0|1] "" IHU
 SG_ DispTSIInfoForLgtCtrl : 127|2@0+ (1,0) [0|3] "" IHU
 SG_ DispTSIInfoForLgtCtrl_UB : 160|1@0+ (1,0) [0|1] "" IHU
 SG_ DrvOffReqForLgtCtrl : 93|1@0+ (1,0) [0|1] "" BBM,IHU
 SG_ DrvOffReqForLgtCtrl_UB : 92|1@0+ (1,0) [0|1] "" BBM,IHU
 SG_ FctaIndcnLe : 63|2@0+ (1,0) [0|3] "" IHU,ZCUD
 SG_ FctaIndcnLe_UB : 61|1@0+ (1,0) [0|1] "" IHU,ZCUD
 SG_ FctaIndcnRi : 95|2@0+ (1,0) [0|3] "" IHU,ZCUD
 SG_ FctaIndcnRi_UB : 60|1@0+ (1,0) [0|1] "" IHU,ZCUD
 SG_ LimSts : 371|2@0+ (1,0) [0|3] "" IHU
 SG_ LimSts_UB : 369|1@0+ (1,0) [0|1] "" IHU
 SG_ NonTrvrsbleRoadEdgeOnLeft : 31|1@0+ (1,0) [0|1] "" IHU
 SG_ NonTrvrsbleRoadEdgeOnLeft_UB : 0|1@0+ (1,0) [0|1] "" IHU
 SG_ NonTrvrsbleRoadEdgeOnRight : 30|1@0+ (1,0) [0|1] "" IHU
 SG_ NonTrvrsbleRoadEdgeOnRight_UB : 29|1@0+ (1,0) [0|1] "" IHU
 SG_ ObjFrnt1_UB : 28|1@0+ (1,0) [0|1] "" IHU
 SG_ ObjFrnt1ColorOfObjFrnt1 : 27|4@0+ (1,0) [0|15] "" IHU
 SG_ ObjFrnt1DstLatOfObjFrnt1 : 39|8@0+ (0.1,-12.7) [-12.7|12.700000000000003] "m" IHU
 SG_ ObjFrnt1DstLgtOfObjFrnt1 : 47|8@0+ (1.0,-30.0) [-30.0|225.0] "m" IHU
 SG_ ObjFrnt1HdDirOfObjFrnt1 : 55|3@0+ (1,0) [0|7] "" IHU
 SG_ ObjFrnt1TypOfObjFrnt1 : 52|4@0+ (1,0) [0|15] "" IHU
 SG_ ObjFrnt2_UB : 80|1@0+ (1,0) [0|1] "" IHU
 SG_ ObjFrnt2ColorOfObjFrnt2 : 59|4@0+ (1,0) [0|15] "" IHU
 SG_ ObjFrnt2DstLatOfObjFrnt2 : 71|8@0+ (0.1,-12.7) [-12.7|12.700000000000003] "m" IHU
 SG_ ObjFrnt2DstLgtOfObjFrnt2 : 79|8@0+ (1.0,-30.0) [-30.0|225.0] "m" IHU
 SG_ ObjFrnt2HdDirOfObjFrnt2 : 87|3@0+ (1,0) [0|7] "" IHU
 SG_ ObjFrnt2TypOfObjFrnt2 : 84|4@0+ (1,0) [0|15] "" IHU
 SG_ ObjFrntLe_UB : 48|1@0+ (1,0) [0|1] "" IHU
 SG_ ObjFrntLeColorOfObjFrntLe : 91|4@0+ (1,0) [0|15] "" IHU
 SG_ ObjFrntLeDstLatOfObjFrntLe : 103|8@0+ (0.1,-12.7) [-12.7|12.700000000000003] "m" IHU
 SG_ ObjFrntLeDstLgtOfObjFrntLe : 111|8@0+ (1.0,-30.0) [-30.0|225.0] "m" IHU
 SG_ ObjFrntLeHdDirOfObjFrntLe : 119|3@0+ (1,0) [0|7] "" IHU
 SG_ ObjFrntLeTypOfObjFrntLe : 116|4@0+ (1,0) [0|15] "" IHU
 SG_ ObjFrntRi_UB : 112|1@0+ (1,0) [0|1] "" IHU
 SG_ ObjFrntRiColorOfObjFrntRi : 123|4@0+ (1,0) [0|15] "" IHU
 SG_ ObjFrntRiDstLatOfObjFrntRi : 135|8@0+ (0.1,-12.7) [-12.7|12.700000000000003] "m" IHU
 SG_ ObjFrntRiDstLgtOfObjFrntRi : 143|8@0+ (1.0,-30.0) [-30.0|225.0] "m" IHU
 SG_ ObjFrntRiHdDirOfObjFrntRi : 151|3@0+ (1,0) [0|7] "" IHU
 SG_ ObjFrntRiTypOfObjFrntRi : 148|4@0+ (1,0) [0|15] "" IHU
 SG_ PtVehSpdMax_UB : 363|1@0+ (1,0) [0|1] "" IHU
 SG_ PtVehSpdMaxChks : 351|8@0+ (1.0,0.0) [0.0|255.0] "Unitless" IHU
 SG_ PtVehSpdMaxCntr : 367|4@0+ (1.0,0.0) [0.0|15.0] "Unitless" IHU
 SG_ PtVehSpdMaxReq : 359|8@0+ (0.4,0.0) [0.0|102.0] "m/s" IHU
 SG_ RcwmBrkReq_UB : 124|1@0+ (1,0) [0|1] "" BBM,IHU
 SG_ RcwmBrkReqChks : 215|8@0+ (1.0,0.0) [0.0|255.0] "Unitless" BBM,IHU
 SG_ RcwmBrkReqCntr : 223|4@0+ (1.0,0.0) [0.0|15.0] "Unitless" BBM,IHU
 SG_ RcwmBrkReqRcwmBrkReq : 219|1@0+ (1,0) [0|1] "" BBM,IHU
 SG_ RoadSgnInfoSts : 375|3@0+ (1,0) [0|7] "" IHU,ZCUD
 SG_ RoadSgnInfoSts_UB : 372|1@0+ (1,0) [0|1] "" IHU,ZCUD
 SG_ SftyDecelGroupSafe_UB : 125|1@0+ (1,0) [0|1] "" BBM,IHU,ZCUD
 SG_ SftyDecelGroupSafeAsySftyDecelReq : 231|8@0+ (0.1,0.0) [0.0|15.0] "m/s^2" BBM,IHU,ZCUD
 SG_ SftyDecelGroupSafeAsySftyEnaDecel : 243|1@0+ (1,0) [0|1] "" BBM,IHU,ZCUD
 SG_ SftyDecelGroupSafeChks : 239|8@0+ (1.0,0.0) [0.0|255.0] "Unitless" BBM,IHU,ZCUD
 SG_ SftyDecelGroupSafeCntr : 247|4@0+ (1.0,0.0) [0.0|15.0] "Unitless" BBM,IHU,ZCUD
 SG_ SpdLimFirst : 159|8@0+ (1.0,0.0) [0.0|255.0] "Unitless" BBM,IHU,ZCUD
 SG_ SpdLimFirst_UB : 144|1@0+ (1,0) [0|1] "" BBM,IHU,ZCUD

BO_ 1152 AdcuZCUCANFD1Fr05 : 64 ASDM
 SG_ AgCtrlTqLowrLim : 7|9@0+ (0.125,-30.0) [-30.0|30.0] "Nm" IHU
 SG_ AgCtrlTqLowrLim_UB : 14|1@0+ (1,0) [0|1] "" IHU
 SG_ AgCtrlTqUpprLim : 8|9@0+ (0.125,-30.0) [-30.0|30.0] "Nm" IHU
 SG_ AgCtrlTqUpprLim_UB : 9|1@0+ (1,0) [0|1] "" IHU
 SG_ AsyObjForBigData1_UB : 13|1@0+ (1,0) [0|1] "" IHU
 SG_ AsyObjForBigData1AbsLatSpd : 31|7@0+ (0.25,-16.0) [-16.0|15.75] "m/s" IHU
 SG_ AsyObjForBigData1AbsLgtSpd : 24|9@0+ (0.25,0.0) [0.0|125.0] "m/s" IHU
 SG_ AsyObjForBigData1Confidence : 47|7@0+ (0.01,0.0) [0.0|1.0] "Unitless" IHU
 SG_ AsyObjForBigData1RlvtLatDst : 40|9@0+ (0.1,-25.0) [-25.0|25.0] "m" IHU
 SG_ AsyObjForBigData1RlvtLgtDst : 63|11@0+ (0.1,0.0) [0.0|150.0] "m" IHU
 SG_ AsyObjForBigData1SnsrSrcOfAbsLatSpd : 68|2@0+ (1,0) [0|3] "" IHU
 SG_ AsyObjForBigData1SnsrSrcOfAbsLgtSpd : 66|2@0+ (1,0) [0|3] "" IHU
 SG_ AsyObjForBigData1TTC : 79|7@0+ (0.05,0.0) [0.0|6.3500000000000005] "s" IHU
 SG_ AsyObjForBigData1Type : 87|4@0+ (1,0) [0|15] "" IHU
 SG_ AsyObjForBigData2_UB : 12|1@0+ (1,0) [0|1] "" IHU
 SG_ AsyObjForBigData2AbsLatSpd : 95|7@0+ (0.25,-16.0) [-16.0|15.75] "m/s" IHU
 SG_ AsyObjForBigData2AbsLgtSpd : 88|9@0+ (0.25,0.0) [0.0|125.0] "m/s" IHU
 SG_ AsyObjForBigData2Confidence : 111|7@0+ (0.01,0.0) [0.0|1.0] "Unitless" IHU
 SG_ AsyObjForBigData2RlvtLatDst : 104|9@0+ (0.1,-25.0) [-25.0|25.0] "m" IHU
 SG_ AsyObjForBigData2RlvtLgtDst : 127|11@0+ (0.1,0.0) [0.0|150.0] "m" IHU
 SG_ AsyObjForBigData2SnsrSrcOfAbsLatSpd : 132|2@0+ (1,0) [0|3] "" IHU
 SG_ AsyObjForBigData2SnsrSrcOfAbsLgtSpd : 130|2@0+ (1,0) [0|3] "" IHU
 SG_ AsyObjForBigData2TTC : 143|7@0+ (0.05,0.0) [0.0|6.3500000000000005] "s" IHU
 SG_ AsyObjForBigData2Type : 151|4@0+ (1,0) [0|15] "" IHU
 SG_ AsyPinionAgReqSafe_UB : 147|1@0+ (1,0) [0|1] "" IHU
 SG_ AsyPinionAgReqSafeAsyPinionAgReq : 159|15@0+ (0.0009765625,-14.5) [-14.5|17.4990234375] "rad" IHU
 SG_ AsyPinionAgReqSafeAsyPinionAgReqChks : 175|8@0+ (1.0,0.0) [0.0|255.0] "Unitless" IHU
 SG_ AsyPinionAgReqSafeAsyPinionAgReqCntr : 183|4@0+ (1.0,0.0) [0.0|15.0] "Unitless" IHU
 SG_ ExtLiData_UB : 179|1@0+ (1,0) [0|1] "" IHU
 SG_ ExtLiDataDayNight : 190|2@0+ (1,0) [0|3] "" IHU
 SG_ ExtLiDataHiWay : 188|1@0+ (1,0) [0|1] "" IHU
 SG_ ExtLiDataInCity : 187|1@0+ (1,0) [0|1] "" IHU
 SG_ ExtLiDataInTunnel : 186|1@0+ (1,0) [0|1] "" IHU
 SG_ ExtLiDataTiStamp : 199|32@0+ (0.0001,0.0) [0.0|429496.7295] "s" IHU
 SG_ ExtLiDataTrfcSide : 185|2@0+ (1,0) [0|3] "" IHU
 SG_ RctaBrkReqQM : 11|1@0+ (1,0) [0|1] "" IHU
 SG_ RctaBrkReqQM_UB : 10|1@0+ (1,0) [0|1] "" IHU

BO_ 511 AdcuZCUCANFD1Fr06 : 64 ASDM
 SG_ AsyLineRi2Pah2_UB : 7|1@0+ (1,0) [0|1] "" IHU
 SG_ AsyLineRi2Pah2PrmA : 15|13@0+ (0.01,-30.0) [-30.0|30.0] "m" IHU
 SG_ AsyLineRi2Pah2PrmB : 39|12@0+ (0.001,-1.6) [-1.6|1.6] "rad" IHU
 SG_ AsyLineRi2Pah2PrmC : 18|11@0+ (0.0001,-0.1) [-0.1|0.1] "1/m" IHU
 SG_ AsyLineRi2Pah2PrmD : 43|11@0+ (0.000001,-0.001) [-0.001|0.001] "1/m^2" IHU
 SG_ AsyLineRiPah_UB : 48|1@0+ (1,0) [0|1] "" IHU
 SG_ AsyLineRiPah2_UB : 96|1@0+ (1,0) [0|1] "" IHU
 SG_ AsyLineRiPah2PrmA : 111|13@0+ (0.01,-30.0) [-30.0|30.0] "m" IHU
 SG_ AsyLineRiPah2PrmB : 135|12@0+ (0.001,-1.6) [-1.6|1.6] "rad" IHU
 SG_ AsyLineRiPah2PrmC : 114|11@0+ (0.0001,-0.1) [-0.1|0.1] "1/m" IHU
 SG_ AsyLineRiPah2PrmD : 139|11@0+ (0.000001,-0.001) [-0.001|0.001] "1/m^2" IHU
 SG_ AsyLineRiPahPrmA : 63|13@0+ (0.01,-30.0) [-30.0|30.0] "m" IHU
 SG_ AsyLineRiPahPrmB : 87|12@0+ (0.001,-1.6) [-1.6|1.6] "rad" IHU
 SG_ AsyLineRiPahPrmC : 66|11@0+ (0.0001,-0.1) [-0.1|0.1] "1/m" IHU
 SG_ AsyLineRiPahPrmD : 91|11@0+ (0.000001,-0.001) [-0.001|0.001] "1/m^2" IHU
 SG_ AsyLineRiRampPosn : 159|8@0+ (1.0,-30.0) [-30.0|225.0] "m" IHU
 SG_ AsyLineRiRampPosn_UB : 144|1@0+ (1,0) [0|1] "" IHU
 SG_ AsyLineRiTyp : 167|4@0+ (1,0) [0|15] "" IHU
 SG_ AsyLineRiTyp_UB : 6|1@0+ (1,0) [0|1] "" IHU
 SG_ AsyRi2FirstEnd : 175|8@0+ (1.0,-30.0) [-30.0|225.0] "m" IHU
 SG_ AsyRi2FirstEnd_UB : 5|1@0+ (1,0) [0|1] "" IHU
 SG_ AsyRi2FirstStrt : 183|8@0+ (1.0,-30.0) [-30.0|225.0] "m" IHU
 SG_ AsyRi2FirstStrt_UB : 4|1@0+ (1,0) [0|1] "" IHU
 SG_ AsyRi2SecEnd : 191|8@0+ (1.0,-30.0) [-30.0|225.0] "m" IHU
 SG_ AsyRi2SecEnd_UB : 3|1@0+ (1,0) [0|1] "" IHU
 SG_ AsyRi2SecStrt : 199|8@0+ (1.0,-30.0) [-30.0|225.0] "m" IHU
 SG_ AsyRi2SecStrt_UB : 2|1@0+ (1,0) [0|1] "" IHU
 SG_ AsyRiFirstEnd : 207|8@0+ (1.0,-30.0) [-30.0|225.0] "m" IHU
 SG_ AsyRiFirstEnd_UB : 1|1@0+ (1,0) [0|1] "" IHU
 SG_ AsyRiFirstStrt : 215|8@0+ (1.0,-30.0) [-30.0|225.0] "m" IHU
 SG_ AsyRiFirstStrt_UB : 0|1@0+ (1,0) [0|1] "" IHU
 SG_ AsyRiSecEnd : 223|8@0+ (1.0,-30.0) [-30.0|225.0] "m" IHU
 SG_ AsyRiSecEnd_UB : 163|1@0+ (1,0) [0|1] "" IHU
 SG_ AsyRiSecStrt : 231|8@0+ (1.0,-30.0) [-30.0|225.0] "m" IHU
 SG_ AsyRiSecStrt_UB : 162|1@0+ (1,0) [0|1] "" IHU
 SG_ AsyRoadCrvt : 239|8@0+ (0.00005,-0.0064) [-0.0064|0.006350000000000001] "rad" IHU
 SG_ AsyRoadCrvt_UB : 161|1@0+ (1,0) [0|1] "" IHU
 SG_ AsySafeStopSts : 247|1@0+ (1,0) [0|1] "" IHU
 SG_ AsySafeStopSts_UB : 160|1@0+ (1,0) [0|1] "" IHU
 SG_ AsySodLaneChgSwitch : 245|2@0+ (1.0,0.0) [0.0|3.0] "Unitless" IHU
 SG_ AsySodLaneChgSwitch_UB : 246|1@0+ (1,0) [0|1] "" IHU
 SG_ AsySodPilotCfirm : 255|2@0+ (1,0) [0|3] "" IHU
 SG_ AsySodPilotCfirm_UB : 253|1@0+ (1,0) [0|1] "" IHU
 SG_ AvlStsForLongAutDrvSound : 243|4@0+ (1,0) [0|15] "" IHU
 SG_ AvlStsForLongAutDrvSound_UB : 252|1@0+ (1,0) [0|1] "" IHU
 SG_ CnclWarnForAutDrvSound : 251|2@0+ (1,0) [0|3] "" IHU
 SG_ CnclWarnForAutDrvSound_UB : 249|1@0+ (1,0) [0|1] "" IHU
 SG_ CnclWarnLgtForAutDrvSound : 263|2@0+ (1,0) [0|3] "" IHU
 SG_ CnclWarnLgtForAutDrvSound_UB : 248|1@0+ (1,0) [0|1] "" IHU
 SG_ FrntLidarSts0 : 261|3@0+ (1,0) [0|7] "" IHU
 SG_ FrntLidarSts0_UB : 268|1@0+ (1,0) [0|1] "" IHU
 SG_ FrntSideCamLeSts0 : 258|3@0+ (1,0) [0|7] "" IHU
 SG_ FrntSideCamLeSts0_UB : 267|1@0+ (1,0) [0|1] "" IHU
 SG_ FrntSideCamRiSts0 : 271|3@0+ (1,0) [0|7] "" IHU
 SG_ FrntSideCamRiSts0_UB : 265|1@0+ (1,0) [0|1] "" IHU
 SG_ HmiAsyVehicleFirstEnd : 295|8@0+ (1.0,-30.0) [-30.0|225.0] "m" IHU
 SG_ HmiAsyVehicleFirstEnd_UB : 286|1@0+ (1,0) [0|1] "" IHU
 SG_ HmiAsyVehicleFirstStrt : 279|8@0+ (1.0,-30.0) [-30.0|225.0] "m" IHU
 SG_ HmiAsyVehicleFirstStrt_UB : 287|1@0+ (1,0) [0|1] "" IHU
 SG_ HmiAsyVehiclePah_UB : 285|1@0+ (1,0) [0|1] "" IHU
 SG_ HmiAsyVehiclePah2_UB : 284|1@0+ (1,0) [0|1] "" IHU
 SG_ HmiAsyVehiclePah2PrmA : 367|13@0+ (0.01,-30.0) [-30.0|30.0] "m" IHU
 SG_ HmiAsyVehiclePah2PrmB : 391|12@0+ (0.001,-1.6) [-1.6|1.6] "rad" IHU
 SG_ HmiAsyVehiclePah2PrmC : 370|11@0+ (0.0001,-0.1) [-0.1|0.1] "1/m" IHU
 SG_ HmiAsyVehiclePah2PrmD : 395|11@0+ (0.000001,-0.001) [-0.001|0.001] "1/m^2" IHU
 SG_ HmiAsyVehiclePahDisp : 266|1@0+ (1,0) [0|1] "" IHU
 SG_ HmiAsyVehiclePahDisp_UB : 264|1@0+ (1,0) [0|1] "" IHU
 SG_ HmiAsyVehiclePahPrmA : 319|13@0+ (0.01,-30.0) [-30.0|30.0] "m" IHU
 SG_ HmiAsyVehiclePahPrmB : 343|12@0+ (0.001,-1.6) [-1.6|1.6] "rad" IHU
 SG_ HmiAsyVehiclePahPrmC : 322|11@0+ (0.0001,-0.1) [-0.1|0.1] "1/m" IHU
 SG_ HmiAsyVehiclePahPrmD : 347|11@0+ (0.000001,-0.001) [-0.001|0.001] "1/m^2" IHU
 SG_ HmiAsyVehicleSecEnd : 303|8@0+ (1.0,-30.0) [-30.0|225.0] "m" IHU
 SG_ HmiAsyVehicleSecEnd_UB : 283|1@0+ (1,0) [0|1] "" IHU
 SG_ HmiAsyVehicleSecStrt : 311|8@0+ (1.0,-30.0) [-30.0|225.0] "m" IHU
 SG_ HmiAsyVehicleSecStrt_UB : 282|1@0+ (1,0) [0|1] "" IHU
 SG_ HmiAutoLaneChgStyle : 281|2@0+ (1,0) [0|3] "" IHU
 SG_ HmiAutoLaneChgStyle_UB : 352|1@0+ (1,0) [0|1] "" IHU
 SG_ HmiCrosswalk_UB : 400|1@0+ (1,0) [0|1] "" IHU
 SG_ HmiCrosswalkAngle : 415|9@0+ (0.01,-1.6) [-1.6|1.6] "rad" IHU
 SG_ HmiCrosswalkcolor : 422|3@0+ (1,0) [0|7] "" IHU
 SG_ HmiCrosswalklateralDistance : 419|11@0+ (0.1,-100.0) [-100.0|100.0] "m" IHU
 SG_ HmiCrosswalklength : 424|9@0+ (0.1,0.0) [0.0|30.0] "m" IHU
 SG_ HmiCrosswalklongitudinalDistance : 447|11@0+ (0.1,0.0) [0.0|150.0] "m" IHU
 SG_ HmiCrosswalkTiStamp : 459|32@0+ (0.0001,0.0) [0.0|429496.7295] "s" IHU
 SG_ HmiCrosswalkwidth : 452|9@0+ (0.1,0.0) [0.0|30.0] "m" IHU
 SG_ HmiLaneChgInfo : 491|2@0+ (1,0) [0|3] "" IHU
 SG_ HmiLaneChgInfo_UB : 489|1@0+ (1,0) [0|1] "" IHU
 SG_ OvrdWrnForFstActv : 503|1@0+ (1,0) [0|1] "" IHU
 SG_ OvrdWrnForFstActv_UB : 488|1@0+ (1,0) [0|1] "" IHU

BO_ 640 AdcuZCUCANFD1Fr07 : 64 ASDM
 SG_ AsyALatIndcr : 7|3@0+ (1,0) [0|7] "" IHU
 SG_ AsyALatIndcr_UB : 4|1@0+ (1,0) [0|1] "" IHU
 SG_ AsyALgtIndcr : 3|3@0+ (1,0) [0|7] "" IHU
 SG_ AsyALgtIndcr_UB : 0|1@0+ (1,0) [0|1] "" IHU
 SG_ AsyObjForBigData0_UB : 137|1@0+ (1,0) [0|1] "" IHU
 SG_ AsyObjForBigData0AbsLatSpd : 79|7@0+ (0.25,-16.0) [-16.0|15.75] "m/s" IHU
 SG_ AsyObjForBigData0AbsLgtSpd : 72|9@0+ (0.25,0.0) [0.0|125.0] "m/s" IHU
 SG_ AsyObjForBigData0Confidence : 95|7@0+ (0.01,0.0) [0.0|1.0] "Unitless" IHU
 SG_ AsyObjForBigData0RlvtLatDst : 88|9@0+ (0.1,-25.0) [-25.0|25.0] "m" IHU
 SG_ AsyObjForBigData0RlvtLgtDst : 111|11@0+ (0.1,0.0) [0.0|150.0] "m" IHU
 SG_ AsyObjForBigData0SnsrSrcOfAbsLatSpd : 116|2@0+ (1,0) [0|3] "" IHU
 SG_ AsyObjForBigData0SnsrSrcOfAbsLgtSpd : 114|2@0+ (1,0) [0|3] "" IHU
 SG_ AsyObjForBigData0TTC : 127|7@0+ (0.05,0.0) [0.0|6.3500000000000005] "s" IHU
 SG_ AsyObjForBigData0Type : 135|4@0+ (1,0) [0|15] "" IHU
 SG_ AsyObjType : 131|4@0+ (1,0) [0|15] "" IHU
 SG_ AsyObjType_UB : 143|1@0+ (1,0) [0|1] "" IHU
 SG_ AsyWarnForSteerCncl : 65|1@0+ (1,0) [0|1] "" IHU
 SG_ AsyWarnForSteerCncl_UB : 64|1@0+ (1,0) [0|1] "" IHU
 SG_ AvlStsForLongAutDrv : 142|4@0+ (1,0) [0|15] "" IHU
 SG_ AvlStsForLongAutDrv_UB : 138|1@0+ (1,0) [0|1] "" IHU
 SG_ CamStatus0 : 151|3@0+ (1,0) [0|7] "" IHU
 SG_ CamStatus0_UB : 148|1@0+ (1,0) [0|1] "" IHU
 SG_ CllsnAidPost : 147|1@0+ (1,0) [0|1] "" IHU,ZCUD
 SG_ CllsnAidPost_UB : 146|1@0+ (1,0) [0|1] "" IHU,ZCUD
 SG_ CllsnMtgtnFaultSts : 145|2@0+ (1,0) [0|3] "" IHU
 SG_ CllsnMtgtnFaultSts_UB : 159|1@0+ (1,0) [0|1] "" IHU
 SG_ CllsnMtgtnOnoffSts : 158|1@0+ (1,0) [0|1] "" IHU
 SG_ CllsnMtgtnOnoffSts_UB : 157|1@0+ (1,0) [0|1] "" IHU
 SG_ CllsnWarnReIndcn : 156|2@0+ (1,0) [0|3] "" IHU,ZCUD
 SG_ CllsnWarnReIndcn_UB : 154|1@0+ (1,0) [0|1] "" IHU,ZCUD
 SG_ CnclWarnLgtForAutDrv : 153|2@0+ (1,0) [0|3] "" IHU
 SG_ CnclWarnLgtForAutDrv_UB : 167|1@0+ (1,0) [0|1] "" IHU
 SG_ DrvOffMod : 69|2@0+ (1,0) [0|3] "" IHU
 SG_ DrvOffMod_UB : 70|1@0+ (1,0) [0|1] "" IHU
 SG_ DrvOffWarn : 175|2@0+ (1,0) [0|3] "" IHU
 SG_ DrvOffWarn_UB : 173|1@0+ (1,0) [0|1] "" IHU
 SG_ FrntRdrSts0 : 182|3@0+ (1,0) [0|7] "" IHU
 SG_ FrntRdrSts0_UB : 179|1@0+ (1,0) [0|1] "" IHU
 SG_ FrntSideRdrLeSts0 : 191|3@0+ (1,0) [0|7] "" IHU
 SG_ FrntSideRdrLeSts0_UB : 177|1@0+ (1,0) [0|1] "" IHU
 SG_ FrntSideRdrRiSts0 : 188|3@0+ (1,0) [0|7] "" IHU
 SG_ FrntSideRdrRiSts0_UB : 176|1@0+ (1,0) [0|1] "" IHU
 SG_ HmiAutoLaneChgStsForAsyAIAsistAudio : 199|4@0+ (1,0) [0|15] "" IHU
 SG_ HmiAutoLaneChgStsForAsyAIAsistAudio_UB : 185|1@0+ (1,0) [0|1] "" IHU
 SG_ IHUSetDispAD : 195|2@0+ (1,0) [0|3] "" IHU
 SG_ IHUSetDispAD_UB : 184|1@0+ (1,0) [0|1] "" IHU
 SG_ LcmaOn : 193|2@0+ (1,0) [0|3] "" IHU
 SG_ LcmaOn_UB : 205|1@0+ (1,0) [0|1] "" IHU
 SG_ LeTTCLv : 207|2@0+ (1,0) [0|3] "" IHU
 SG_ LeTTCLv_UB : 204|1@0+ (1,0) [0|1] "" IHU
 SG_ OffsForSpdWarnSetgSts : 203|3@0+ (1,0) [0|7] "" IHU
 SG_ OffsForSpdWarnSetgSts_UB : 200|1@0+ (1,0) [0|1] "" IHU
 SG_ ReSideRdrLeSts0 : 215|3@0+ (1,0) [0|7] "" IHU
 SG_ ReSideRdrLeSts0_UB : 223|1@0+ (1,0) [0|1] "" IHU
 SG_ ReSideRdrRiSts0 : 212|3@0+ (1,0) [0|7] "" IHU
 SG_ ReSideRdrRiSts0_UB : 222|1@0+ (1,0) [0|1] "" IHU
 SG_ RiTTCLv : 209|2@0+ (1,0) [0|3] "" IHU
 SG_ RiTTCLv_UB : 221|1@0+ (1,0) [0|1] "" IHU
 SG_ SpdLimCoupldFirst : 220|5@0+ (1,0) [0|31] "" IHU
 SG_ SpdLimCoupldFirst_UB : 231|1@0+ (1,0) [0|1] "" IHU
 SG_ SpdLimSec : 239|8@0+ (1.0,0.0) [0.0|255.0] "Unitless" IHU
 SG_ SpdLimSec_UB : 224|1@0+ (1,0) [0|1] "" IHU
 SG_ SpdLimSpplFirst : 230|5@0+ (1,0) [0|31] "" IHU
 SG_ SpdLimSpplFirst_UB : 225|1@0+ (1,0) [0|1] "" IHU
 SG_ SpdLimWarnReq : 166|2@0+ (1,0) [0|3] "" IHU
 SG_ SpdLimWarnReq_UB : 183|1@0+ (1,0) [0|1] "" IHU
 SG_ SpdLimWarnReqAud : 164|1@0+ (1,0) [0|1] "" IHU
 SG_ SpdLimWarnReqAud_UB : 163|1@0+ (1,0) [0|1] "" IHU
 SG_ TooManyCars : 161|1@0+ (1,0) [0|1] "" IHU,ZCUD
 SG_ TooManyCars_UB : 162|1@0+ (1,0) [0|1] "" IHU,ZCUD

BO_ 288 AdcuZCUCANFD1Fr08 : 64 ASDM
 SG_ AsyAutDrvgAvl : 7|5@0+ (1,0) [0|31] "" IHU
 SG_ AsyAutDrvgAvl_UB : 2|1@0+ (1,0) [0|1] "" IHU
 SG_ AsyLatOffstSts : 1|2@0+ (1.0,0.0) [0.0|3.0] "Unitless" IHU
 SG_ AsyLatOffstSts_UB : 15|1@0+ (1,0) [0|1] "" IHU
 SG_ AsySteerApplyRqrd : 11|2@0+ (1,0) [0|3] "" IHU
 SG_ AsySteerApplyRqrd_UB : 12|1@0+ (1,0) [0|1] "" IHU
 SG_ BrkPrecActv : 73|1@0+ (1,0) [0|1] "" BBM,IHU
 SG_ BrkPrecActv_UB : 72|1@0+ (1,0) [0|1] "" BBM,IHU
 SG_ DoorOpenwarnLeIndcn : 9|2@0+ (1,0) [0|3] "" IHU,ZCUD,ZCUP
 SG_ DoorOpenwarnLeIndcn_UB : 23|1@0+ (1,0) [0|1] "" IHU,ZCUD,ZCUP
 SG_ DoorOpenwarnRiIndcn : 22|2@0+ (1,0) [0|3] "" IHU,ZCUD,ZCUP
 SG_ DoorOpenwarnRiIndcn_UB : 20|1@0+ (1,0) [0|1] "" IHU,ZCUD,ZCUP
 SG_ IntvAndWarnModInfoSts : 19|2@0+ (1,0) [0|3] "" IHU
 SG_ IntvAndWarnModInfoSts_UB : 17|1@0+ (1,0) [0|1] "" IHU
 SG_ LaneChgAutInfoForAsyHiWay : 31|2@0+ (1,0) [0|3] "" IHU
 SG_ LaneChgAutInfoForAsyHiWay_UB : 16|1@0+ (1,0) [0|1] "" IHU
 SG_ LaneChgAutStsForAsyHiWay : 27|4@0+ (1,0) [0|15] "" IHU
 SG_ LaneChgAutStsForAsyHiWay_UB : 29|1@0+ (1,0) [0|1] "" IHU
 SG_ LcmaIndcnLe : 39|2@0+ (1,0) [0|3] "" IHU,ZCUD,ZCUP
 SG_ LcmaIndcnLe_UB : 28|1@0+ (1,0) [0|1] "" IHU,ZCUD,ZCUP
 SG_ LcmaIndcnRi : 37|2@0+ (1,0) [0|3] "" IHU,ZCUD,ZCUP
 SG_ LcmaIndcnRi_UB : 35|1@0+ (1,0) [0|1] "" IHU,ZCUD,ZCUP
 SG_ RctaBrkReq_UB : 105|1@0+ (1,0) [0|1] "" BBM,IHU
 SG_ RctaBrkReqChks : 119|8@0+ (1.0,0.0) [0.0|255.0] "Unitless" BBM,IHU
 SG_ RctaBrkReqCntr : 127|4@0+ (1.0,0.0) [0.0|15.0] "Unitless" BBM,IHU
 SG_ RctaBrkReqRctaBrkReq : 104|1@0+ (1,0) [0|1] "" BBM,IHU
 SG_ RctaIndcnLe : 34|2@0+ (1,0) [0|3] "" IHU,ZCUD,ZCUP
 SG_ RctaIndcnLe_UB : 32|1@0+ (1,0) [0|1] "" IHU,ZCUD,ZCUP
 SG_ RctaIndcnRi : 47|2@0+ (1,0) [0|3] "" IHU,ZCUD,ZCUP
 SG_ RctaIndcnRi_UB : 45|1@0+ (1,0) [0|1] "" IHU,ZCUD,ZCUP
 SG_ TiGapSetForLgtCtrl : 43|3@0+ (1,0) [0|7] "" IHU
 SG_ TiGapSetForLgtCtrl_UB : 40|1@0+ (1,0) [0|1] "" IHU

BO_ 864 AdcuZCUCANFD1Fr09 : 64 ASDM
 SG_ AsyLanChgSodSec : 431|5@0+ (1.0,0.0) [0.0|31.0] "Unitless" IHU
 SG_ AsyLanChgSodSec_UB : 384|1@0+ (1,0) [0|1] "" IHU
 SG_ AsyLaneChgAssistSts : 93|6@0+ (1.0,0.0) [0.0|63.0] "Unitless" ETC,IHU
 SG_ AsyLaneChgAssistSts_UB : 72|1@0+ (1,0) [0|1] "" ETC,IHU
 SG_ AsyLaneChgFailType : 399|4@0+ (1.0,0.0) [0.0|15.0] "Unitless" ETC,IHU
 SG_ AsyLaneChgFailType_UB : 218|1@0+ (1,0) [0|1] "" ETC,IHU
 SG_ CameraStsforAHBC : 5|2@0+ (1,0) [0|3] "" IHU,ZCUD
 SG_ CameraStsforAHBC_UB : 3|1@0+ (1,0) [0|1] "" IHU,ZCUD
 SG_ LitArea : 1|1@0+ (1,0) [0|1] "" IHU,ZCUD
 SG_ LitArea_UB : 0|1@0+ (1,0) [0|1] "" IHU,ZCUD
 SG_ RcwmLiReq : 74|1@0+ (1,0) [0|1] "" IHU,ZCUD
 SG_ RcwmLiReq_UB : 73|1@0+ (1,0) [0|1] "" IHU,ZCUD
 SG_ TurnIndicReqByALCA : 77|2@0+ (1,0) [0|3] "" IHU,ZCUD
 SG_ TurnIndicReqByALCA_UB : 75|1@0+ (1,0) [0|1] "" IHU,ZCUD

BO_ 437 AdcuZCUCANFD1Fr10 : 64 ASDM
 SG_ FrntSideLidarLeSts0 : 275|3@0+ (1,0) [0|7] "" IHU
 SG_ FrntSideLidarLeSts0_UB : 272|1@0+ (1,0) [0|1] "" IHU
 SG_ FrntSideLidarRiSts0 : 315|3@0+ (1,0) [0|7] "" IHU
 SG_ FrntSideLidarRiSts0_UB : 312|1@0+ (1,0) [0|1] "" IHU
 SG_ HmiMovgObj1_UB : 35|1@0+ (1,0) [0|1] "" IHU,ZCUD
 SG_ HmiMovgObj10_UB : 114|1@0+ (1,0) [0|1] "" IHU
 SG_ HmiMovgObj10ColorOfHmiMovgObj : 398|3@0+ (1,0) [0|7] "" IHU
 SG_ HmiMovgObj10DstLatOfMovgObj : 391|9@0+ (0.1,-25.0) [-25.0|25.0] "m" IHU
 SG_ HmiMovgObj10DstLgtOfMovgObj : 383|8@0+ (1.0,-30.0) [-30.0|225.0] "m" IHU
 SG_ HmiMovgObj10HdDirOfMovgObj : 363|12@0+ (0.1,0.0) [0.0|360.0] "Deg" IHU
 SG_ HmiMovgObj10HmiMovgObjTyp : 367|4@0+ (1,0) [0|15] "" IHU
 SG_ HmiMovgObj11_UB : 113|1@0+ (1,0) [0|1] "" IHU
 SG_ HmiMovgObj11ColorOfHmiMovgObj : 438|3@0+ (1,0) [0|7] "" IHU
 SG_ HmiMovgObj11DstLatOfMovgObj : 431|9@0+ (0.1,-25.0) [-25.0|25.0] "m" IHU
 SG_ HmiMovgObj11DstLgtOfMovgObj : 423|8@0+ (1.0,-30.0) [-30.0|225.0] "m" IHU
 SG_ HmiMovgObj11HdDirOfMovgObj : 403|12@0+ (0.1,0.0) [0.0|360.0] "Deg" IHU
 SG_ HmiMovgObj11HmiMovgObjTyp : 407|4@0+ (1,0) [0|15] "" IHU
 SG_ HmiMovgObj1ColorOfHmiMovgObj : 38|3@0+ (1,0) [0|7] "" IHU,ZCUD
 SG_ HmiMovgObj1DstLatOfMovgObj : 31|9@0+ (0.1,-25.0) [-25.0|25.0] "m" IHU,ZCUD
 SG_ HmiMovgObj1DstLgtOfMovgObj : 23|8@0+ (1.0,-30.0) [-30.0|225.0] "m" IHU,ZCUD
 SG_ HmiMovgObj1HdDirOfMovgObj : 3|12@0+ (0.1,0.0) [0.0|360.0] "Deg" IHU,ZCUD
 SG_ HmiMovgObj1HmiMovgObjTyp : 7|4@0+ (1,0) [0|15] "" IHU,ZCUD
 SG_ HmiMovgObj2_UB : 34|1@0+ (1,0) [0|1] "" IHU
 SG_ HmiMovgObj2ColorOfHmiMovgObj : 78|3@0+ (1,0) [0|7] "" IHU
 SG_ HmiMovgObj2DstLatOfMovgObj : 71|9@0+ (0.1,-25.0) [-25.0|25.0] "m" IHU
 SG_ HmiMovgObj2DstLgtOfMovgObj : 63|8@0+ (1.0,-30.0) [-30.0|225.0] "m" IHU
 SG_ HmiMovgObj2HdDirOfMovgObj : 43|12@0+ (0.1,0.0) [0.0|360.0] "Deg" IHU
 SG_ HmiMovgObj2HmiMovgObjTyp : 47|4@0+ (1,0) [0|15] "" IHU
 SG_ HmiMovgObj3_UB : 33|1@0+ (1,0) [0|1] "" IHU
 SG_ HmiMovgObj3ColorOfHmiMovgObj : 118|3@0+ (1,0) [0|7] "" IHU
 SG_ HmiMovgObj3DstLatOfMovgObj : 111|9@0+ (0.1,-25.0) [-25.0|25.0] "m" IHU
 SG_ HmiMovgObj3DstLgtOfMovgObj : 103|8@0+ (1.0,-30.0) [-30.0|225.0] "m" IHU
 SG_ HmiMovgObj3HdDirOfMovgObj : 83|12@0+ (0.1,0.0) [0.0|360.0] "Deg" IHU
 SG_ HmiMovgObj3HmiMovgObjTyp : 87|4@0+ (1,0) [0|15] "" IHU
 SG_ HmiMovgObj4_UB : 32|1@0+ (1,0) [0|1] "" IHU
 SG_ HmiMovgObj4ColorOfHmiMovgObj : 158|3@0+ (1,0) [0|7] "" IHU
 SG_ HmiMovgObj4DstLatOfMovgObj : 151|9@0+ (0.1,-25.0) [-25.0|25.0] "m" IHU
 SG_ HmiMovgObj4DstLgtOfMovgObj : 143|8@0+ (1.0,-30.0) [-30.0|225.0] "m" IHU
 SG_ HmiMovgObj4HdDirOfMovgObj : 123|12@0+ (0.1,0.0) [0.0|360.0] "Deg" IHU
 SG_ HmiMovgObj4HmiMovgObjTyp : 127|4@0+ (1,0) [0|15] "" IHU
 SG_ HmiMovgObj5_UB : 75|1@0+ (1,0) [0|1] "" IHU
 SG_ HmiMovgObj5ColorOfHmiMovgObj : 198|3@0+ (1,0) [0|7] "" IHU
 SG_ HmiMovgObj5DstLatOfMovgObj : 191|9@0+ (0.1,-25.0) [-25.0|25.0] "m" IHU
 SG_ HmiMovgObj5DstLgtOfMovgObj : 183|8@0+ (1.0,-30.0) [-30.0|225.0] "m" IHU
 SG_ HmiMovgObj5HdDirOfMovgObj : 163|12@0+ (0.1,0.0) [0.0|360.0] "Deg" IHU
 SG_ HmiMovgObj5HmiMovgObjTyp : 167|4@0+ (1,0) [0|15] "" IHU
 SG_ HmiMovgObj6_UB : 74|1@0+ (1,0) [0|1] "" IHU
 SG_ HmiMovgObj6ColorOfHmiMovgObj : 238|3@0+ (1,0) [0|7] "" IHU
 SG_ HmiMovgObj6DstLatOfMovgObj : 231|9@0+ (0.1,-25.0) [-25.0|25.0] "m" IHU
 SG_ HmiMovgObj6DstLgtOfMovgObj : 223|8@0+ (1.0,-30.0) [-30.0|225.0] "m" IHU
 SG_ HmiMovgObj6HdDirOfMovgObj : 203|12@0+ (0.1,0.0) [0.0|360.0] "Deg" IHU
 SG_ HmiMovgObj6HmiMovgObjTyp : 207|4@0+ (1,0) [0|15] "" IHU
 SG_ HmiMovgObj7_UB : 73|1@0+ (1,0) [0|1] "" IHU
 SG_ HmiMovgObj7ColorOfHmiMovgObj : 278|3@0+ (1,0) [0|7] "" IHU
 SG_ HmiMovgObj7DstLatOfMovgObj : 271|9@0+ (0.1,-25.0) [-25.0|25.0] "m" IHU
 SG_ HmiMovgObj7DstLgtOfMovgObj : 263|8@0+ (1.0,-30.0) [-30.0|225.0] "m" IHU
 SG_ HmiMovgObj7HdDirOfMovgObj : 243|12@0+ (0.1,0.0) [0.0|360.0] "Deg" IHU
 SG_ HmiMovgObj7HmiMovgObjTyp : 247|4@0+ (1,0) [0|15] "" IHU
 SG_ HmiMovgObj8_UB : 72|1@0+ (1,0) [0|1] "" IHU
 SG_ HmiMovgObj8ColorOfHmiMovgObj : 318|3@0+ (1,0) [0|7] "" IHU
 SG_ HmiMovgObj8DstLatOfMovgObj : 311|9@0+ (0.1,-25.0) [-25.0|25.0] "m" IHU
 SG_ HmiMovgObj8DstLgtOfMovgObj : 303|8@0+ (1.0,-30.0) [-30.0|225.0] "m" IHU
 SG_ HmiMovgObj8HdDirOfMovgObj : 283|12@0+ (0.1,0.0) [0.0|360.0] "Deg" IHU
 SG_ HmiMovgObj8HmiMovgObjTyp : 287|4@0+ (1,0) [0|15] "" IHU
 SG_ HmiMovgObj9_UB : 115|1@0+ (1,0) [0|1] "" IHU
 SG_ HmiMovgObj9ColorOfHmiMovgObj : 358|3@0+ (1,0) [0|7] "" IHU
 SG_ HmiMovgObj9DstLatOfMovgObj : 351|9@0+ (0.1,-25.0) [-25.0|25.0] "m" IHU
 SG_ HmiMovgObj9DstLgtOfMovgObj : 343|8@0+ (1.0,-30.0) [-30.0|225.0] "m" IHU
 SG_ HmiMovgObj9HdDirOfMovgObj : 323|12@0+ (0.1,0.0) [0.0|360.0] "Deg" IHU
 SG_ HmiMovgObj9HmiMovgObjTyp : 327|4@0+ (1,0) [0|15] "" IHU
 SG_ HmiNOPCofmOfLanChag : 155|2@0+ (1,0) [0|3] "" IHU
 SG_ HmiNOPCofmOfLanChag_UB : 153|1@0+ (1,0) [0|1] "" IHU
 SG_ HmiReCamSts0 : 195|4@0+ (1,0) [0|15] "" IHU
 SG_ HmiReCamSts0_UB : 112|1@0+ (1,0) [0|1] "" IHU
 SG_ HWALeadingPoint_UB : 462|1@0+ (1,0) [0|1] "" IHU
 SG_ HWALeadingPointCenterX : 455|9@0+ (0.1,-25.0) [-25.0|25.0] "m" IHU
 SG_ HWALeadingPointCenterY : 434|11@0+ (0.1,0.0) [0.0|150.0] "m" IHU
 SG_ HWALeadingPointValid : 435|1@0+ (1,0) [0|1] "" IHU
 SG_ LaneKeepAidInfoSts : 152|1@0+ (1,0) [0|1] "" IHU
 SG_ LaneKeepAidInfoSts_UB : 235|1@0+ (1,0) [0|1] "" IHU
 SG_ ReLidarSts0 : 355|3@0+ (1,0) [0|7] "" IHU
 SG_ ReLidarSts0_UB : 352|1@0+ (1,0) [0|1] "" IHU
 SG_ ReSideLidarLeSts0 : 395|3@0+ (1,0) [0|7] "" IHU
 SG_ ReSideLidarLeSts0_UB : 392|1@0+ (1,0) [0|1] "" IHU
 SG_ ReSideLidarRiSts0 : 461|3@0+ (1,0) [0|7] "" IHU
 SG_ ReSideLidarRiSts0_UB : 458|1@0+ (1,0) [0|1] "" IHU

BO_ 480 AdcuZCUCANFD1Fr11 : 64 ASDM
 SG_ HmiRoadArrow1_UB : 28|1@0+ (1,0) [0|1] "" IHU
 SG_ HmiRoadArrow1HmiRoadArrowLane : 7|3@0+ (1,0) [0|7] "" IHU
 SG_ HmiRoadArrow1HmiRoadArrowTyp : 4|4@0+ (1,0) [0|15] "" IHU
 SG_ HmiRoadArrow1LatPosition : 0|9@0+ (0.1,-25.0) [-25.0|25.0] "m" IHU
 SG_ HmiRoadArrow1LongPosition : 23|11@0+ (0.1,0.0) [0.0|200.0] "m" IHU
 SG_ HmiRoadArrow2_UB : 27|1@0+ (1,0) [0|1] "" IHU
 SG_ HmiRoadArrow2HmiRoadArrowLane : 39|3@0+ (1,0) [0|7] "" IHU
 SG_ HmiRoadArrow2HmiRoadArrowTyp : 36|4@0+ (1,0) [0|15] "" IHU
 SG_ HmiRoadArrow2LatPosition : 32|9@0+ (0.1,-25.0) [-25.0|25.0] "m" IHU
 SG_ HmiRoadArrow2LongPosition : 55|11@0+ (0.1,0.0) [0.0|200.0] "m" IHU
 SG_ HmiRoadArrow3_UB : 26|1@0+ (1,0) [0|1] "" IHU
 SG_ HmiRoadArrow3HmiRoadArrowLane : 71|3@0+ (1,0) [0|7] "" IHU
 SG_ HmiRoadArrow3HmiRoadArrowTyp : 68|4@0+ (1,0) [0|15] "" IHU
 SG_ HmiRoadArrow3LatPosition : 64|9@0+ (0.1,-25.0) [-25.0|25.0] "m" IHU
 SG_ HmiRoadArrow3LongPosition : 87|11@0+ (0.1,0.0) [0.0|200.0] "m" IHU
 SG_ HmiRoadArrow4_UB : 25|1@0+ (1,0) [0|1] "" IHU
 SG_ HmiRoadArrow4HmiRoadArrowLane : 103|3@0+ (1,0) [0|7] "" IHU
 SG_ HmiRoadArrow4HmiRoadArrowTyp : 100|4@0+ (1,0) [0|15] "" IHU
 SG_ HmiRoadArrow4LatPosition : 96|9@0+ (0.1,-25.0) [-25.0|25.0] "m" IHU
 SG_ HmiRoadArrow4LongPosition : 119|11@0+ (0.1,0.0) [0.0|200.0] "m" IHU
 SG_ HmiRoadArrow5_UB : 24|1@0+ (1,0) [0|1] "" IHU
 SG_ HmiRoadArrow5HmiRoadArrowLane : 135|3@0+ (1,0) [0|7] "" IHU
 SG_ HmiRoadArrow5HmiRoadArrowTyp : 132|4@0+ (1,0) [0|15] "" IHU
 SG_ HmiRoadArrow5LatPosition : 128|9@0+ (0.1,-25.0) [-25.0|25.0] "m" IHU
 SG_ HmiRoadArrow5LongPosition : 151|11@0+ (0.1,0.0) [0.0|200.0] "m" IHU
 SG_ HmiStaticObj1_UB : 124|1@0+ (1,0) [0|1] "" IHU
 SG_ HmiStaticObj1DstLatOfStaticObj : 175|9@0+ (0.1,-25.0) [-25.0|25.0] "m" IHU
 SG_ HmiStaticObj1DstLgtOfStaticObj : 167|8@0+ (1.0,-30.0) [-30.0|225.0] "m" IHU
 SG_ HmiStaticObj1HmiStaticObjTyp : 182|4@0+ (1,0) [0|15] "" IHU
 SG_ HmiStaticObj2_UB : 123|1@0+ (1,0) [0|1] "" IHU
 SG_ HmiStaticObj2DstLatOfStaticObj : 199|9@0+ (0.1,-25.0) [-25.0|25.0] "m" IHU
 SG_ HmiStaticObj2DstLgtOfStaticObj : 191|8@0+ (1.0,-30.0) [-30.0|225.0] "m" IHU
 SG_ HmiStaticObj2HmiStaticObjTyp : 206|4@0+ (1,0) [0|15] "" IHU
 SG_ HmiStaticObj3_UB : 122|1@0+ (1,0) [0|1] "" IHU
 SG_ HmiStaticObj3DstLatOfStaticObj : 223|9@0+ (0.1,-25.0) [-25.0|25.0] "m" IHU
 SG_ HmiStaticObj3DstLgtOfStaticObj : 215|8@0+ (1.0,-30.0) [-30.0|225.0] "m" IHU
 SG_ HmiStaticObj3HmiStaticObjTyp : 230|4@0+ (1,0) [0|15] "" IHU
 SG_ HmiStaticObj4_UB : 121|1@0+ (1,0) [0|1] "" IHU
 SG_ HmiStaticObj4DstLatOfStaticObj : 247|9@0+ (0.1,-25.0) [-25.0|25.0] "m" IHU
 SG_ HmiStaticObj4DstLgtOfStaticObj : 239|8@0+ (1.0,-30.0) [-30.0|225.0] "m" IHU
 SG_ HmiStaticObj4HmiStaticObjTyp : 254|4@0+ (1,0) [0|15] "" IHU
 SG_ HmiStaticObj5_UB : 120|1@0+ (1,0) [0|1] "" IHU
 SG_ HmiStaticObj5DstLatOfStaticObj : 271|9@0+ (0.1,-25.0) [-25.0|25.0] "m" IHU
 SG_ HmiStaticObj5DstLgtOfStaticObj : 263|8@0+ (1.0,-30.0) [-30.0|225.0] "m" IHU
 SG_ HmiStaticObj5HmiStaticObjTyp : 278|4@0+ (1,0) [0|15] "" IHU
 SG_ HmiStaticObj6_UB : 156|1@0+ (1,0) [0|1] "" IHU
 SG_ HmiStaticObj6DstLatOfStaticObj : 295|9@0+ (0.1,-25.0) [-25.0|25.0] "m" IHU
 SG_ HmiStaticObj6DstLgtOfStaticObj : 287|8@0+ (1.0,-30.0) [-30.0|225.0] "m" IHU
 SG_ HmiStaticObj6HmiStaticObjTyp : 302|4@0+ (1,0) [0|15] "" IHU
 SG_ HmiStaticObj7_UB : 155|1@0+ (1,0) [0|1] "" IHU
 SG_ HmiStaticObj7DstLatOfStaticObj : 319|9@0+ (0.1,-25.0) [-25.0|25.0] "m" IHU
 SG_ HmiStaticObj7DstLgtOfStaticObj : 311|8@0+ (1.0,-30.0) [-30.0|225.0] "m" IHU
 SG_ HmiStaticObj7HmiStaticObjTyp : 326|4@0+ (1,0) [0|15] "" IHU
 SG_ HmiStaticObj8_UB : 154|1@0+ (1,0) [0|1] "" IHU
 SG_ HmiStaticObj8DstLatOfStaticObj : 343|9@0+ (0.1,-25.0) [-25.0|25.0] "m" IHU
 SG_ HmiStaticObj8DstLgtOfStaticObj : 335|8@0+ (1.0,-30.0) [-30.0|225.0] "m" IHU
 SG_ HmiStaticObj8HmiStaticObjTyp : 350|4@0+ (1,0) [0|15] "" IHU
 SG_ HmiStopLine_UB : 392|1@0+ (1,0) [0|1] "" IHU
 SG_ HmiStopLineConfidence : 399|7@0+ (0.01,0.0) [0.0|1.0] "Unitless" IHU
 SG_ HmiStopLineDistanceToStopLine : 345|10@0+ (0.1,-10.0) [-10.0|50.0] "m" IHU
 SG_ HmiStopLineStopLinePresent : 346|1@0+ (1,0) [0|1] "" IHU
 SG_ HmiStopLineTiStamp : 367|32@0+ (0.0001,0.0) [0.0|429496.7295] "s" IHU
 SG_ ReSideCamLeSts0 : 60|3@0+ (1,0) [0|7] "" IHU
 SG_ ReSideCamLeSts0_UB : 57|1@0+ (1,0) [0|1] "" IHU
 SG_ ReSideCamRiSts0 : 178|3@0+ (1,0) [0|7] "" IHU
 SG_ ReSideCamRiSts0_UB : 56|1@0+ (1,0) [0|1] "" IHU
 SG_ SelfLaneColor : 92|3@0+ (1,0) [0|7] "" IHU
 SG_ SelfLaneColor_UB : 89|1@0+ (1,0) [0|1] "" IHU

BO_ 400 AdcuZCUCANFD1Fr13 : 64 ASDM
 SG_ SteerTqAddlForEma_UB : 58|1@0+ (1,0) [0|1] "" BBM,IHU
 SG_ SteerTqAddlForEmaChks : 127|8@0+ (1.0,0.0) [0.0|255.0] "Unitless" BBM,IHU
 SG_ SteerTqAddlForEmaCntr : 151|4@0+ (1.0,0.0) [0.0|15.0] "Unitless" BBM,IHU
 SG_ SteerTqAddlForEmaSteerTqAddlForEma : 135|14@0- (0.00390625,0.0) [-30.0|30.0] "NewtonMeter" BBM,IHU
 SG_ StopReqOfLgtCtrlForPrpsn : 57|1@0+ (1,0) [0|1] "" IHU,ZCUD
 SG_ StopReqOfLgtCtrlForPrpsn_UB : 56|1@0+ (1,0) [0|1] "" IHU,ZCUD
 SG_ StrtReqOfLgtCtrlForPrpsn : 223|1@0+ (1,0) [0|1] "" IHU,ZCUD
 SG_ StrtReqOfLgtCtrlForPrpsn_UB : 222|1@0+ (1,0) [0|1] "" IHU,ZCUD
 SG_ TrafficSignForADB1_UB : 63|1@0+ (1,0) [0|1] "" IHU,ZCUD
 SG_ TrafficSignForADB1AdbAbsDist : 7|12@0+ (0.2,0.0) [0.0|819.0] "m" IHU,ZCUD
 SG_ TrafficSignForADB1AdbDetdQly : 11|2@0+ (1,0) [0|3] "" IHU,ZCUD
 SG_ TrafficSignForADB1AdbHozlAgLe : 31|11@0+ (0.05,-40.0) [-40.0|40.0] "Deg" IHU,ZCUD
 SG_ TrafficSignForADB1AdbHozlAgRi : 36|11@0+ (0.05,-40.0) [-40.0|40.0] "Deg" IHU,ZCUD
 SG_ TrafficSignForADB1AdbTrkInfo : 9|1@0+ (1,0) [0|1] "" IHU,ZCUD
 SG_ TrafficSignForADB1AdbVertAgBot : 8|9@0+ (0.05,-3.0) [-3.0|22.55] "Deg" IHU,ZCUD
 SG_ TrafficSignForADB1AdbVertAgTop : 40|9@0+ (0.05,-3.0) [-3.0|22.55] "Deg" IHU,ZCUD
 SG_ TrafficSignForADB2_UB : 62|1@0+ (1,0) [0|1] "" IHU,ZCUD
 SG_ TrafficSignForADB2AdbAbsDist : 71|12@0+ (0.2,0.0) [0.0|819.0] "m" IHU,ZCUD
 SG_ TrafficSignForADB2AdbDetdQly : 75|2@0+ (1,0) [0|3] "" IHU,ZCUD
 SG_ TrafficSignForADB2AdbHozlAgLe : 95|11@0+ (0.05,-40.0) [-40.0|40.0] "Deg" IHU,ZCUD
 SG_ TrafficSignForADB2AdbHozlAgRi : 100|11@0+ (0.05,-40.0) [-40.0|40.0] "Deg" IHU,ZCUD
 SG_ TrafficSignForADB2AdbTrkInfo : 73|1@0+ (1,0) [0|1] "" IHU,ZCUD
 SG_ TrafficSignForADB2AdbVertAgBot : 72|9@0+ (0.05,-3.0) [-3.0|22.55] "Deg" IHU,ZCUD
 SG_ TrafficSignForADB2AdbVertAgTop : 104|9@0+ (0.05,-3.0) [-3.0|22.55] "Deg" IHU,ZCUD
 SG_ VehObjforAHB_UB : 208|1@0+ (1,0) [0|1] "" IHU,ZCUD
 SG_ VehObjforAHBAdbAbsDist : 159|10@0+ (1.0,0.0) [0.0|1000.0] "m" IHU,ZCUD
 SG_ VehObjforAHBAdbClassn : 212|3@0+ (1,0) [0|7] "" IHU,ZCUD
 SG_ VehObjforAHBAdbClassnQly : 165|2@0+ (1,0) [0|3] "" IHU,ZCUD
 SG_ VehObjforAHBAdbDetdQly : 163|2@0+ (1,0) [0|3] "" IHU,ZCUD
 SG_ VehObjforAHBAdbHozlAg : 178|11@0+ (0.05,-40.0) [-40.0|40.0] "Deg" IHU,ZCUD
 SG_ VehObjforAHBAdbObjDir : 161|2@0+ (1,0) [0|3] "" IHU,ZCUD
 SG_ VehObjforAHBAdbObjHozlAgSpd : 175|13@0+ (0.05,-144.0) [-144.0|144.0] "DegPerSec" IHU,ZCUD
 SG_ VehObjforAHBAdbObjVertAgSpd : 207|11@0+ (0.2,-144.0) [-144.0|144.0] "DegPerSec" IHU,ZCUD
 SG_ VehObjforAHBAdbTrkInfo : 209|1@0+ (1,0) [0|1] "" IHU,ZCUD
 SG_ VehObjforAHBAdbVertAg : 199|8@0+ (0.2,-15.0) [-15.0|15.0] "Deg" IHU,ZCUD
 SG_ WarnForAsyEmgyLaneKeepAid : 221|1@0+ (1,0) [0|1] "" IHU
 SG_ WarnForAsyEmgyLaneKeepAid_UB : 220|1@0+ (1,0) [0|1] "" IHU

CM_ BU_ ETC "External Tester Connector";

CM_ SG_ 306 AsyLgtCtrlTakeOverReq "Take Over requirement";
CM_ SG_ 448 AsySteerWhlHptcWarnReq "Request for a haptic warning in the steering wheel.";
CM_ SG_ 448 CllsnFwdWarn "indicate the FCW warning and Latent warning activation.";
CM_ SG_ 448 LaneChgWarnSts "Request of LDW sound warning.";
CM_ SG_ 496 ADDimLight "DIM surrounding light, depending on current autonomous driving level";
CM_ SG_ 496 AsyAutDrvCtrlTyp "Indicates if autonomous driving is ACC/TJA/HWA/TJP or only ACC.";
CM_ SG_ 496 AsyAutDrvgAvlSound "function unavaiable sound signal";
CM_ SG_ 496 AsyEmgyLaneKeepAidSts "The signal indicates the status of ELKA function; Off, passive, standby,active etc.";
CM_ SG_ 496 AsyLanChgColorDsp "Display the lane would be changed in by different color ";
CM_ SG_ 496 AsyLanChgMesg "Words warning from NOA ";
CM_ SG_ 496 AsyLanChgSod "Voice warning from NOA";
CM_ SG_ 496 AsyLaneKeepAidSts "the status of LKA function; Off, passive, standby,active etc.";
CM_ SG_ 496 AsyLatDegSts "this signal is used to indicate whether HWA has been downgraded";
CM_ SG_ 496 AsyLe2FirstEnd "End point of the first left 2 line segment";
CM_ SG_ 496 AsyLe2FirstStrt "Start point of the first left 2 line segment";
CM_ SG_ 496 AsyLe2SecEnd "End point of the second left 2 line segment";
CM_ SG_ 496 AsyLe2SecStrt "Start point of the second left 2 line segment";
CM_ SG_ 496 AsyLeFirstEnd "End point of the first left line segment";
CM_ SG_ 496 AsyLeFirstStrt "Start point of the first left line segment";
CM_ SG_ 496 AsyLeSecEnd "End point of the second left line segment";
CM_ SG_ 496 AsyLeSecStrt "Start point of the second left line segment";
CM_ SG_ 496 AsyLineDstLe "The signal indicates the distance to left line.";
CM_ SG_ 496 AsyLineDstRi "The signal indicates the distance to right line.";
CM_ SG_ 496 AsyLineLe2Color "The signal indicates the color of the left line of left lane.";
CM_ SG_ 496 AsyLineLe2Pah2PrmA "Supply the parameters to creat second left 2 line segment of the path of lane lines";
CM_ SG_ 496 AsyLineLe2Pah2PrmB "Supply the parameters to creat second left 2 line segment of the path of lane lines";
CM_ SG_ 496 AsyLineLe2Pah2PrmC "Supply the parameters to creat second left 2 line segment of the path of lane lines";
CM_ SG_ 496 AsyLineLe2Pah2PrmD "Supply the parameters to creat second left 2 line segment of the path of lane lines";
CM_ SG_ 496 AsyLineLe2PahPrmA "DX-distance ";
CM_ SG_ 496 AsyLineLe2PahPrmB "yaw angle radian";
CM_ SG_ 496 AsyLineLe2PahPrmC "curvature";
CM_ SG_ 496 AsyLineLe2PahPrmD "curvature change";
CM_ SG_ 496 AsyLineLe2RampPosn "To display the position of ramp.
far
middle
near";
CM_ SG_ 496 AsyLineLe2RampTyp "To display the ramp type of lane line.";
CM_ SG_ 496 AsyLineLe2Typ "The signal indicates the type of the left line of left lane.";
CM_ SG_ 496 AsyLineLeColor "The signal indicates the color of the left line of ego lane.";
CM_ SG_ 496 AsyLineLePah2PrmA "Supply the parameters to creat second left line segment of the path of lane lines";
CM_ SG_ 496 AsyLineLePah2PrmB "Supply the parameters to creat second left line segment of the path of lane lines";
CM_ SG_ 496 AsyLineLePah2PrmC "Supply the parameters to creat second left line segment of the path of lane lines";
CM_ SG_ 496 AsyLineLePah2PrmD "Supply the parameters to creat second left line segment of the path of lane lines";
CM_ SG_ 496 AsyLineLePahPrmA "DX-distance ";
CM_ SG_ 496 AsyLineLePahPrmB "yaw angle radian";
CM_ SG_ 496 AsyLineLePahPrmC "curvature";
CM_ SG_ 496 AsyLineLePahPrmD "curvature change";
CM_ SG_ 496 AsyLineLeRampPosn "To display the position of ramp.
far
middle
near";
CM_ SG_ 496 AsyLineLeRampTyp "To display the ramp type of lane line.";
CM_ SG_ 496 AsyLineLeTyp "The signal indicates the type of the left line of ego lane.";
CM_ SG_ 496 AsyLineRi2Color "The signal indicates the color of the right line of right lane.";
CM_ SG_ 496 AsyLineRi2PahPrmA "DX-distance ";
CM_ SG_ 496 AsyLineRi2PahPrmB "yaw angle radian";
CM_ SG_ 496 AsyLineRi2PahPrmC "curvature";
CM_ SG_ 496 AsyLineRi2PahPrmD "curvature change";
CM_ SG_ 496 AsyLineRi2RampPosn "To display the position of ramp.
far
middle
near";
CM_ SG_ 496 AsyLineRi2RampTyp "To display the ramp type of lane line.";
CM_ SG_ 496 AsyLineRi2Typ "The signal indicates the type of the right line of right lane.";
CM_ SG_ 496 AsyLineRiColor "The signal indicates the color of the right line of ego lane.";
CM_ SG_ 496 AsyLineRiRampTyp "To display the ramp type of lane line.";
CM_ SG_ 496 AsyNoaActvSuggest "Gpilot Suggest Driver to Active ";
CM_ SG_ 752 AccFusnTrfcSgn "Indicates if ACC function fuses with TSR or not.";
CM_ SG_ 752 ActvSafeCtrlrSts "Status signal which indicates the status of the ASDM.";
CM_ SG_ 752 AsyEmgyLaneKeepAid "Feedback to HMI for EmgyLaneKeepAidActvSts";
CM_ SG_ 752 AsyEmgyManoeuvreAidSts "The signal indicates the status of EMA function; Off, passive, standby,active etc.";
CM_ SG_ 752 AsyFctnIhbtByTrlr "no - none of ADAS functions is inhibited by trailer
yes - some ADAS functions are being inhibited by trailer";
CM_ SG_ 752 AsyLaneChgWarnMod "LDW function warning mode.";
CM_ SG_ 752 AsySftyFctStsToEDRACCFctSTs "The signal indicates the function status of the ACC function.";
CM_ SG_ 752 AsySftyFctStsToEDRACSFB1FctSts "The signal indicates the function status of the HWA function.";
CM_ SG_ 752 AsySftyFctStsToEDRACSFB2FctSts "The signal indicates the function status of the ACSF B2.";
CM_ SG_ 752 AsySftyFctStsToEDRACSFCFctSts "The signal indicates the function status of the ALCA function.";
CM_ SG_ 752 AsySftyFctStsToEDRACSFDFctSts "The signal indicates the function status of the ACSF D.";
CM_ SG_ 752 AsySftyFctStsToEDRACSFEFctSts "The signal indicates the function status of the ACSF E.";
CM_ SG_ 752 AsySftyFctStsToEDRAEBSFctSts "The signal indicates the function status of the AEB and FCW function.";
CM_ SG_ 752 AsySftyFctStsToEDRCSFFctSts "The signal indicates the function status of the LKA function.";
CM_ SG_ 752 AsySftyFctStsToEDRESFFctSts "The signal indicates the function status of the ELKA function.";
CM_ SG_ 752 AsySftyFctStsToEDRLDWSFctSts "The signal indicates the function status of the LDW function.";
CM_ SG_ 752 AsySftyHWLReq "Request to turn on/off the Hazard Warning Light";
CM_ SG_ 752 CllsnAidPostEMA "incident text message for EMA";
CM_ SG_ 752 CllsnMtgtnFctSts "Shows if the AEB function is on or off. ";
CM_ SG_ 752 CllsnMtgtnWarnSts "Shows the FCW function switch and sensitivity status.";
CM_ SG_ 752 CllsnWarnReOn1 "Shows the RCW function status. ";
CM_ SG_ 752 CpmOn1 "the request to select REM by switch in HMI.";
CM_ SG_ 752 CtraOn1 "Shows the RCTA function status. ";
CM_ SG_ 752 CtryForRoadSgnInfo "Country to be used for the presentation of  traffic signs.";
CM_ SG_ 752 DoorOpenwarnOn1 "Shows the DOW function status. ";
CM_ SG_ 752 LaneChgAutActvSts "Signal indicating the status of the automatic lane change in High Way Assist (HWA) function.";
CM_ SG_ 752 LcmaAudWarn "Vedio warning";
CM_ SG_ 752 RoadMiscSgnInfoSts "Indicates if road miscellaneous sign shall be displayed or not.";
CM_ SG_ 752 RsdsSysSts "rader system status";
CM_ SG_ 752 SpdAlrmActvSts "Indicates TSR warning function status.";
CM_ SG_ 752 SpdLimCamFirst "Indicates if speed limit camera symbol (electronic eyes) shall be displayed or not.";
CM_ SG_ 752 SpdLimUnit "Indicates current speed limit sign units.";
CM_ SG_ 752 TrfcInfoMiscFirst "Indicates current miscellaneous sign (No entrance, No stop, etc).";
CM_ SG_ 416 AdjSpdLimnActvnOk "The signal informs if Speed Limiter (ASL/AVSL) can be activated or not. Primarily used by HMI to know if Speed Limiter activation requests by driver should be ignored or not.";
CM_ SG_ 416 AdjSpdLimnMsg "The signal triggers visual messages in DIM to inform the driver relevant information about the Speed Limiter (ASL/AVSL)";
CM_ SG_ 416 AdjSpdLimnStbOk "The signal informs if Speed Limiter (ASL/AVSL) can be set to standby or not.
";
CM_ SG_ 416 AdjSpdLimnSts "The signal indicates the status (or state) of the Speed Limiter (ASL/AVSL); Off, Standby, Actv etc.";
CM_ SG_ 416 ADThemeDisp "DIM theme display, depending on current autonomous driving level";
CM_ SG_ 416 AsyALgtCtrlMod1 "longitudinal control mode signal";
CM_ SG_ 416 AsyALgtCtrlModChks "counter";
CM_ SG_ 416 AsyALgtCtrlModCntr "checksum";
CM_ SG_ 416 AsyALgtReqForCmftAsyCmftLgtNegLimForJerk "AsyCmftLgtNegLimForJerk";
CM_ SG_ 416 AsyALgtReqForCmftAsyCmftLgtPosLimForJerk "AsyCmftLgtPosLimForJerk";
CM_ SG_ 416 AsyALgtReqForCmftMax "max";
CM_ SG_ 416 AsyALgtReqForCmftMin "min";
CM_ SG_ 416 AsyALgtStsAsyALgtSts "The signal indicates the status of the longitudinal control; off, passive, standby, active etc.";
CM_ SG_ 416 AsyALgtStsChks "check sum for E2E
";
CM_ SG_ 416 AsyALgtStsCntr "counter for E2E";
CM_ SG_ 416 AsyLatCtrlModReqGroupAsyLatCtrlModReq "lateral control mode signal";
CM_ SG_ 416 AsyLatCtrlModReqGroupChks "checksum";
CM_ SG_ 416 AsyLatCtrlModReqGroupCntr "counter";
CM_ SG_ 416 AsySftyEnaDecelByDBSAsySftyEnaDecelByDBS "Indicate the DBS function activation";
CM_ SG_ 416 AsySftyEnaDecelByDBSChks "CRC";
CM_ SG_ 416 AsySftyEnaDecelByDBSCntr "counter";
CM_ SG_ 416 AsyStandStillReqForCmft "AsyStandStillReqForCmft";
CM_ SG_ 416 BrkHptcWarnReqForAutDrvBrkHptcWarnReqForAutDrv "To indicate the relative subsystem to excute a haptic warning (short brake) for driver.";
CM_ SG_ 416 BrkHptcWarnReqForAutDrvChks "crc";
CM_ SG_ 416 BrkHptcWarnReqForAutDrvCntr "counter";
CM_ SG_ 416 CllsnThreat "Indicate the danger level for subsystem.";
CM_ SG_ 416 CnclWarnForAutDrv "ASDM sends a signal when GPilot function exits";
CM_ SG_ 416 DispSpdSetForLgtCtrl "Indicates the current setting speed value for longitudinal control.";
CM_ SG_ 416 DispTSIInfoForLgtCtrl "To show the type of Setting speed, for example, Driver setting speed or TSI speed";
CM_ SG_ 416 DrvOffReqForLgtCtrl "Indicates the driving-off requirement of longitudinal control";
CM_ SG_ 416 FctaIndcnLe "Indicates if a left FCTA warning shall be shown to the driver or not.";
CM_ SG_ 416 FctaIndcnRi "Indicates if a right FCTA warning shall be shown to the driver or not.";
CM_ SG_ 416 LimSts "auto/manual LIM founction states";
CM_ SG_ 416 NonTrvrsbleRoadEdgeOnLeft "To indicate whether there is non-traversable road edge on the left side of ego lane";
CM_ SG_ 416 NonTrvrsbleRoadEdgeOnRight "To indicate whether there is non-traversable road edge on the right side of ego lane";
CM_ SG_ 416 ObjFrnt1ColorOfObjFrnt1 "the information of Front object 1";
CM_ SG_ 416 ObjFrnt1DstLatOfObjFrnt1 "the information of Front object 1";
CM_ SG_ 416 ObjFrnt1DstLgtOfObjFrnt1 "the information of Front object 1";
CM_ SG_ 416 ObjFrnt1HdDirOfObjFrnt1 "the information of Front object 1";
CM_ SG_ 416 ObjFrnt1TypOfObjFrnt1 "the information of Front object 1";
CM_ SG_ 416 ObjFrnt2ColorOfObjFrnt2 "the information of Front object 2";
CM_ SG_ 416 ObjFrnt2DstLatOfObjFrnt2 "the information of Front object 2";
CM_ SG_ 416 ObjFrnt2DstLgtOfObjFrnt2 "the information of Front object 2";
CM_ SG_ 416 ObjFrnt2HdDirOfObjFrnt2 "the information of Front object 2";
CM_ SG_ 416 ObjFrnt2TypOfObjFrnt2 "the information of Front object 2";
CM_ SG_ 416 ObjFrntLeColorOfObjFrntLe "the information of Front left object";
CM_ SG_ 416 ObjFrntLeDstLatOfObjFrntLe "the information of Front left object";
CM_ SG_ 416 ObjFrntLeDstLgtOfObjFrntLe "the information of Front left object";
CM_ SG_ 416 ObjFrntLeHdDirOfObjFrntLe "the information of Front left object";
CM_ SG_ 416 ObjFrntLeTypOfObjFrntLe "the information of Front left object";
CM_ SG_ 416 ObjFrntRiColorOfObjFrntRi "the information of Front left object";
CM_ SG_ 416 ObjFrntRiDstLatOfObjFrntRi "the information of Front left object";
CM_ SG_ 416 ObjFrntRiDstLgtOfObjFrntRi "the information of Front left object";
CM_ SG_ 416 ObjFrntRiHdDirOfObjFrntRi "the information of Front left object";
CM_ SG_ 416 ObjFrntRiTypOfObjFrntRi "the information of Front left object";
CM_ SG_ 416 PtVehSpdMaxChks "Checksum of PtVehSpdMax";
CM_ SG_ 416 PtVehSpdMaxCntr "Counter of PtVehSpdMax";
CM_ SG_ 416 PtVehSpdMaxReq " The signal shall limit the vehicle speed for e.g. reverse with electric engine and manipulation of the speed signal.";
CM_ SG_ 416 RcwmBrkReqChks "Brake request from RCW to brake controller.couner";
CM_ SG_ 416 RcwmBrkReqCntr "Brake request from RCW to brake controller.checksum";
CM_ SG_ 416 RcwmBrkReqRcwmBrkReq "Brake request from RCW to brake controller.";
CM_ SG_ 416 RoadSgnInfoSts "Indicates the TSR function status.";
CM_ SG_ 416 SftyDecelGroupSafeAsySftyDecelReq "target deceleration";
CM_ SG_ 416 SftyDecelGroupSafeAsySftyEnaDecel "brake order
";
CM_ SG_ 416 SftyDecelGroupSafeChks "crc";
CM_ SG_ 416 SftyDecelGroupSafeCntr "counter";
CM_ SG_ 416 SpdLimFirst "The speed limit for DIM and HUD to display.";
CM_ SG_ 1152 AgCtrlTqLowrLim "Lower limit for angle controller torque request.";
CM_ SG_ 1152 AgCtrlTqUpprLim "Upper limit for angle controller torque request.";
CM_ SG_ 1152 AsyObjForBigData1AbsLatSpd "Describe the reletive latent speed of object.";
CM_ SG_ 1152 AsyObjForBigData1AbsLgtSpd "Describe the reletive latent speed of object.";
CM_ SG_ 1152 AsyObjForBigData1Confidence "Describe the confidence of the object type.";
CM_ SG_ 1152 AsyObjForBigData1RlvtLatDst "Describe the latent distance of object.";
CM_ SG_ 1152 AsyObjForBigData1RlvtLgtDst "Describe the longitudinal distance of object.";
CM_ SG_ 1152 AsyObjForBigData1SnsrSrcOfAbsLatSpd "Describe source of reletive latent speed of object.";
CM_ SG_ 1152 AsyObjForBigData1SnsrSrcOfAbsLgtSpd "Describe source of reletive longitudinal speed of object.";
CM_ SG_ 1152 AsyObjForBigData1TTC "Describe the TTC between host vehicle and object.";
CM_ SG_ 1152 AsyObjForBigData1Type "Describe type of object.";
CM_ SG_ 1152 AsyObjForBigData2AbsLatSpd "Describe the reletive latent speed of object.";
CM_ SG_ 1152 AsyObjForBigData2AbsLgtSpd "Describe the reletive latent speed of object.";
CM_ SG_ 1152 AsyObjForBigData2Confidence "Describe the confidence of the object type.";
CM_ SG_ 1152 AsyObjForBigData2RlvtLatDst "Describe the latent distance of object.";
CM_ SG_ 1152 AsyObjForBigData2RlvtLgtDst "Describe the longitudinal distance of object.";
CM_ SG_ 1152 AsyObjForBigData2SnsrSrcOfAbsLatSpd "Describe source of reletive latent speed of object.";
CM_ SG_ 1152 AsyObjForBigData2SnsrSrcOfAbsLgtSpd "Describe source of reletive longitudinal speed of object.";
CM_ SG_ 1152 AsyObjForBigData2TTC "Describe the TTC between host vehicle and object.";
CM_ SG_ 1152 AsyObjForBigData2Type "Describe type of object.";
CM_ SG_ 1152 AsyPinionAgReqSafeAsyPinionAgReq "Steering request signal from Active Safety with end-to-end protection ";
CM_ SG_ 1152 AsyPinionAgReqSafeAsyPinionAgReqChks "CRC";
CM_ SG_ 1152 AsyPinionAgReqSafeAsyPinionAgReqCntr "Counter";
CM_ SG_ 1152 ExtLiDataDayNight "Signal indicating Day, Twilight or Night based on ambient light intensity.";
CM_ SG_ 1152 ExtLiDataHiWay "Highway with driveways separated with guardrail in between.";
CM_ SG_ 1152 ExtLiDataInCity "city";
CM_ SG_ 1152 ExtLiDataInTunnel "tunnel";
CM_ SG_ 1152 ExtLiDataTiStamp "TimeStamp";
CM_ SG_ 1152 ExtLiDataTrfcSide "Trafic side.";
CM_ SG_ 1152 RctaBrkReqQM "Indicating RCTA braking is committed.
This signal complies with QM.";
CM_ SG_ 511 AsyLineRi2Pah2PrmA "Supply the parameters to creat second right 2 line segment of the path of lane lines";
CM_ SG_ 511 AsyLineRi2Pah2PrmB "Supply the parameters to creat second right 2 line segment of the path of lane lines";
CM_ SG_ 511 AsyLineRi2Pah2PrmC "Supply the parameters to creat second right 2 line segment of the path of lane lines";
CM_ SG_ 511 AsyLineRi2Pah2PrmD "Supply the parameters to creat second right 2 line segment of the path of lane lines";
CM_ SG_ 511 AsyLineRiPah2PrmA "Supply the parameters to creat second right line segment of the path of lane lines";
CM_ SG_ 511 AsyLineRiPah2PrmB "Supply the parameters to creat second right line segment of the path of lane lines";
CM_ SG_ 511 AsyLineRiPah2PrmC "Supply the parameters to creat second right line segment of the path of lane lines";
CM_ SG_ 511 AsyLineRiPah2PrmD "Supply the parameters to creat second right line segment of the path of lane lines";
CM_ SG_ 511 AsyLineRiPahPrmA "DX-distance ";
CM_ SG_ 511 AsyLineRiPahPrmB "yaw angle radian";
CM_ SG_ 511 AsyLineRiPahPrmC "curvature";
CM_ SG_ 511 AsyLineRiPahPrmD "curvature change";
CM_ SG_ 511 AsyLineRiRampPosn "To display the position of ramp.
far
middle
near";
CM_ SG_ 511 AsyLineRiTyp "The signal indicates the type of the right line of ego lane.";
CM_ SG_ 511 AsyRi2FirstEnd "End point of the first right 2 line segment";
CM_ SG_ 511 AsyRi2FirstStrt "Start point of the first right 2 line segment";
CM_ SG_ 511 AsyRi2SecEnd "End point of the second right 2 line segment";
CM_ SG_ 511 AsyRi2SecStrt "Start point of the second right 2 line segment";
CM_ SG_ 511 AsyRiFirstEnd "End point of the first right line segment";
CM_ SG_ 511 AsyRiFirstStrt "End point of the second right line segment";
CM_ SG_ 511 AsyRiSecEnd "End point of the second right line segment";
CM_ SG_ 511 AsyRiSecStrt "Start point of the second right line segment";
CM_ SG_ 511 AsyRoadCrvt "An estimation of the road curvature. This signal will give the curvature of the road edge, barrier or lane marking, depending on which kind of intervention currently active.";
CM_ SG_ 511 AsySafeStopSts "SafeStop status of NOA/HWA";
CM_ SG_ 511 AsySodLaneChgSwitch "the status feedback of voice activation for lane changing";
CM_ SG_ 511 AsySodPilotCfirm "the status feedback of voice activation for G-Pilot";
CM_ SG_ 511 AvlStsForLongAutDrvSound "function unavaliable sound signal";
CM_ SG_ 511 CnclWarnForAutDrvSound "cancal warning sound signal";
CM_ SG_ 511 CnclWarnLgtForAutDrvSound "function cancal warning sound signal";
CM_ SG_ 511 FrntLidarSts0 "Front Lidar status for display";
CM_ SG_ 511 FrntSideCamLeSts0 "Front Left Side Camera status for display";
CM_ SG_ 511 FrntSideCamRiSts0 "Front Right Side Camera status for display";
CM_ SG_ 511 HmiAsyVehicleFirstEnd "End point of the first line segment";
CM_ SG_ 511 HmiAsyVehicleFirstStrt "Start point of the first line segment";
CM_ SG_ 511 HmiAsyVehiclePah2PrmA "Supply the parameters to creat second line segment of the path of vehicle lines";
CM_ SG_ 511 HmiAsyVehiclePah2PrmB "Supply the parameters to creat second line segment of the path of vehicle lines";
CM_ SG_ 511 HmiAsyVehiclePah2PrmC "Supply the parameters to creat second line segment of the path of vehicle lines";
CM_ SG_ 511 HmiAsyVehiclePah2PrmD "Supply the parameters to creat second  line segment of the path of vehicle lines";
CM_ SG_ 511 HmiAsyVehiclePahDisp "The signal indicates if the vehicle path diaplays.";
CM_ SG_ 511 HmiAsyVehiclePahPrmA "DX-distance ";
CM_ SG_ 511 HmiAsyVehiclePahPrmB "yaw angle radian";
CM_ SG_ 511 HmiAsyVehiclePahPrmC "curvature";
CM_ SG_ 511 HmiAsyVehiclePahPrmD "curvature change";
CM_ SG_ 511 HmiAsyVehicleSecEnd "End point of the second line segment";
CM_ SG_ 511 HmiAsyVehicleSecStrt "Start point of the second line segment";
CM_ SG_ 511 HmiAutoLaneChgStyle "This switch is used to set auto lane change mode with speed. ";
CM_ SG_ 511 HmiCrosswalkAngle "Rotational angle of the crosswalk relative to the vehicle direction";
CM_ SG_ 511 HmiCrosswalkcolor "crosswalk color";
CM_ SG_ 511 HmiCrosswalklateralDistance "Lateral distance to the crosswalk front edge center";
CM_ SG_ 511 HmiCrosswalklength "Length of the crosswalk";
CM_ SG_ 511 HmiCrosswalklongitudinalDistance "Longitudinal distance to the crosswalk front edge";
CM_ SG_ 511 HmiCrosswalkTiStamp "TimeStamp";
CM_ SG_ 511 HmiCrosswalkwidth "Width of the crosswalk";
CM_ SG_ 511 HmiLaneChgInfo "inform the driver with message please change lane ahead";
CM_ SG_ 511 OvrdWrnForFstActv "override warning to the driver at the first engine start period when ACC is working";
CM_ SG_ 640 AsyALatIndcr "Lateral control on/off/active/standby/error status HMI indicator display";
CM_ SG_ 640 AsyALgtIndcr "Longitudinal control on/off/active/standby/error status HMI indicator display";
CM_ SG_ 640 AsyObjForBigData0AbsLatSpd "Describe the reletive latent speed of object.";
CM_ SG_ 640 AsyObjForBigData0AbsLgtSpd "Describe the reletive latent speed of object.";
CM_ SG_ 640 AsyObjForBigData0Confidence "Describe the confidence of the object type.";
CM_ SG_ 640 AsyObjForBigData0RlvtLatDst "Describe the latent distance of object.";
CM_ SG_ 640 AsyObjForBigData0RlvtLgtDst "Describe the longitudinal distance of object.";
CM_ SG_ 640 AsyObjForBigData0SnsrSrcOfAbsLatSpd "Describe source of reletive latent speed of object.";
CM_ SG_ 640 AsyObjForBigData0SnsrSrcOfAbsLgtSpd "Describe source of reletive longitudinal speed of object.";
CM_ SG_ 640 AsyObjForBigData0TTC "Describe the TTC between host vehicle and object.";
CM_ SG_ 640 AsyObjForBigData0Type "Describe type of object.";
CM_ SG_ 640 AsyObjType "The signal indicates the type of the front object for AEB function.";
CM_ SG_ 640 AsyWarnForSteerCncl "Lane keeping assist cancel message";
CM_ SG_ 640 AvlStsForLongAutDrv "ACC unable to activate reason message";
CM_ SG_ 640 CamStatus0 "camera status for DIM ";
CM_ SG_ 640 CllsnAidPost "indicate the AEB  brake intervention to the driver.";
CM_ SG_ 640 CllsnMtgtnFaultSts "This signal represents status of collision mitigation support system of front and front side.";
CM_ SG_ 640 CllsnMtgtnOnoffSts "Collision front and front side mitigation support function on/off status";
CM_ SG_ 640 CllsnWarnReIndcn "Request to activate collision warning against rear object";
CM_ SG_ 640 CnclWarnLgtForAutDrv "to show that  the longitudinal control is canceled.";
CM_ SG_ 640 DrvOffMod "drvoff fuction is on/off/error";
CM_ SG_ 640 DrvOffWarn "This signal is used to warn that the preceding vehicle is driving off.";
CM_ SG_ 640 FrntRdrSts0 "Front Radar status for display";
CM_ SG_ 640 FrntSideRdrLeSts0 "Left Front Side Radar status for display";
CM_ SG_ 640 FrntSideRdrRiSts0 "Right Front Side Radar status for display";
CM_ SG_ 640 HmiAutoLaneChgStsForAsyAIAsistAudio "Autonomously lane change inform for audio subsystem";
CM_ SG_ 640 IHUSetDispAD "indicate the fault/active status of ACC/G-Pilot function, to control setting clickable status and fault report on IHU
";
CM_ SG_ 640 LcmaOn "Shows the LCA function status. ";
CM_ SG_ 640 LeTTCLv "Left side TTC level information ";
CM_ SG_ 640 OffsForSpdWarnSetgSts "Indicates the speed offset to speed limit warn for TSR function.";
CM_ SG_ 640 ReSideRdrLeSts0 "Left rear Side Radar status for display";
CM_ SG_ 640 ReSideRdrRiSts0 "Right rear Side Radar status for display";
CM_ SG_ 640 RiTTCLv "Right side TTC level information ";
CM_ SG_ 640 SpdLimCoupldFirst "Received by DIM to display relevant speed limit symbol or not.";
CM_ SG_ 640 SpdLimSec "Upcoming speed limit for DIM to display.";
CM_ SG_ 640 SpdLimSpplFirst "Indicates current supplementary speed limit sign.";
CM_ SG_ 640 SpdLimWarnReq "Request to activate warning for too high speed compared to current speed limit.
";
CM_ SG_ 640 SpdLimWarnReqAud "Request to activate warning for too high speed compared to current speed limit.";
CM_ SG_ 640 TooManyCars "Whether there are too many cars";
CM_ SG_ 288 AsyAutDrvgAvl "The signal is send to HMI  , when driver press active button ,HMI should display the message :G-pilot function is not available in this driving cycle signal";
CM_ SG_ 288 AsyLatOffstSts "This Signal is Lateral Offset for Truck and RoadEdge";
CM_ SG_ 288 AsySteerApplyRqrd "Request to the driver information system to inform that driver has to put hands on steering wheel.";
CM_ SG_ 288 BrkPrecActv "Indicate to active brake prefill for driver.";
CM_ SG_ 288 DoorOpenwarnLeIndcn "Indicates if a left door open,warning shall be shown to the driver or not.
If the left door open (FL door open or  RL door open or FL and RL both open), the warning signal will send out.";
CM_ SG_ 288 DoorOpenwarnRiIndcn "Indicates if a right door open, warning shall be shown to the driver or not.
If the right door open( FR door open or  RR door open or FR and RR both open), the warning signal will send out.";
CM_ SG_ 288 IntvAndWarnModInfoSts "Feedback to HMI for IntvAndWarnModForLaneKeepAidSts";
CM_ SG_ 288 LaneChgAutInfoForAsyHiWay "Request to the driver information system to inform that left or right lane can automatically change lane.";
CM_ SG_ 288 LaneChgAutStsForAsyHiWay "Signals indicates if the automatic lane change is active or successful or failed.";
CM_ SG_ 288 LcmaIndcnLe "LCA left waning signal.";
CM_ SG_ 288 LcmaIndcnRi "LCA right waning signal";
CM_ SG_ 288 RctaBrkReqChks "RCTA brake request signal.couner";
CM_ SG_ 288 RctaBrkReqCntr "RCTA brake request signal.checksum";
CM_ SG_ 288 RctaBrkReqRctaBrkReq "RCTA brake request signal.";
CM_ SG_ 288 RctaIndcnLe "RCTA left warning signal";
CM_ SG_ 288 RctaIndcnRi "RCTA right warning signal";
CM_ SG_ 288 TiGapSetForLgtCtrl "Longitudinal control time gap setting value";
CM_ SG_ 864 AsyLanChgSodSec "another voice warning for Lane change";
CM_ SG_ 864 AsyLaneChgAssistSts "the status of ALCA";
CM_ SG_ 864 AsyLaneChgFailType "the type of failure";
CM_ SG_ 864 CameraStsforAHBC "To discribe camera can working or not.";
CM_ SG_ 864 LitArea "Whether the host vehicle is in a lit area";
CM_ SG_ 864 RcwmLiReq "RCW lit the hazard light request.";
CM_ SG_ 864 TurnIndicReqByALCA "control turn indicator lamps turn on or turn off. when 0-turn off, 1-turn on left turn indicator lamps, 2-turn on right turn indicator lamp";
CM_ SG_ 437 FrntSideLidarLeSts0 "lidar status for DIM ";
CM_ SG_ 437 FrntSideLidarRiSts0 "lidar status for DIM ";
CM_ SG_ 437 HmiMovgObj10ColorOfHmiMovgObj "the information of moving object 1";
CM_ SG_ 437 HmiMovgObj10DstLatOfMovgObj "the information of moving object 1";
CM_ SG_ 437 HmiMovgObj10DstLgtOfMovgObj "the information of moving object 1";
CM_ SG_ 437 HmiMovgObj10HdDirOfMovgObj "the information of moving object 1";
CM_ SG_ 437 HmiMovgObj10HmiMovgObjTyp "the information of moving object 1";
CM_ SG_ 437 HmiMovgObj11ColorOfHmiMovgObj "the information of moving object 1";
CM_ SG_ 437 HmiMovgObj11DstLatOfMovgObj "the information of moving object 1";
CM_ SG_ 437 HmiMovgObj11DstLgtOfMovgObj "the information of moving object 1";
CM_ SG_ 437 HmiMovgObj11HdDirOfMovgObj "the information of moving object 1";
CM_ SG_ 437 HmiMovgObj11HmiMovgObjTyp "the information of moving object 1";
CM_ SG_ 437 HmiMovgObj1ColorOfHmiMovgObj "the information of moving object 1";
CM_ SG_ 437 HmiMovgObj1DstLatOfMovgObj "the information of moving object 1";
CM_ SG_ 437 HmiMovgObj1DstLgtOfMovgObj "the information of moving object 1";
CM_ SG_ 437 HmiMovgObj1HdDirOfMovgObj "the information of moving object 1";
CM_ SG_ 437 HmiMovgObj1HmiMovgObjTyp "the information of moving object 1";
CM_ SG_ 437 HmiMovgObj2ColorOfHmiMovgObj "the information of moving object 1";
CM_ SG_ 437 HmiMovgObj2DstLatOfMovgObj "the information of moving object 1";
CM_ SG_ 437 HmiMovgObj2DstLgtOfMovgObj "the information of moving object 1";
CM_ SG_ 437 HmiMovgObj2HdDirOfMovgObj "the information of moving object 1";
CM_ SG_ 437 HmiMovgObj2HmiMovgObjTyp "the information of moving object 1";
CM_ SG_ 437 HmiMovgObj3ColorOfHmiMovgObj "the information of moving object 1";
CM_ SG_ 437 HmiMovgObj3DstLatOfMovgObj "the information of moving object 1";
CM_ SG_ 437 HmiMovgObj3DstLgtOfMovgObj "the information of moving object 1";
CM_ SG_ 437 HmiMovgObj3HdDirOfMovgObj "the information of moving object 1";
CM_ SG_ 437 HmiMovgObj3HmiMovgObjTyp "the information of moving object 1";
CM_ SG_ 437 HmiMovgObj4ColorOfHmiMovgObj "the information of moving object 1";
CM_ SG_ 437 HmiMovgObj4DstLatOfMovgObj "the information of moving object 1";
CM_ SG_ 437 HmiMovgObj4DstLgtOfMovgObj "the information of moving object 1";
CM_ SG_ 437 HmiMovgObj4HdDirOfMovgObj "the information of moving object 1";
CM_ SG_ 437 HmiMovgObj4HmiMovgObjTyp "the information of moving object 1";
CM_ SG_ 437 HmiMovgObj5ColorOfHmiMovgObj "the information of moving object 1";
CM_ SG_ 437 HmiMovgObj5DstLatOfMovgObj "the information of moving object 1";
CM_ SG_ 437 HmiMovgObj5DstLgtOfMovgObj "the information of moving object 1";
CM_ SG_ 437 HmiMovgObj5HdDirOfMovgObj "the information of moving object 1";
CM_ SG_ 437 HmiMovgObj5HmiMovgObjTyp "the information of moving object 1";
CM_ SG_ 437 HmiMovgObj6ColorOfHmiMovgObj "the information of moving object 1";
CM_ SG_ 437 HmiMovgObj6DstLatOfMovgObj "the information of moving object 1";
CM_ SG_ 437 HmiMovgObj6DstLgtOfMovgObj "the information of moving object 1";
CM_ SG_ 437 HmiMovgObj6HdDirOfMovgObj "the information of moving object 1";
CM_ SG_ 437 HmiMovgObj6HmiMovgObjTyp "the information of moving object 1";
CM_ SG_ 437 HmiMovgObj7ColorOfHmiMovgObj "the information of moving object 1";
CM_ SG_ 437 HmiMovgObj7DstLatOfMovgObj "the information of moving object 1";
CM_ SG_ 437 HmiMovgObj7DstLgtOfMovgObj "the information of moving object 1";
CM_ SG_ 437 HmiMovgObj7HdDirOfMovgObj "the information of moving object 1";
CM_ SG_ 437 HmiMovgObj7HmiMovgObjTyp "the information of moving object 1";
CM_ SG_ 437 HmiMovgObj8ColorOfHmiMovgObj "the information of moving object 1";
CM_ SG_ 437 HmiMovgObj8DstLatOfMovgObj "the information of moving object 1";
CM_ SG_ 437 HmiMovgObj8DstLgtOfMovgObj "the information of moving object 1";
CM_ SG_ 437 HmiMovgObj8HdDirOfMovgObj "the information of moving object 1";
CM_ SG_ 437 HmiMovgObj8HmiMovgObjTyp "the information of moving object 1";
CM_ SG_ 437 HmiMovgObj9ColorOfHmiMovgObj "the information of moving object 1";
CM_ SG_ 437 HmiMovgObj9DstLatOfMovgObj "the information of moving object 1";
CM_ SG_ 437 HmiMovgObj9DstLgtOfMovgObj "the information of moving object 1";
CM_ SG_ 437 HmiMovgObj9HdDirOfMovgObj "the information of moving object 1";
CM_ SG_ 437 HmiMovgObj9HmiMovgObjTyp "the information of moving object 1";
CM_ SG_ 437 HmiNOPCofmOfLanChag "subswitch of Pilot fusion navigation menu setting.";
CM_ SG_ 437 HmiReCamSts0 "Rear Camera  status";
CM_ SG_ 437 HWALeadingPointCenterX "lateral coordinate is variable based on the lateral distance between the vehicle and the target point ";
CM_ SG_ 437 HWALeadingPointCenterY "The longitudinal coordinates of the end of the lane change is a fixed value 40m(tunable)";
CM_ SG_ 437 HWALeadingPointValid "indicates whether the point is available";
CM_ SG_ 437 LaneKeepAidInfoSts "Feedback to HMI for LaneKeepAidActvSts";
CM_ SG_ 437 ReLidarSts0 "lidar status for DIM ";
CM_ SG_ 437 ReSideLidarLeSts0 "lidar status for DIM ";
CM_ SG_ 437 ReSideLidarRiSts0 "lidar status for DIM ";
CM_ SG_ 480 HmiRoadArrow1HmiRoadArrowLane "Road arrow lane relevancy";
CM_ SG_ 480 HmiRoadArrow1HmiRoadArrowTyp "Type of road arrow";
CM_ SG_ 480 HmiRoadArrow1LatPosition "The lateral position of a road arrow.";
CM_ SG_ 480 HmiRoadArrow1LongPosition "The longitudinal position of a road arrow.";
CM_ SG_ 480 HmiRoadArrow2HmiRoadArrowLane "Road arrow lane relevancy";
CM_ SG_ 480 HmiRoadArrow2HmiRoadArrowTyp "Type of road arrow";
CM_ SG_ 480 HmiRoadArrow2LatPosition "The lateral position of a road arrow.";
CM_ SG_ 480 HmiRoadArrow2LongPosition "The longitudinal position of a road arrow.";
CM_ SG_ 480 HmiRoadArrow3HmiRoadArrowLane "Road arrow lane relevancy";
CM_ SG_ 480 HmiRoadArrow3HmiRoadArrowTyp "Type of road arrow";
CM_ SG_ 480 HmiRoadArrow3LatPosition "The lateral position of a road arrow.";
CM_ SG_ 480 HmiRoadArrow3LongPosition "The longitudinal position of a road arrow.";
CM_ SG_ 480 HmiRoadArrow4HmiRoadArrowLane "Road arrow lane relevancy";
CM_ SG_ 480 HmiRoadArrow4HmiRoadArrowTyp "Type of road arrow";
CM_ SG_ 480 HmiRoadArrow4LatPosition "The lateral position of a road arrow.";
CM_ SG_ 480 HmiRoadArrow4LongPosition "The longitudinal position of a road arrow.";
CM_ SG_ 480 HmiRoadArrow5HmiRoadArrowLane "Road arrow lane relevancy";
CM_ SG_ 480 HmiRoadArrow5HmiRoadArrowTyp "Type of road arrow";
CM_ SG_ 480 HmiRoadArrow5LatPosition "The lateral position of a road arrow.";
CM_ SG_ 480 HmiRoadArrow5LongPosition "The longitudinal position of a road arrow.";
CM_ SG_ 480 HmiStaticObj1DstLatOfStaticObj "the information of static object 1";
CM_ SG_ 480 HmiStaticObj1DstLgtOfStaticObj "the information of static object 1";
CM_ SG_ 480 HmiStaticObj1HmiStaticObjTyp "the information of static object 1";
CM_ SG_ 480 HmiStaticObj2DstLatOfStaticObj "the information of static object 1";
CM_ SG_ 480 HmiStaticObj2DstLgtOfStaticObj "the information of static object 1";
CM_ SG_ 480 HmiStaticObj2HmiStaticObjTyp "the information of static object 1";
CM_ SG_ 480 HmiStaticObj3DstLatOfStaticObj "the information of static object 1";
CM_ SG_ 480 HmiStaticObj3DstLgtOfStaticObj "the information of static object 1";
CM_ SG_ 480 HmiStaticObj3HmiStaticObjTyp "the information of static object 1";
CM_ SG_ 480 HmiStaticObj4DstLatOfStaticObj "the information of static object 1";
CM_ SG_ 480 HmiStaticObj4DstLgtOfStaticObj "the information of static object 1";
CM_ SG_ 480 HmiStaticObj4HmiStaticObjTyp "the information of static object 1";
CM_ SG_ 480 HmiStaticObj5DstLatOfStaticObj "the information of static object 1";
CM_ SG_ 480 HmiStaticObj5DstLgtOfStaticObj "the information of static object 1";
CM_ SG_ 480 HmiStaticObj5HmiStaticObjTyp "the information of static object 1";
CM_ SG_ 480 HmiStaticObj6DstLatOfStaticObj "the information of static object 1";
CM_ SG_ 480 HmiStaticObj6DstLgtOfStaticObj "the information of static object 1";
CM_ SG_ 480 HmiStaticObj6HmiStaticObjTyp "the information of static object 1";
CM_ SG_ 480 HmiStaticObj7DstLatOfStaticObj "the information of static object 1";
CM_ SG_ 480 HmiStaticObj7DstLgtOfStaticObj "the information of static object 1";
CM_ SG_ 480 HmiStaticObj7HmiStaticObjTyp "the information of static object 1";
CM_ SG_ 480 HmiStaticObj8DstLatOfStaticObj "the information of static object 1";
CM_ SG_ 480 HmiStaticObj8DstLgtOfStaticObj "the information of static object 1";
CM_ SG_ 480 HmiStaticObj8HmiStaticObjTyp "the information of static object 1";
CM_ SG_ 480 HmiStopLineConfidence "Confidence of the stop line information.";
CM_ SG_ 480 HmiStopLineDistanceToStopLine "Distance in meters to the detected stop line.";
CM_ SG_ 480 HmiStopLineStopLinePresent "Indicated if stop line is detected in front of the host.";
CM_ SG_ 480 HmiStopLineTiStamp "TimeStamp";
CM_ SG_ 480 ReSideCamLeSts0 "Rear Left Side Camera status for display";
CM_ SG_ 480 ReSideCamRiSts0 "Rear Right Side Camera status for display";
CM_ SG_ 480 SelfLaneColor "Status signal which indicates the color of ego lane.";
CM_ SG_ 400 SteerTqAddlForEmaChks "Checksum";
CM_ SG_ 400 SteerTqAddlForEmaCntr "Live counter";
CM_ SG_ 400 SteerTqAddlForEmaSteerTqAddlForEma "when EMA function triggered, ASDM should send this signal to PSCM and archive a torque overlay (0.5nm TBD)which can help the driver to maneuver the evasive intervention.";
CM_ SG_ 400 StopReqOfLgtCtrlForPrpsn "This signal is used to ask the engine to stop.";
CM_ SG_ 400 StrtReqOfLgtCtrlForPrpsn "This signal is used to ask the engine to start.";
CM_ SG_ 400 TrafficSignForADB1AdbAbsDist "refer to VehObjforADB1";
CM_ SG_ 400 TrafficSignForADB1AdbDetdQly "refer to VehObjforADB1";
CM_ SG_ 400 TrafficSignForADB1AdbHozlAgLe "refer to VehObjforADB1";
CM_ SG_ 400 TrafficSignForADB1AdbHozlAgRi "refer to VehObjforADB1";
CM_ SG_ 400 TrafficSignForADB1AdbTrkInfo "refer to VehObjforADB1";
CM_ SG_ 400 TrafficSignForADB1AdbVertAgBot "angle between ego vehicle camera and the bottom of object ";
CM_ SG_ 400 TrafficSignForADB1AdbVertAgTop "angle between ego vehicle camera and the top of object ";
CM_ SG_ 400 TrafficSignForADB2AdbAbsDist "refer to VehObjforADB1";
CM_ SG_ 400 TrafficSignForADB2AdbDetdQly "refer to VehObjforADB1";
CM_ SG_ 400 TrafficSignForADB2AdbHozlAgLe "refer to VehObjforADB1";
CM_ SG_ 400 TrafficSignForADB2AdbHozlAgRi "refer to VehObjforADB1";
CM_ SG_ 400 TrafficSignForADB2AdbTrkInfo "refer to VehObjforADB1";
CM_ SG_ 400 TrafficSignForADB2AdbVertAgBot "angle between ego vehicle camera and the bottom of object ";
CM_ SG_ 400 TrafficSignForADB2AdbVertAgTop "angle between ego vehicle camera and the top of object ";
CM_ SG_ 400 VehObjforAHBAdbAbsDist "refer to VehObjforADB1";
CM_ SG_ 400 VehObjforAHBAdbClassn "refer to VehObjforADB1";
CM_ SG_ 400 VehObjforAHBAdbClassnQly "refer to VehObjforADB1";
CM_ SG_ 400 VehObjforAHBAdbDetdQly "refer to VehObjforADB1";
CM_ SG_ 400 VehObjforAHBAdbHozlAg "refer to VehObjforADB1";
CM_ SG_ 400 VehObjforAHBAdbObjDir "refer to VehObjforADB1";
CM_ SG_ 400 VehObjforAHBAdbObjHozlAgSpd "refer to VehObjforADB1";
CM_ SG_ 400 VehObjforAHBAdbObjVertAgSpd "refer to VehObjforADB1";
CM_ SG_ 400 VehObjforAHBAdbTrkInfo "refer to VehObjforADB1";
CM_ SG_ 400 VehObjforAHBAdbVertAg "refer to VehObjforADB1";
CM_ SG_ 400 WarnForAsyEmgyLaneKeepAid "ELKA warning request to inform the driver.";

BA_DEF_  "BaudRateCANFD" FLOAT 1000 10000000;
BA_DEF_  "Baudrate" INT 1000 1000000;
BA_DEF_  "BusType" STRING;
BA_DEF_  "DBName" STRING;
BA_DEF_  "ProtocolType" STRING;
BA_DEF_ BU_ "NmAsrNode" ENUM "No","Yes";
BA_DEF_ BU_ "NmAsrNodeIdentifier" INT 0 255;
BA_DEF_ BO_ "CANFD_BRS" ENUM "0","1";
BA_DEF_ BO_ "GenMsgCycleTime" INT 0 65536;
BA_DEF_ BO_ "GenMsgDelayTime" INT 0 65536;
BA_DEF_ BO_ "GenMsgSendType" ENUM "cyclic", "spontaneous", "not-used", "not-used", "not-used", "cyclicAndSpontaneous", "not-used", "cyclicIfActive", "NoMsgSendType";
BA_DEF_ BO_ "GenMsgStartDelayTime" INT 0 65536;
BA_DEF_ BO_ "VFrameFormat" ENUM "StandardCAN","ExtendedCAN","reserved","J1939PG","reserved","reserved","reserved","reserved","reserved","reserved","reserved","reserved","reserved","reserved","StandardCAN_FD","ExtendedCAN_FD";
BA_DEF_ SG_ "GenSigSendType" ENUM "Cyclic","OnWrite","OnWriteWithRepetition","OnChange","OnChangeWithRepetition","IfActive","IfActiveWithRepetition","NoSigSendType";
BA_DEF_ SG_ "GenSigStartValue" HEX 0 80000000;
BA_DEF_ BO_ "GenMsgILSupport" ENUM "No","Yes";
BA_DEF_ BO_ "NmAsrMessage" ENUM "No","Yes";
BA_DEF_  "NmAsrBaseAddress" HEX 0 536870911;
BA_DEF_  "NmAsrMessageCount" INT 0 255;
BA_DEF_ BU_ "NodeLayerModules" STRING;
BA_DEF_ BU_ "ILused" ENUM "No","Yes";
BA_DEF_ SG_ "GenSigFuncType" ENUM "NoFunction","n/a","n/a","n/a","n/a","n/a","n/a","n/a","n/a","n/a","n/a","n/a","n/a","n/a","n/a","CHK","CNTR","n/a","n/a","n/a","CNTR_AR_01","CRC_AR_01_BOTH","CRC_AR_01_ALT","CRC_AR_01_LOW","CRC_AR_01_NIBBLE","CNTR_AR_04","CRC_AR_04A","CNTR_AR_05","CRC_AR_05";
BA_DEF_ SG_ "GenSigDataID" STRING;
BA_DEF_ SG_ "SigGroup" STRING;

BA_DEF_DEF_ "BusType" "";
BA_DEF_DEF_ "DBName" "";
BA_DEF_DEF_ "ProtocolType" "";
BA_DEF_DEF_ "NmAsrNode" "No";
BA_DEF_DEF_ "NmAsrNodeIdentifier" 0;
BA_DEF_DEF_ "CANFD_BRS" "1";
BA_DEF_DEF_ "GenSigStartValue" 0;
BA_DEF_DEF_ "VFrameFormat" "J1939PG";
BA_DEF_DEF_ "GenSigSendType" "NoSigSendType";
BA_DEF_DEF_ "GenMsgCycleTime" 0;
BA_DEF_DEF_ "GenMsgDelayTime" 0;
BA_DEF_DEF_ "GenMsgStartDelayTime" 0;
BA_DEF_DEF_ "GenMsgSendType" "NoMsgSendType";
BA_DEF_DEF_ "GenMsgILSupport" "Yes";
BA_DEF_DEF_ "NmAsrMessage" "No";
BA_DEF_DEF_ "NmAsrBaseAddress" 1280;
BA_DEF_DEF_ "NmAsrMessageCount" 64;
BA_DEF_DEF_ "NodeLayerModules" "CANoeILNLSPA.dll";
BA_DEF_DEF_ "ILused" "Yes";
BA_DEF_DEF_ "GenSigFuncType" "NoFunction";
BA_DEF_DEF_ "GenSigDataID" "";
BA_DEF_DEF_ "SigGroup" "";

BA_ "BaudRateCANFD" 2000000;
BA_ "Baudrate" 500000;
BA_ "BusType" "CAN FD";
BA_ "DBName" "ZCU_CANFD1";
BA_ "ProtocolType" "CAN";

BA_ "NmAsrNode" BU_ ASDM 1;
BA_ "NmAsrNodeIdentifier" BU_ ASDM 1;
BA_ "NodeLayerModules" BU_ ASDM "CANoeILNLSPA.dll,AsrNM33.dll";

BA_ "NmAsrNode" BU_ BBM 1;
BA_ "NmAsrNodeIdentifier" BU_ BBM 40;
BA_ "NodeLayerModules" BU_ BBM "CANoeILNLSPA.dll,AsrNM33.dll";

BA_ "ILused" BU_ ETC 0;

BA_ "NmAsrNode" BU_ IHU 1;
BA_ "NmAsrNodeIdentifier" BU_ IHU 9;
BA_ "NodeLayerModules" BU_ IHU "CANoeILNLSPA.dll,AsrNM33.dll";

BA_ "NmAsrNode" BU_ ZCUD 1;
BA_ "NmAsrNodeIdentifier" BU_ ZCUD 3;
BA_ "NodeLayerModules" BU_ ZCUD "CANoeILNLSPA.dll,AsrNM33.dll";

BA_ "NmAsrNode" BU_ ZCUP 1;
BA_ "NmAsrNodeIdentifier" BU_ ZCUP 5;
BA_ "NodeLayerModules" BU_ ZCUP "CANoeILNLSPA.dll,AsrNM33.dll";

BA_ "GenMsgCycleTime" BO_ 306 20.000;
BA_ "GenMsgSendType" BO_ 306 0;
BA_ "VFrameFormat" BO_ 306 14;

BA_ "GenMsgCycleTime" BO_ 448 30.000;
BA_ "GenMsgSendType" BO_ 448 0;
BA_ "VFrameFormat" BO_ 448 14;

BA_ "GenMsgCycleTime" BO_ 496 30.000;
BA_ "GenMsgSendType" BO_ 496 0;
BA_ "VFrameFormat" BO_ 496 14;

BA_ "GenMsgCycleTime" BO_ 752 80.000;
BA_ "GenMsgSendType" BO_ 752 0;
BA_ "VFrameFormat" BO_ 752 14;

BA_ "GenMsgCycleTime" BO_ 416 20.000;
BA_ "GenMsgSendType" BO_ 416 0;
BA_ "VFrameFormat" BO_ 416 14;

BA_ "GenMsgCycleTime" BO_ 1152 1000.000;
BA_ "GenMsgSendType" BO_ 1152 0;
BA_ "VFrameFormat" BO_ 1152 14;

BA_ "GenMsgCycleTime" BO_ 511 40.000;
BA_ "GenMsgSendType" BO_ 511 0;
BA_ "VFrameFormat" BO_ 511 14;

BA_ "GenMsgCycleTime" BO_ 640 70.000;
BA_ "GenMsgSendType" BO_ 640 0;
BA_ "VFrameFormat" BO_ 640 14;

BA_ "GenMsgCycleTime" BO_ 288 10.000;
BA_ "GenMsgSendType" BO_ 288 0;
BA_ "VFrameFormat" BO_ 288 14;

BA_ "GenMsgCycleTime" BO_ 864 100.000;
BA_ "GenMsgSendType" BO_ 864 0;
BA_ "VFrameFormat" BO_ 864 14;

BA_ "GenMsgCycleTime" BO_ 437 40.000;
BA_ "GenMsgSendType" BO_ 437 0;
BA_ "VFrameFormat" BO_ 437 14;

BA_ "GenMsgCycleTime" BO_ 480 40.000;
BA_ "GenMsgSendType" BO_ 480 0;
BA_ "VFrameFormat" BO_ 480 14;

BA_ "GenMsgCycleTime" BO_ 400 50.000;
BA_ "GenMsgSendType" BO_ 400 0;
BA_ "VFrameFormat" BO_ 400 14;
BA_ "GenSigSendType" SG_ 496 ADDimLight 0;
BA_ "GenSigSendType" SG_ 416 ADThemeDisp 0;
BA_ "GenSigSendType" SG_ 752 AccFusnTrfcSgn 0;
BA_ "GenSigSendType" SG_ 752 ActvSafeCtrlrSts 0;
BA_ "GenSigSendType" SG_ 416 AdjSpdLimnActvnOk 0;
BA_ "GenSigSendType" SG_ 416 AdjSpdLimnMsg 0;
BA_ "GenSigSendType" SG_ 416 AdjSpdLimnStbOk 0;
BA_ "GenSigSendType" SG_ 416 AdjSpdLimnSts 0;
BA_ "GenSigStartValue" SG_ 416 AdjSpdLimnSts 1;
BA_ "GenSigSendType" SG_ 1152 AgCtrlTqLowrLim 0;
BA_ "GenSigStartValue" SG_ 1152 AgCtrlTqLowrLim 240;
BA_ "GenSigSendType" SG_ 1152 AgCtrlTqUpprLim 0;
BA_ "GenSigStartValue" SG_ 1152 AgCtrlTqUpprLim 240;
BA_ "GenSigSendType" SG_ 640 AsyALatIndcr 0;
BA_ "GenSigSendType" SG_ 416 AsyALgtCtrlMod1 0;
BA_ "GenSigDataID" SG_ 416 AsyALgtCtrlModChks "0xD16";
BA_ "GenSigFuncType" SG_ 416 AsyALgtCtrlModChks 15;
BA_ "GenSigSendType" SG_ 416 AsyALgtCtrlModChks 0;
BA_ "GenSigFuncType" SG_ 416 AsyALgtCtrlModCntr 16;
BA_ "GenSigSendType" SG_ 416 AsyALgtCtrlModCntr 0;
BA_ "GenSigSendType" SG_ 640 AsyALgtIndcr 0;
BA_ "GenSigSendType" SG_ 416 AsyALgtReqForCmftAsyCmftLgtNegLimForJerk 0;
BA_ "GenSigStartValue" SG_ 416 AsyALgtReqForCmftAsyCmftLgtNegLimForJerk 3000;
BA_ "GenSigSendType" SG_ 416 AsyALgtReqForCmftAsyCmftLgtPosLimForJerk 0;
BA_ "GenSigStartValue" SG_ 416 AsyALgtReqForCmftAsyCmftLgtPosLimForJerk 3000;
BA_ "GenSigSendType" SG_ 416 AsyALgtReqForCmftMax 0;
BA_ "GenSigStartValue" SG_ 416 AsyALgtReqForCmftMax 1200;
BA_ "GenSigSendType" SG_ 416 AsyALgtReqForCmftMin 0;
BA_ "GenSigStartValue" SG_ 416 AsyALgtReqForCmftMin 1200;
BA_ "GenSigSendType" SG_ 416 AsyALgtStsAsyALgtSts 0;
BA_ "GenSigDataID" SG_ 416 AsyALgtStsChks "0xAF0";
BA_ "GenSigFuncType" SG_ 416 AsyALgtStsChks 15;
BA_ "GenSigSendType" SG_ 416 AsyALgtStsChks 0;
BA_ "GenSigFuncType" SG_ 416 AsyALgtStsCntr 16;
BA_ "GenSigSendType" SG_ 416 AsyALgtStsCntr 0;
BA_ "GenSigSendType" SG_ 496 AsyAutDrvCtrlTyp 0;
BA_ "GenSigSendType" SG_ 288 AsyAutDrvgAvl 0;
BA_ "GenSigSendType" SG_ 496 AsyAutDrvgAvlSound 0;
BA_ "GenSigSendType" SG_ 752 AsyEmgyLaneKeepAid 0;
BA_ "GenSigStartValue" SG_ 752 AsyEmgyLaneKeepAid 1;
BA_ "GenSigSendType" SG_ 496 AsyEmgyLaneKeepAidSts 0;
BA_ "GenSigStartValue" SG_ 496 AsyEmgyLaneKeepAidSts 3;
BA_ "GenSigSendType" SG_ 752 AsyEmgyManoeuvreAidSts 0;
BA_ "GenSigStartValue" SG_ 752 AsyEmgyManoeuvreAidSts 1;
BA_ "GenSigSendType" SG_ 752 AsyFctnIhbtByTrlr 0;
BA_ "GenSigSendType" SG_ 496 AsyLanChgColorDsp 0;
BA_ "GenSigSendType" SG_ 496 AsyLanChgMesg 0;
BA_ "GenSigSendType" SG_ 496 AsyLanChgSod 0;
BA_ "GenSigSendType" SG_ 864 AsyLanChgSodSec 0;
BA_ "GenSigSendType" SG_ 864 AsyLaneChgAssistSts 0;
BA_ "GenSigSendType" SG_ 864 AsyLaneChgFailType 0;
BA_ "GenSigSendType" SG_ 752 AsyLaneChgWarnMod 0;
BA_ "GenSigStartValue" SG_ 752 AsyLaneChgWarnMod 2;
BA_ "GenSigSendType" SG_ 496 AsyLaneKeepAidSts 0;
BA_ "GenSigSendType" SG_ 416 AsyLatCtrlModReqGroupAsyLatCtrlModReq 0;
BA_ "GenSigDataID" SG_ 416 AsyLatCtrlModReqGroupChks "0x1ED2";
BA_ "GenSigFuncType" SG_ 416 AsyLatCtrlModReqGroupChks 15;
BA_ "GenSigSendType" SG_ 416 AsyLatCtrlModReqGroupChks 0;
BA_ "GenSigFuncType" SG_ 416 AsyLatCtrlModReqGroupCntr 16;
BA_ "GenSigSendType" SG_ 416 AsyLatCtrlModReqGroupCntr 0;
BA_ "GenSigSendType" SG_ 496 AsyLatDegSts 0;
BA_ "GenSigSendType" SG_ 288 AsyLatOffstSts 0;
BA_ "GenSigSendType" SG_ 496 AsyLe2FirstEnd 0;
BA_ "GenSigStartValue" SG_ 496 AsyLe2FirstEnd 30;
BA_ "GenSigSendType" SG_ 496 AsyLe2FirstStrt 0;
BA_ "GenSigStartValue" SG_ 496 AsyLe2FirstStrt 30;
BA_ "GenSigSendType" SG_ 496 AsyLe2SecEnd 0;
BA_ "GenSigStartValue" SG_ 496 AsyLe2SecEnd 30;
BA_ "GenSigSendType" SG_ 496 AsyLe2SecStrt 0;
BA_ "GenSigStartValue" SG_ 496 AsyLe2SecStrt 30;
BA_ "GenSigSendType" SG_ 496 AsyLeFirstEnd 0;
BA_ "GenSigStartValue" SG_ 496 AsyLeFirstEnd 30;
BA_ "GenSigSendType" SG_ 496 AsyLeFirstStrt 0;
BA_ "GenSigStartValue" SG_ 496 AsyLeFirstStrt 30;
BA_ "GenSigSendType" SG_ 496 AsyLeSecEnd 0;
BA_ "GenSigStartValue" SG_ 496 AsyLeSecEnd 30;
BA_ "GenSigSendType" SG_ 496 AsyLeSecStrt 0;
BA_ "GenSigStartValue" SG_ 496 AsyLeSecStrt 30;
BA_ "GenSigSendType" SG_ 306 AsyLgtCtrlTakeOverReq 0;
BA_ "GenSigSendType" SG_ 496 AsyLineDstLe 0;
BA_ "GenSigStartValue" SG_ 496 AsyLineDstLe 127;
BA_ "GenSigSendType" SG_ 496 AsyLineDstRi 0;
BA_ "GenSigStartValue" SG_ 496 AsyLineDstRi 127;
BA_ "GenSigSendType" SG_ 496 AsyLineLe2Color 0;
BA_ "GenSigSendType" SG_ 496 AsyLineLe2Pah2PrmA 0;
BA_ "GenSigStartValue" SG_ 496 AsyLineLe2Pah2PrmA 3000;
BA_ "GenSigSendType" SG_ 496 AsyLineLe2Pah2PrmB 0;
BA_ "GenSigStartValue" SG_ 496 AsyLineLe2Pah2PrmB 1600;
BA_ "GenSigSendType" SG_ 496 AsyLineLe2Pah2PrmC 0;
BA_ "GenSigStartValue" SG_ 496 AsyLineLe2Pah2PrmC 1000;
BA_ "GenSigSendType" SG_ 496 AsyLineLe2Pah2PrmD 0;
BA_ "GenSigStartValue" SG_ 496 AsyLineLe2Pah2PrmD 1000;
BA_ "GenSigSendType" SG_ 496 AsyLineLe2PahPrmA 0;
BA_ "GenSigStartValue" SG_ 496 AsyLineLe2PahPrmA 3000;
BA_ "GenSigSendType" SG_ 496 AsyLineLe2PahPrmB 0;
BA_ "GenSigStartValue" SG_ 496 AsyLineLe2PahPrmB 1600;
BA_ "GenSigSendType" SG_ 496 AsyLineLe2PahPrmC 0;
BA_ "GenSigStartValue" SG_ 496 AsyLineLe2PahPrmC 1000;
BA_ "GenSigSendType" SG_ 496 AsyLineLe2PahPrmD 0;
BA_ "GenSigStartValue" SG_ 496 AsyLineLe2PahPrmD 1000;
BA_ "GenSigSendType" SG_ 496 AsyLineLe2RampPosn 0;
BA_ "GenSigStartValue" SG_ 496 AsyLineLe2RampPosn 30;
BA_ "GenSigSendType" SG_ 496 AsyLineLe2RampTyp 0;
BA_ "GenSigSendType" SG_ 496 AsyLineLe2Typ 0;
BA_ "GenSigSendType" SG_ 496 AsyLineLeColor 0;
BA_ "GenSigSendType" SG_ 496 AsyLineLePah2PrmA 0;
BA_ "GenSigStartValue" SG_ 496 AsyLineLePah2PrmA 3000;
BA_ "GenSigSendType" SG_ 496 AsyLineLePah2PrmB 0;
BA_ "GenSigStartValue" SG_ 496 AsyLineLePah2PrmB 1600;
BA_ "GenSigSendType" SG_ 496 AsyLineLePah2PrmC 0;
BA_ "GenSigStartValue" SG_ 496 AsyLineLePah2PrmC 1000;
BA_ "GenSigSendType" SG_ 496 AsyLineLePah2PrmD 0;
BA_ "GenSigStartValue" SG_ 496 AsyLineLePah2PrmD 1000;
BA_ "GenSigSendType" SG_ 496 AsyLineLePahPrmA 0;
BA_ "GenSigStartValue" SG_ 496 AsyLineLePahPrmA 3000;
BA_ "GenSigSendType" SG_ 496 AsyLineLePahPrmB 0;
BA_ "GenSigStartValue" SG_ 496 AsyLineLePahPrmB 1600;
BA_ "GenSigSendType" SG_ 496 AsyLineLePahPrmC 0;
BA_ "GenSigStartValue" SG_ 496 AsyLineLePahPrmC 1000;
BA_ "GenSigSendType" SG_ 496 AsyLineLePahPrmD 0;
BA_ "GenSigStartValue" SG_ 496 AsyLineLePahPrmD 1000;
BA_ "GenSigSendType" SG_ 496 AsyLineLeRampPosn 0;
BA_ "GenSigStartValue" SG_ 496 AsyLineLeRampPosn 30;
BA_ "GenSigSendType" SG_ 496 AsyLineLeRampTyp 0;
BA_ "GenSigSendType" SG_ 496 AsyLineLeTyp 0;
BA_ "GenSigSendType" SG_ 496 AsyLineRi2Color 0;
BA_ "GenSigSendType" SG_ 511 AsyLineRi2Pah2PrmA 0;
BA_ "GenSigStartValue" SG_ 511 AsyLineRi2Pah2PrmA 3000;
BA_ "GenSigSendType" SG_ 511 AsyLineRi2Pah2PrmB 0;
BA_ "GenSigStartValue" SG_ 511 AsyLineRi2Pah2PrmB 1600;
BA_ "GenSigSendType" SG_ 511 AsyLineRi2Pah2PrmC 0;
BA_ "GenSigStartValue" SG_ 511 AsyLineRi2Pah2PrmC 1000;
BA_ "GenSigSendType" SG_ 511 AsyLineRi2Pah2PrmD 0;
BA_ "GenSigStartValue" SG_ 511 AsyLineRi2Pah2PrmD 1000;
BA_ "GenSigSendType" SG_ 496 AsyLineRi2PahPrmA 0;
BA_ "GenSigStartValue" SG_ 496 AsyLineRi2PahPrmA 3000;
BA_ "GenSigSendType" SG_ 496 AsyLineRi2PahPrmB 0;
BA_ "GenSigStartValue" SG_ 496 AsyLineRi2PahPrmB 1600;
BA_ "GenSigSendType" SG_ 496 AsyLineRi2PahPrmC 0;
BA_ "GenSigStartValue" SG_ 496 AsyLineRi2PahPrmC 1000;
BA_ "GenSigSendType" SG_ 496 AsyLineRi2PahPrmD 0;
BA_ "GenSigStartValue" SG_ 496 AsyLineRi2PahPrmD 1000;
BA_ "GenSigSendType" SG_ 496 AsyLineRi2RampPosn 0;
BA_ "GenSigStartValue" SG_ 496 AsyLineRi2RampPosn 30;
BA_ "GenSigSendType" SG_ 496 AsyLineRi2RampTyp 0;
BA_ "GenSigSendType" SG_ 496 AsyLineRi2Typ 0;
BA_ "GenSigSendType" SG_ 496 AsyLineRiColor 0;
BA_ "GenSigSendType" SG_ 511 AsyLineRiPah2PrmA 0;
BA_ "GenSigStartValue" SG_ 511 AsyLineRiPah2PrmA 3000;
BA_ "GenSigSendType" SG_ 511 AsyLineRiPah2PrmB 0;
BA_ "GenSigStartValue" SG_ 511 AsyLineRiPah2PrmB 1600;
BA_ "GenSigSendType" SG_ 511 AsyLineRiPah2PrmC 0;
BA_ "GenSigStartValue" SG_ 511 AsyLineRiPah2PrmC 1000;
BA_ "GenSigSendType" SG_ 511 AsyLineRiPah2PrmD 0;
BA_ "GenSigStartValue" SG_ 511 AsyLineRiPah2PrmD 1000;
BA_ "GenSigSendType" SG_ 511 AsyLineRiPahPrmA 0;
BA_ "GenSigStartValue" SG_ 511 AsyLineRiPahPrmA 3000;
BA_ "GenSigSendType" SG_ 511 AsyLineRiPahPrmB 0;
BA_ "GenSigStartValue" SG_ 511 AsyLineRiPahPrmB 1600;
BA_ "GenSigSendType" SG_ 511 AsyLineRiPahPrmC 0;
BA_ "GenSigStartValue" SG_ 511 AsyLineRiPahPrmC 1000;
BA_ "GenSigSendType" SG_ 511 AsyLineRiPahPrmD 0;
BA_ "GenSigStartValue" SG_ 511 AsyLineRiPahPrmD 1000;
BA_ "GenSigSendType" SG_ 511 AsyLineRiRampPosn 0;
BA_ "GenSigStartValue" SG_ 511 AsyLineRiRampPosn 30;
BA_ "GenSigSendType" SG_ 496 AsyLineRiRampTyp 0;
BA_ "GenSigSendType" SG_ 511 AsyLineRiTyp 0;
BA_ "GenSigSendType" SG_ 496 AsyNoaActvSuggest 0;
BA_ "GenSigSendType" SG_ 640 AsyObjForBigData0AbsLatSpd 0;
BA_ "GenSigStartValue" SG_ 640 AsyObjForBigData0AbsLatSpd 64;
BA_ "GenSigSendType" SG_ 640 AsyObjForBigData0AbsLgtSpd 0;
BA_ "GenSigSendType" SG_ 640 AsyObjForBigData0Confidence 0;
BA_ "GenSigSendType" SG_ 640 AsyObjForBigData0RlvtLatDst 0;
BA_ "GenSigStartValue" SG_ 640 AsyObjForBigData0RlvtLatDst 250;
BA_ "GenSigSendType" SG_ 640 AsyObjForBigData0RlvtLgtDst 0;
BA_ "GenSigSendType" SG_ 640 AsyObjForBigData0SnsrSrcOfAbsLatSpd 0;
BA_ "GenSigSendType" SG_ 640 AsyObjForBigData0SnsrSrcOfAbsLgtSpd 0;
BA_ "GenSigSendType" SG_ 640 AsyObjForBigData0TTC 0;
BA_ "GenSigStartValue" SG_ 640 AsyObjForBigData0TTC 127;
BA_ "GenSigSendType" SG_ 640 AsyObjForBigData0Type 0;
BA_ "GenSigStartValue" SG_ 640 AsyObjForBigData0Type 9;
BA_ "GenSigSendType" SG_ 1152 AsyObjForBigData1AbsLatSpd 0;
BA_ "GenSigStartValue" SG_ 1152 AsyObjForBigData1AbsLatSpd 64;
BA_ "GenSigSendType" SG_ 1152 AsyObjForBigData1AbsLgtSpd 0;
BA_ "GenSigSendType" SG_ 1152 AsyObjForBigData1Confidence 0;
BA_ "GenSigSendType" SG_ 1152 AsyObjForBigData1RlvtLatDst 0;
BA_ "GenSigStartValue" SG_ 1152 AsyObjForBigData1RlvtLatDst 250;
BA_ "GenSigSendType" SG_ 1152 AsyObjForBigData1RlvtLgtDst 0;
BA_ "GenSigSendType" SG_ 1152 AsyObjForBigData1SnsrSrcOfAbsLatSpd 0;
BA_ "GenSigSendType" SG_ 1152 AsyObjForBigData1SnsrSrcOfAbsLgtSpd 0;
BA_ "GenSigSendType" SG_ 1152 AsyObjForBigData1TTC 0;
BA_ "GenSigStartValue" SG_ 1152 AsyObjForBigData1TTC 127;
BA_ "GenSigSendType" SG_ 1152 AsyObjForBigData1Type 0;
BA_ "GenSigStartValue" SG_ 1152 AsyObjForBigData1Type 9;
BA_ "GenSigSendType" SG_ 1152 AsyObjForBigData2AbsLatSpd 0;
BA_ "GenSigStartValue" SG_ 1152 AsyObjForBigData2AbsLatSpd 64;
BA_ "GenSigSendType" SG_ 1152 AsyObjForBigData2AbsLgtSpd 0;
BA_ "GenSigSendType" SG_ 1152 AsyObjForBigData2Confidence 0;
BA_ "GenSigSendType" SG_ 1152 AsyObjForBigData2RlvtLatDst 0;
BA_ "GenSigStartValue" SG_ 1152 AsyObjForBigData2RlvtLatDst 250;
BA_ "GenSigSendType" SG_ 1152 AsyObjForBigData2RlvtLgtDst 0;
BA_ "GenSigSendType" SG_ 1152 AsyObjForBigData2SnsrSrcOfAbsLatSpd 0;
BA_ "GenSigSendType" SG_ 1152 AsyObjForBigData2SnsrSrcOfAbsLgtSpd 0;
BA_ "GenSigSendType" SG_ 1152 AsyObjForBigData2TTC 0;
BA_ "GenSigStartValue" SG_ 1152 AsyObjForBigData2TTC 127;
BA_ "GenSigSendType" SG_ 1152 AsyObjForBigData2Type 0;
BA_ "GenSigStartValue" SG_ 1152 AsyObjForBigData2Type 9;
BA_ "GenSigSendType" SG_ 640 AsyObjType 0;
BA_ "GenSigSendType" SG_ 1152 AsyPinionAgReqSafeAsyPinionAgReq 0;
BA_ "GenSigStartValue" SG_ 1152 AsyPinionAgReqSafeAsyPinionAgReq 14848;
BA_ "GenSigDataID" SG_ 1152 AsyPinionAgReqSafeAsyPinionAgReqChks "0x2F7";
BA_ "GenSigFuncType" SG_ 1152 AsyPinionAgReqSafeAsyPinionAgReqChks 15;
BA_ "GenSigSendType" SG_ 1152 AsyPinionAgReqSafeAsyPinionAgReqChks 0;
BA_ "GenSigFuncType" SG_ 1152 AsyPinionAgReqSafeAsyPinionAgReqCntr 16;
BA_ "GenSigSendType" SG_ 1152 AsyPinionAgReqSafeAsyPinionAgReqCntr 0;
BA_ "GenSigSendType" SG_ 511 AsyRi2FirstEnd 0;
BA_ "GenSigStartValue" SG_ 511 AsyRi2FirstEnd 30;
BA_ "GenSigSendType" SG_ 511 AsyRi2FirstStrt 0;
BA_ "GenSigStartValue" SG_ 511 AsyRi2FirstStrt 30;
BA_ "GenSigSendType" SG_ 511 AsyRi2SecEnd 0;
BA_ "GenSigStartValue" SG_ 511 AsyRi2SecEnd 30;
BA_ "GenSigSendType" SG_ 511 AsyRi2SecStrt 0;
BA_ "GenSigStartValue" SG_ 511 AsyRi2SecStrt 30;
BA_ "GenSigSendType" SG_ 511 AsyRiFirstEnd 0;
BA_ "GenSigStartValue" SG_ 511 AsyRiFirstEnd 30;
BA_ "GenSigSendType" SG_ 511 AsyRiFirstStrt 0;
BA_ "GenSigStartValue" SG_ 511 AsyRiFirstStrt 30;
BA_ "GenSigSendType" SG_ 511 AsyRiSecEnd 0;
BA_ "GenSigStartValue" SG_ 511 AsyRiSecEnd 30;
BA_ "GenSigSendType" SG_ 511 AsyRiSecStrt 0;
BA_ "GenSigStartValue" SG_ 511 AsyRiSecStrt 30;
BA_ "GenSigSendType" SG_ 511 AsyRoadCrvt 0;
BA_ "GenSigStartValue" SG_ 511 AsyRoadCrvt 128;
BA_ "GenSigSendType" SG_ 511 AsySafeStopSts 0;
BA_ "GenSigSendType" SG_ 416 AsySftyEnaDecelByDBSAsySftyEnaDecelByDBS 0;
BA_ "GenSigDataID" SG_ 416 AsySftyEnaDecelByDBSChks "0x29C";
BA_ "GenSigFuncType" SG_ 416 AsySftyEnaDecelByDBSChks 15;
BA_ "GenSigSendType" SG_ 416 AsySftyEnaDecelByDBSChks 0;
BA_ "GenSigFuncType" SG_ 416 AsySftyEnaDecelByDBSCntr 16;
BA_ "GenSigSendType" SG_ 416 AsySftyEnaDecelByDBSCntr 0;
BA_ "GenSigSendType" SG_ 752 AsySftyFctStsToEDRACCFctSTs 0;
BA_ "GenSigSendType" SG_ 752 AsySftyFctStsToEDRACSFB1FctSts 0;
BA_ "GenSigSendType" SG_ 752 AsySftyFctStsToEDRACSFB2FctSts 0;
BA_ "GenSigSendType" SG_ 752 AsySftyFctStsToEDRACSFCFctSts 0;
BA_ "GenSigSendType" SG_ 752 AsySftyFctStsToEDRACSFDFctSts 0;
BA_ "GenSigSendType" SG_ 752 AsySftyFctStsToEDRACSFEFctSts 0;
BA_ "GenSigSendType" SG_ 752 AsySftyFctStsToEDRAEBSFctSts 0;
BA_ "GenSigSendType" SG_ 752 AsySftyFctStsToEDRCSFFctSts 0;
BA_ "GenSigSendType" SG_ 752 AsySftyFctStsToEDRESFFctSts 0;
BA_ "GenSigSendType" SG_ 752 AsySftyFctStsToEDRLDWSFctSts 0;
BA_ "GenSigSendType" SG_ 752 AsySftyHWLReq 0;
BA_ "GenSigSendType" SG_ 511 AsySodLaneChgSwitch 0;
BA_ "GenSigSendType" SG_ 511 AsySodPilotCfirm 0;
BA_ "GenSigSendType" SG_ 416 AsyStandStillReqForCmft 0;
BA_ "GenSigSendType" SG_ 288 AsySteerApplyRqrd 0;
BA_ "GenSigSendType" SG_ 448 AsySteerWhlHptcWarnReq 0;
BA_ "GenSigSendType" SG_ 640 AsyWarnForSteerCncl 0;
BA_ "GenSigSendType" SG_ 640 AvlStsForLongAutDrv 0;
BA_ "GenSigSendType" SG_ 511 AvlStsForLongAutDrvSound 0;
BA_ "GenSigSendType" SG_ 416 BrkHptcWarnReqForAutDrvBrkHptcWarnReqForAutDrv 0;
BA_ "GenSigDataID" SG_ 416 BrkHptcWarnReqForAutDrvChks "0xD27";
BA_ "GenSigFuncType" SG_ 416 BrkHptcWarnReqForAutDrvChks 15;
BA_ "GenSigSendType" SG_ 416 BrkHptcWarnReqForAutDrvChks 0;
BA_ "GenSigFuncType" SG_ 416 BrkHptcWarnReqForAutDrvCntr 16;
BA_ "GenSigSendType" SG_ 416 BrkHptcWarnReqForAutDrvCntr 0;
BA_ "GenSigSendType" SG_ 288 BrkPrecActv 0;
BA_ "GenSigSendType" SG_ 640 CamStatus0 0;
BA_ "GenSigStartValue" SG_ 640 CamStatus0 5;
BA_ "GenSigSendType" SG_ 864 CameraStsforAHBC 0;
BA_ "GenSigSendType" SG_ 640 CllsnAidPost 0;
BA_ "GenSigSendType" SG_ 752 CllsnAidPostEMA 0;
BA_ "GenSigSendType" SG_ 448 CllsnFwdWarn 0;
BA_ "GenSigSendType" SG_ 640 CllsnMtgtnFaultSts 0;
BA_ "GenSigSendType" SG_ 752 CllsnMtgtnFctSts 0;
BA_ "GenSigStartValue" SG_ 752 CllsnMtgtnFctSts 2;
BA_ "GenSigSendType" SG_ 640 CllsnMtgtnOnoffSts 0;
BA_ "GenSigStartValue" SG_ 640 CllsnMtgtnOnoffSts 1;
BA_ "GenSigSendType" SG_ 752 CllsnMtgtnWarnSts 0;
BA_ "GenSigStartValue" SG_ 752 CllsnMtgtnWarnSts 2;
BA_ "GenSigSendType" SG_ 416 CllsnThreat 0;
BA_ "GenSigSendType" SG_ 640 CllsnWarnReIndcn 0;
BA_ "GenSigSendType" SG_ 752 CllsnWarnReOn1 0;
BA_ "GenSigStartValue" SG_ 752 CllsnWarnReOn1 1;
BA_ "GenSigSendType" SG_ 416 CnclWarnForAutDrv 0;
BA_ "GenSigSendType" SG_ 511 CnclWarnForAutDrvSound 0;
BA_ "GenSigSendType" SG_ 640 CnclWarnLgtForAutDrv 0;
BA_ "GenSigSendType" SG_ 511 CnclWarnLgtForAutDrvSound 0;
BA_ "GenSigSendType" SG_ 752 CpmOn1 1;
BA_ "GenSigSendType" SG_ 752 CtraOn1 0;
BA_ "GenSigStartValue" SG_ 752 CtraOn1 1;
BA_ "GenSigSendType" SG_ 752 CtryForRoadSgnInfo 0;
BA_ "GenSigSendType" SG_ 416 DispSpdSetForLgtCtrl 0;
BA_ "GenSigSendType" SG_ 416 DispTSIInfoForLgtCtrl 0;
BA_ "GenSigSendType" SG_ 288 DoorOpenwarnLeIndcn 0;
BA_ "GenSigSendType" SG_ 752 DoorOpenwarnOn1 0;
BA_ "GenSigStartValue" SG_ 752 DoorOpenwarnOn1 1;
BA_ "GenSigSendType" SG_ 288 DoorOpenwarnRiIndcn 0;
BA_ "GenSigSendType" SG_ 640 DrvOffMod 0;
BA_ "GenSigSendType" SG_ 416 DrvOffReqForLgtCtrl 0;
BA_ "GenSigSendType" SG_ 640 DrvOffWarn 0;
BA_ "GenSigSendType" SG_ 1152 ExtLiDataDayNight 0;
BA_ "GenSigSendType" SG_ 1152 ExtLiDataHiWay 0;
BA_ "GenSigSendType" SG_ 1152 ExtLiDataInCity 0;
BA_ "GenSigSendType" SG_ 1152 ExtLiDataInTunnel 0;
BA_ "GenSigSendType" SG_ 1152 ExtLiDataTiStamp 0;
BA_ "GenSigSendType" SG_ 1152 ExtLiDataTrfcSide 0;
BA_ "GenSigSendType" SG_ 416 FctaIndcnLe 0;
BA_ "GenSigSendType" SG_ 416 FctaIndcnRi 0;
BA_ "GenSigSendType" SG_ 511 FrntLidarSts0 0;
BA_ "GenSigStartValue" SG_ 511 FrntLidarSts0 5;
BA_ "GenSigSendType" SG_ 640 FrntRdrSts0 0;
BA_ "GenSigStartValue" SG_ 640 FrntRdrSts0 5;
BA_ "GenSigSendType" SG_ 511 FrntSideCamLeSts0 0;
BA_ "GenSigStartValue" SG_ 511 FrntSideCamLeSts0 5;
BA_ "GenSigSendType" SG_ 511 FrntSideCamRiSts0 0;
BA_ "GenSigStartValue" SG_ 511 FrntSideCamRiSts0 5;
BA_ "GenSigSendType" SG_ 437 FrntSideLidarLeSts0 0;
BA_ "GenSigStartValue" SG_ 437 FrntSideLidarLeSts0 5;
BA_ "GenSigSendType" SG_ 437 FrntSideLidarRiSts0 0;
BA_ "GenSigStartValue" SG_ 437 FrntSideLidarRiSts0 5;
BA_ "GenSigSendType" SG_ 640 FrntSideRdrLeSts0 0;
BA_ "GenSigStartValue" SG_ 640 FrntSideRdrLeSts0 5;
BA_ "GenSigSendType" SG_ 640 FrntSideRdrRiSts0 0;
BA_ "GenSigStartValue" SG_ 640 FrntSideRdrRiSts0 5;
BA_ "GenSigSendType" SG_ 437 HWALeadingPointCenterX 0;
BA_ "GenSigStartValue" SG_ 437 HWALeadingPointCenterX 250;
BA_ "GenSigSendType" SG_ 437 HWALeadingPointCenterY 0;
BA_ "GenSigSendType" SG_ 437 HWALeadingPointValid 0;
BA_ "GenSigSendType" SG_ 511 HmiAsyVehicleFirstEnd 0;
BA_ "GenSigStartValue" SG_ 511 HmiAsyVehicleFirstEnd 30;
BA_ "GenSigSendType" SG_ 511 HmiAsyVehicleFirstStrt 0;
BA_ "GenSigStartValue" SG_ 511 HmiAsyVehicleFirstStrt 30;
BA_ "GenSigSendType" SG_ 511 HmiAsyVehiclePah2PrmA 0;
BA_ "GenSigStartValue" SG_ 511 HmiAsyVehiclePah2PrmA 3000;
BA_ "GenSigSendType" SG_ 511 HmiAsyVehiclePah2PrmB 0;
BA_ "GenSigStartValue" SG_ 511 HmiAsyVehiclePah2PrmB 1600;
BA_ "GenSigSendType" SG_ 511 HmiAsyVehiclePah2PrmC 0;
BA_ "GenSigStartValue" SG_ 511 HmiAsyVehiclePah2PrmC 1000;
BA_ "GenSigSendType" SG_ 511 HmiAsyVehiclePah2PrmD 0;
BA_ "GenSigStartValue" SG_ 511 HmiAsyVehiclePah2PrmD 1000;
BA_ "GenSigSendType" SG_ 511 HmiAsyVehiclePahDisp 0;
BA_ "GenSigSendType" SG_ 511 HmiAsyVehiclePahPrmA 0;
BA_ "GenSigStartValue" SG_ 511 HmiAsyVehiclePahPrmA 3000;
BA_ "GenSigSendType" SG_ 511 HmiAsyVehiclePahPrmB 0;
BA_ "GenSigStartValue" SG_ 511 HmiAsyVehiclePahPrmB 1600;
BA_ "GenSigSendType" SG_ 511 HmiAsyVehiclePahPrmC 0;
BA_ "GenSigStartValue" SG_ 511 HmiAsyVehiclePahPrmC 1000;
BA_ "GenSigSendType" SG_ 511 HmiAsyVehiclePahPrmD 0;
BA_ "GenSigStartValue" SG_ 511 HmiAsyVehiclePahPrmD 1000;
BA_ "GenSigSendType" SG_ 511 HmiAsyVehicleSecEnd 0;
BA_ "GenSigStartValue" SG_ 511 HmiAsyVehicleSecEnd 30;
BA_ "GenSigSendType" SG_ 511 HmiAsyVehicleSecStrt 0;
BA_ "GenSigStartValue" SG_ 511 HmiAsyVehicleSecStrt 30;
BA_ "GenSigSendType" SG_ 640 HmiAutoLaneChgStsForAsyAIAsistAudio 0;
BA_ "GenSigSendType" SG_ 511 HmiAutoLaneChgStyle 0;
BA_ "GenSigSendType" SG_ 511 HmiCrosswalkAngle 0;
BA_ "GenSigStartValue" SG_ 511 HmiCrosswalkAngle 160;
BA_ "GenSigSendType" SG_ 511 HmiCrosswalkTiStamp 0;
BA_ "GenSigSendType" SG_ 511 HmiCrosswalkcolor 0;
BA_ "GenSigSendType" SG_ 511 HmiCrosswalklateralDistance 0;
BA_ "GenSigStartValue" SG_ 511 HmiCrosswalklateralDistance 1000;
BA_ "GenSigSendType" SG_ 511 HmiCrosswalklength 0;
BA_ "GenSigSendType" SG_ 511 HmiCrosswalklongitudinalDistance 0;
BA_ "GenSigSendType" SG_ 511 HmiCrosswalkwidth 0;
BA_ "GenSigSendType" SG_ 511 HmiLaneChgInfo 0;
BA_ "GenSigSendType" SG_ 437 HmiMovgObj10ColorOfHmiMovgObj 0;
BA_ "GenSigSendType" SG_ 437 HmiMovgObj10DstLatOfMovgObj 0;
BA_ "GenSigStartValue" SG_ 437 HmiMovgObj10DstLatOfMovgObj 250;
BA_ "GenSigSendType" SG_ 437 HmiMovgObj10DstLgtOfMovgObj 0;
BA_ "GenSigStartValue" SG_ 437 HmiMovgObj10DstLgtOfMovgObj 30;
BA_ "GenSigSendType" SG_ 437 HmiMovgObj10HdDirOfMovgObj 0;
BA_ "GenSigSendType" SG_ 437 HmiMovgObj10HmiMovgObjTyp 0;
BA_ "GenSigSendType" SG_ 437 HmiMovgObj11ColorOfHmiMovgObj 0;
BA_ "GenSigSendType" SG_ 437 HmiMovgObj11DstLatOfMovgObj 0;
BA_ "GenSigStartValue" SG_ 437 HmiMovgObj11DstLatOfMovgObj 250;
BA_ "GenSigSendType" SG_ 437 HmiMovgObj11DstLgtOfMovgObj 0;
BA_ "GenSigStartValue" SG_ 437 HmiMovgObj11DstLgtOfMovgObj 30;
BA_ "GenSigSendType" SG_ 437 HmiMovgObj11HdDirOfMovgObj 0;
BA_ "GenSigSendType" SG_ 437 HmiMovgObj11HmiMovgObjTyp 0;
BA_ "GenSigSendType" SG_ 437 HmiMovgObj1ColorOfHmiMovgObj 0;
BA_ "GenSigSendType" SG_ 437 HmiMovgObj1DstLatOfMovgObj 0;
BA_ "GenSigStartValue" SG_ 437 HmiMovgObj1DstLatOfMovgObj 250;
BA_ "GenSigSendType" SG_ 437 HmiMovgObj1DstLgtOfMovgObj 0;
BA_ "GenSigStartValue" SG_ 437 HmiMovgObj1DstLgtOfMovgObj 30;
BA_ "GenSigSendType" SG_ 437 HmiMovgObj1HdDirOfMovgObj 0;
BA_ "GenSigSendType" SG_ 437 HmiMovgObj1HmiMovgObjTyp 0;
BA_ "GenSigSendType" SG_ 437 HmiMovgObj2ColorOfHmiMovgObj 0;
BA_ "GenSigSendType" SG_ 437 HmiMovgObj2DstLatOfMovgObj 0;
BA_ "GenSigStartValue" SG_ 437 HmiMovgObj2DstLatOfMovgObj 250;
BA_ "GenSigSendType" SG_ 437 HmiMovgObj2DstLgtOfMovgObj 0;
BA_ "GenSigStartValue" SG_ 437 HmiMovgObj2DstLgtOfMovgObj 30;
BA_ "GenSigSendType" SG_ 437 HmiMovgObj2HdDirOfMovgObj 0;
BA_ "GenSigSendType" SG_ 437 HmiMovgObj2HmiMovgObjTyp 0;
BA_ "GenSigSendType" SG_ 437 HmiMovgObj3ColorOfHmiMovgObj 0;
BA_ "GenSigSendType" SG_ 437 HmiMovgObj3DstLatOfMovgObj 0;
BA_ "GenSigStartValue" SG_ 437 HmiMovgObj3DstLatOfMovgObj 250;
BA_ "GenSigSendType" SG_ 437 HmiMovgObj3DstLgtOfMovgObj 0;
BA_ "GenSigStartValue" SG_ 437 HmiMovgObj3DstLgtOfMovgObj 30;
BA_ "GenSigSendType" SG_ 437 HmiMovgObj3HdDirOfMovgObj 0;
BA_ "GenSigSendType" SG_ 437 HmiMovgObj3HmiMovgObjTyp 0;
BA_ "GenSigSendType" SG_ 437 HmiMovgObj4ColorOfHmiMovgObj 0;
BA_ "GenSigSendType" SG_ 437 HmiMovgObj4DstLatOfMovgObj 0;
BA_ "GenSigStartValue" SG_ 437 HmiMovgObj4DstLatOfMovgObj 250;
BA_ "GenSigSendType" SG_ 437 HmiMovgObj4DstLgtOfMovgObj 0;
BA_ "GenSigStartValue" SG_ 437 HmiMovgObj4DstLgtOfMovgObj 30;
BA_ "GenSigSendType" SG_ 437 HmiMovgObj4HdDirOfMovgObj 0;
BA_ "GenSigSendType" SG_ 437 HmiMovgObj4HmiMovgObjTyp 0;
BA_ "GenSigSendType" SG_ 437 HmiMovgObj5ColorOfHmiMovgObj 0;
BA_ "GenSigSendType" SG_ 437 HmiMovgObj5DstLatOfMovgObj 0;
BA_ "GenSigStartValue" SG_ 437 HmiMovgObj5DstLatOfMovgObj 250;
BA_ "GenSigSendType" SG_ 437 HmiMovgObj5DstLgtOfMovgObj 0;
BA_ "GenSigStartValue" SG_ 437 HmiMovgObj5DstLgtOfMovgObj 30;
BA_ "GenSigSendType" SG_ 437 HmiMovgObj5HdDirOfMovgObj 0;
BA_ "GenSigSendType" SG_ 437 HmiMovgObj5HmiMovgObjTyp 0;
BA_ "GenSigSendType" SG_ 437 HmiMovgObj6ColorOfHmiMovgObj 0;
BA_ "GenSigSendType" SG_ 437 HmiMovgObj6DstLatOfMovgObj 0;
BA_ "GenSigStartValue" SG_ 437 HmiMovgObj6DstLatOfMovgObj 250;
BA_ "GenSigSendType" SG_ 437 HmiMovgObj6DstLgtOfMovgObj 0;
BA_ "GenSigStartValue" SG_ 437 HmiMovgObj6DstLgtOfMovgObj 30;
BA_ "GenSigSendType" SG_ 437 HmiMovgObj6HdDirOfMovgObj 0;
BA_ "GenSigSendType" SG_ 437 HmiMovgObj6HmiMovgObjTyp 0;
BA_ "GenSigSendType" SG_ 437 HmiMovgObj7ColorOfHmiMovgObj 0;
BA_ "GenSigSendType" SG_ 437 HmiMovgObj7DstLatOfMovgObj 0;
BA_ "GenSigStartValue" SG_ 437 HmiMovgObj7DstLatOfMovgObj 250;
BA_ "GenSigSendType" SG_ 437 HmiMovgObj7DstLgtOfMovgObj 0;
BA_ "GenSigStartValue" SG_ 437 HmiMovgObj7DstLgtOfMovgObj 30;
BA_ "GenSigSendType" SG_ 437 HmiMovgObj7HdDirOfMovgObj 0;
BA_ "GenSigSendType" SG_ 437 HmiMovgObj7HmiMovgObjTyp 0;
BA_ "GenSigSendType" SG_ 437 HmiMovgObj8ColorOfHmiMovgObj 0;
BA_ "GenSigSendType" SG_ 437 HmiMovgObj8DstLatOfMovgObj 0;
BA_ "GenSigStartValue" SG_ 437 HmiMovgObj8DstLatOfMovgObj 250;
BA_ "GenSigSendType" SG_ 437 HmiMovgObj8DstLgtOfMovgObj 0;
BA_ "GenSigStartValue" SG_ 437 HmiMovgObj8DstLgtOfMovgObj 30;
BA_ "GenSigSendType" SG_ 437 HmiMovgObj8HdDirOfMovgObj 0;
BA_ "GenSigSendType" SG_ 437 HmiMovgObj8HmiMovgObjTyp 0;
BA_ "GenSigSendType" SG_ 437 HmiMovgObj9ColorOfHmiMovgObj 0;
BA_ "GenSigSendType" SG_ 437 HmiMovgObj9DstLatOfMovgObj 0;
BA_ "GenSigStartValue" SG_ 437 HmiMovgObj9DstLatOfMovgObj 250;
BA_ "GenSigSendType" SG_ 437 HmiMovgObj9DstLgtOfMovgObj 0;
BA_ "GenSigStartValue" SG_ 437 HmiMovgObj9DstLgtOfMovgObj 30;
BA_ "GenSigSendType" SG_ 437 HmiMovgObj9HdDirOfMovgObj 0;
BA_ "GenSigSendType" SG_ 437 HmiMovgObj9HmiMovgObjTyp 0;
BA_ "GenSigSendType" SG_ 437 HmiNOPCofmOfLanChag 0;
BA_ "GenSigSendType" SG_ 437 HmiReCamSts0 0;
BA_ "GenSigSendType" SG_ 480 HmiRoadArrow1HmiRoadArrowLane 0;
BA_ "GenSigSendType" SG_ 480 HmiRoadArrow1HmiRoadArrowTyp 0;
BA_ "GenSigSendType" SG_ 480 HmiRoadArrow1LatPosition 0;
BA_ "GenSigStartValue" SG_ 480 HmiRoadArrow1LatPosition 250;
BA_ "GenSigSendType" SG_ 480 HmiRoadArrow1LongPosition 0;
BA_ "GenSigSendType" SG_ 480 HmiRoadArrow2HmiRoadArrowLane 0;
BA_ "GenSigSendType" SG_ 480 HmiRoadArrow2HmiRoadArrowTyp 0;
BA_ "GenSigSendType" SG_ 480 HmiRoadArrow2LatPosition 0;
BA_ "GenSigStartValue" SG_ 480 HmiRoadArrow2LatPosition 250;
BA_ "GenSigSendType" SG_ 480 HmiRoadArrow2LongPosition 0;
BA_ "GenSigSendType" SG_ 480 HmiRoadArrow3HmiRoadArrowLane 0;
BA_ "GenSigSendType" SG_ 480 HmiRoadArrow3HmiRoadArrowTyp 0;
BA_ "GenSigSendType" SG_ 480 HmiRoadArrow3LatPosition 0;
BA_ "GenSigStartValue" SG_ 480 HmiRoadArrow3LatPosition 250;
BA_ "GenSigSendType" SG_ 480 HmiRoadArrow3LongPosition 0;
BA_ "GenSigSendType" SG_ 480 HmiRoadArrow4HmiRoadArrowLane 0;
BA_ "GenSigSendType" SG_ 480 HmiRoadArrow4HmiRoadArrowTyp 0;
BA_ "GenSigSendType" SG_ 480 HmiRoadArrow4LatPosition 0;
BA_ "GenSigStartValue" SG_ 480 HmiRoadArrow4LatPosition 250;
BA_ "GenSigSendType" SG_ 480 HmiRoadArrow4LongPosition 0;
BA_ "GenSigSendType" SG_ 480 HmiRoadArrow5HmiRoadArrowLane 0;
BA_ "GenSigSendType" SG_ 480 HmiRoadArrow5HmiRoadArrowTyp 0;
BA_ "GenSigSendType" SG_ 480 HmiRoadArrow5LatPosition 0;
BA_ "GenSigStartValue" SG_ 480 HmiRoadArrow5LatPosition 250;
BA_ "GenSigSendType" SG_ 480 HmiRoadArrow5LongPosition 0;
BA_ "GenSigSendType" SG_ 480 HmiStaticObj1DstLatOfStaticObj 0;
BA_ "GenSigStartValue" SG_ 480 HmiStaticObj1DstLatOfStaticObj 250;
BA_ "GenSigSendType" SG_ 480 HmiStaticObj1DstLgtOfStaticObj 0;
BA_ "GenSigStartValue" SG_ 480 HmiStaticObj1DstLgtOfStaticObj 30;
BA_ "GenSigSendType" SG_ 480 HmiStaticObj1HmiStaticObjTyp 0;
BA_ "GenSigSendType" SG_ 480 HmiStaticObj2DstLatOfStaticObj 0;
BA_ "GenSigStartValue" SG_ 480 HmiStaticObj2DstLatOfStaticObj 250;
BA_ "GenSigSendType" SG_ 480 HmiStaticObj2DstLgtOfStaticObj 0;
BA_ "GenSigStartValue" SG_ 480 HmiStaticObj2DstLgtOfStaticObj 30;
BA_ "GenSigSendType" SG_ 480 HmiStaticObj2HmiStaticObjTyp 0;
BA_ "GenSigSendType" SG_ 480 HmiStaticObj3DstLatOfStaticObj 0;
BA_ "GenSigStartValue" SG_ 480 HmiStaticObj3DstLatOfStaticObj 250;
BA_ "GenSigSendType" SG_ 480 HmiStaticObj3DstLgtOfStaticObj 0;
BA_ "GenSigStartValue" SG_ 480 HmiStaticObj3DstLgtOfStaticObj 30;
BA_ "GenSigSendType" SG_ 480 HmiStaticObj3HmiStaticObjTyp 0;
BA_ "GenSigSendType" SG_ 480 HmiStaticObj4DstLatOfStaticObj 0;
BA_ "GenSigStartValue" SG_ 480 HmiStaticObj4DstLatOfStaticObj 250;
BA_ "GenSigSendType" SG_ 480 HmiStaticObj4DstLgtOfStaticObj 0;
BA_ "GenSigStartValue" SG_ 480 HmiStaticObj4DstLgtOfStaticObj 30;
BA_ "GenSigSendType" SG_ 480 HmiStaticObj4HmiStaticObjTyp 0;
BA_ "GenSigSendType" SG_ 480 HmiStaticObj5DstLatOfStaticObj 0;
BA_ "GenSigStartValue" SG_ 480 HmiStaticObj5DstLatOfStaticObj 250;
BA_ "GenSigSendType" SG_ 480 HmiStaticObj5DstLgtOfStaticObj 0;
BA_ "GenSigStartValue" SG_ 480 HmiStaticObj5DstLgtOfStaticObj 30;
BA_ "GenSigSendType" SG_ 480 HmiStaticObj5HmiStaticObjTyp 0;
BA_ "GenSigSendType" SG_ 480 HmiStaticObj6DstLatOfStaticObj 0;
BA_ "GenSigStartValue" SG_ 480 HmiStaticObj6DstLatOfStaticObj 250;
BA_ "GenSigSendType" SG_ 480 HmiStaticObj6DstLgtOfStaticObj 0;
BA_ "GenSigStartValue" SG_ 480 HmiStaticObj6DstLgtOfStaticObj 30;
BA_ "GenSigSendType" SG_ 480 HmiStaticObj6HmiStaticObjTyp 0;
BA_ "GenSigSendType" SG_ 480 HmiStaticObj7DstLatOfStaticObj 0;
BA_ "GenSigStartValue" SG_ 480 HmiStaticObj7DstLatOfStaticObj 250;
BA_ "GenSigSendType" SG_ 480 HmiStaticObj7DstLgtOfStaticObj 0;
BA_ "GenSigStartValue" SG_ 480 HmiStaticObj7DstLgtOfStaticObj 30;
BA_ "GenSigSendType" SG_ 480 HmiStaticObj7HmiStaticObjTyp 0;
BA_ "GenSigSendType" SG_ 480 HmiStaticObj8DstLatOfStaticObj 0;
BA_ "GenSigStartValue" SG_ 480 HmiStaticObj8DstLatOfStaticObj 250;
BA_ "GenSigSendType" SG_ 480 HmiStaticObj8DstLgtOfStaticObj 0;
BA_ "GenSigStartValue" SG_ 480 HmiStaticObj8DstLgtOfStaticObj 30;
BA_ "GenSigSendType" SG_ 480 HmiStaticObj8HmiStaticObjTyp 0;
BA_ "GenSigSendType" SG_ 480 HmiStopLineConfidence 0;
BA_ "GenSigSendType" SG_ 480 HmiStopLineDistanceToStopLine 0;
BA_ "GenSigStartValue" SG_ 480 HmiStopLineDistanceToStopLine 100;
BA_ "GenSigSendType" SG_ 480 HmiStopLineStopLinePresent 0;
BA_ "GenSigSendType" SG_ 480 HmiStopLineTiStamp 0;
BA_ "GenSigSendType" SG_ 640 IHUSetDispAD 0;
BA_ "GenSigSendType" SG_ 288 IntvAndWarnModInfoSts 0;
BA_ "GenSigStartValue" SG_ 288 IntvAndWarnModInfoSts 1;
BA_ "GenSigSendType" SG_ 752 LaneChgAutActvSts 0;
BA_ "GenSigSendType" SG_ 288 LaneChgAutInfoForAsyHiWay 0;
BA_ "GenSigSendType" SG_ 288 LaneChgAutStsForAsyHiWay 0;
BA_ "GenSigSendType" SG_ 448 LaneChgWarnSts 0;
BA_ "GenSigSendType" SG_ 437 LaneKeepAidInfoSts 0;
BA_ "GenSigSendType" SG_ 752 LcmaAudWarn 0;
BA_ "GenSigSendType" SG_ 288 LcmaIndcnLe 0;
BA_ "GenSigSendType" SG_ 288 LcmaIndcnRi 0;
BA_ "GenSigSendType" SG_ 640 LcmaOn 0;
BA_ "GenSigSendType" SG_ 640 LeTTCLv 0;
BA_ "GenSigSendType" SG_ 416 LimSts 0;
BA_ "GenSigSendType" SG_ 864 LitArea 0;
BA_ "GenSigSendType" SG_ 416 NonTrvrsbleRoadEdgeOnLeft 0;
BA_ "GenSigSendType" SG_ 416 NonTrvrsbleRoadEdgeOnRight 0;
BA_ "GenSigSendType" SG_ 416 ObjFrnt1ColorOfObjFrnt1 0;
BA_ "GenSigSendType" SG_ 416 ObjFrnt1DstLatOfObjFrnt1 0;
BA_ "GenSigStartValue" SG_ 416 ObjFrnt1DstLatOfObjFrnt1 127;
BA_ "GenSigSendType" SG_ 416 ObjFrnt1DstLgtOfObjFrnt1 0;
BA_ "GenSigStartValue" SG_ 416 ObjFrnt1DstLgtOfObjFrnt1 30;
BA_ "GenSigSendType" SG_ 416 ObjFrnt1HdDirOfObjFrnt1 0;
BA_ "GenSigSendType" SG_ 416 ObjFrnt1TypOfObjFrnt1 0;
BA_ "GenSigSendType" SG_ 416 ObjFrnt2ColorOfObjFrnt2 0;
BA_ "GenSigSendType" SG_ 416 ObjFrnt2DstLatOfObjFrnt2 0;
BA_ "GenSigStartValue" SG_ 416 ObjFrnt2DstLatOfObjFrnt2 127;
BA_ "GenSigSendType" SG_ 416 ObjFrnt2DstLgtOfObjFrnt2 0;
BA_ "GenSigStartValue" SG_ 416 ObjFrnt2DstLgtOfObjFrnt2 30;
BA_ "GenSigSendType" SG_ 416 ObjFrnt2HdDirOfObjFrnt2 0;
BA_ "GenSigSendType" SG_ 416 ObjFrnt2TypOfObjFrnt2 0;
BA_ "GenSigSendType" SG_ 416 ObjFrntLeColorOfObjFrntLe 0;
BA_ "GenSigSendType" SG_ 416 ObjFrntLeDstLatOfObjFrntLe 0;
BA_ "GenSigStartValue" SG_ 416 ObjFrntLeDstLatOfObjFrntLe 127;
BA_ "GenSigSendType" SG_ 416 ObjFrntLeDstLgtOfObjFrntLe 0;
BA_ "GenSigStartValue" SG_ 416 ObjFrntLeDstLgtOfObjFrntLe 30;
BA_ "GenSigSendType" SG_ 416 ObjFrntLeHdDirOfObjFrntLe 0;
BA_ "GenSigSendType" SG_ 416 ObjFrntLeTypOfObjFrntLe 0;
BA_ "GenSigSendType" SG_ 416 ObjFrntRiColorOfObjFrntRi 0;
BA_ "GenSigSendType" SG_ 416 ObjFrntRiDstLatOfObjFrntRi 0;
BA_ "GenSigStartValue" SG_ 416 ObjFrntRiDstLatOfObjFrntRi 127;
BA_ "GenSigSendType" SG_ 416 ObjFrntRiDstLgtOfObjFrntRi 0;
BA_ "GenSigStartValue" SG_ 416 ObjFrntRiDstLgtOfObjFrntRi 30;
BA_ "GenSigSendType" SG_ 416 ObjFrntRiHdDirOfObjFrntRi 0;
BA_ "GenSigSendType" SG_ 416 ObjFrntRiTypOfObjFrntRi 0;
BA_ "GenSigSendType" SG_ 640 OffsForSpdWarnSetgSts 0;
BA_ "GenSigStartValue" SG_ 640 OffsForSpdWarnSetgSts 2;
BA_ "GenSigSendType" SG_ 511 OvrdWrnForFstActv 0;
BA_ "GenSigSendType" SG_ 416 PtVehSpdMaxChks 0;
BA_ "GenSigSendType" SG_ 416 PtVehSpdMaxCntr 0;
BA_ "GenSigSendType" SG_ 416 PtVehSpdMaxReq 0;
BA_ "GenSigStartValue" SG_ 416 PtVehSpdMaxReq 250;
BA_ "GenSigDataID" SG_ 288 RctaBrkReqChks "0x0A";
BA_ "GenSigFuncType" SG_ 288 RctaBrkReqChks 15;
BA_ "GenSigSendType" SG_ 288 RctaBrkReqChks 0;
BA_ "GenSigFuncType" SG_ 288 RctaBrkReqCntr 16;
BA_ "GenSigSendType" SG_ 288 RctaBrkReqCntr 0;
BA_ "GenSigSendType" SG_ 1152 RctaBrkReqQM 0;
BA_ "GenSigSendType" SG_ 288 RctaBrkReqRctaBrkReq 0;
BA_ "GenSigStartValue" SG_ 288 RctaBrkReqRctaBrkReq 1;
BA_ "GenSigSendType" SG_ 288 RctaIndcnLe 0;
BA_ "GenSigSendType" SG_ 288 RctaIndcnRi 0;
BA_ "GenSigDataID" SG_ 416 RcwmBrkReqChks "0x06";
BA_ "GenSigFuncType" SG_ 416 RcwmBrkReqChks 15;
BA_ "GenSigSendType" SG_ 416 RcwmBrkReqChks 0;
BA_ "GenSigFuncType" SG_ 416 RcwmBrkReqCntr 16;
BA_ "GenSigSendType" SG_ 416 RcwmBrkReqCntr 0;
BA_ "GenSigSendType" SG_ 416 RcwmBrkReqRcwmBrkReq 0;
BA_ "GenSigSendType" SG_ 864 RcwmLiReq 0;
BA_ "GenSigStartValue" SG_ 864 RcwmLiReq 1;
BA_ "GenSigSendType" SG_ 437 ReLidarSts0 0;
BA_ "GenSigStartValue" SG_ 437 ReLidarSts0 5;
BA_ "GenSigSendType" SG_ 480 ReSideCamLeSts0 0;
BA_ "GenSigStartValue" SG_ 480 ReSideCamLeSts0 5;
BA_ "GenSigSendType" SG_ 480 ReSideCamRiSts0 0;
BA_ "GenSigStartValue" SG_ 480 ReSideCamRiSts0 5;
BA_ "GenSigSendType" SG_ 437 ReSideLidarLeSts0 0;
BA_ "GenSigStartValue" SG_ 437 ReSideLidarLeSts0 5;
BA_ "GenSigSendType" SG_ 437 ReSideLidarRiSts0 0;
BA_ "GenSigStartValue" SG_ 437 ReSideLidarRiSts0 5;
BA_ "GenSigSendType" SG_ 640 ReSideRdrLeSts0 0;
BA_ "GenSigStartValue" SG_ 640 ReSideRdrLeSts0 5;
BA_ "GenSigSendType" SG_ 640 ReSideRdrRiSts0 0;
BA_ "GenSigStartValue" SG_ 640 ReSideRdrRiSts0 5;
BA_ "GenSigSendType" SG_ 640 RiTTCLv 0;
BA_ "GenSigSendType" SG_ 752 RoadMiscSgnInfoSts 0;
BA_ "GenSigSendType" SG_ 416 RoadSgnInfoSts 0;
BA_ "GenSigSendType" SG_ 752 RsdsSysSts 0;
BA_ "GenSigStartValue" SG_ 752 RsdsSysSts 5;
BA_ "GenSigSendType" SG_ 480 SelfLaneColor 0;
BA_ "GenSigSendType" SG_ 416 SftyDecelGroupSafeAsySftyDecelReq 0;
BA_ "GenSigSendType" SG_ 416 SftyDecelGroupSafeAsySftyEnaDecel 0;
BA_ "GenSigDataID" SG_ 416 SftyDecelGroupSafeChks "0x4C";
BA_ "GenSigFuncType" SG_ 416 SftyDecelGroupSafeChks 15;
BA_ "GenSigSendType" SG_ 416 SftyDecelGroupSafeChks 0;
BA_ "GenSigFuncType" SG_ 416 SftyDecelGroupSafeCntr 16;
BA_ "GenSigSendType" SG_ 416 SftyDecelGroupSafeCntr 0;
BA_ "GenSigSendType" SG_ 752 SpdAlrmActvSts 0;
BA_ "GenSigStartValue" SG_ 752 SpdAlrmActvSts 2;
BA_ "GenSigSendType" SG_ 752 SpdLimCamFirst 0;
BA_ "GenSigSendType" SG_ 640 SpdLimCoupldFirst 0;
BA_ "GenSigSendType" SG_ 416 SpdLimFirst 0;
BA_ "GenSigSendType" SG_ 640 SpdLimSec 0;
BA_ "GenSigSendType" SG_ 640 SpdLimSpplFirst 0;
BA_ "GenSigSendType" SG_ 752 SpdLimUnit 0;
BA_ "GenSigSendType" SG_ 640 SpdLimWarnReq 0;
BA_ "GenSigSendType" SG_ 640 SpdLimWarnReqAud 0;
BA_ "GenSigDataID" SG_ 400 SteerTqAddlForEmaChks "0xC26";
BA_ "GenSigFuncType" SG_ 400 SteerTqAddlForEmaChks 15;
BA_ "GenSigSendType" SG_ 400 SteerTqAddlForEmaChks 0;
BA_ "GenSigFuncType" SG_ 400 SteerTqAddlForEmaCntr 16;
BA_ "GenSigSendType" SG_ 400 SteerTqAddlForEmaCntr 0;
BA_ "GenSigSendType" SG_ 400 SteerTqAddlForEmaSteerTqAddlForEma 0;
BA_ "GenSigSendType" SG_ 400 StopReqOfLgtCtrlForPrpsn 0;
BA_ "GenSigSendType" SG_ 400 StrtReqOfLgtCtrlForPrpsn 0;
BA_ "GenSigSendType" SG_ 288 TiGapSetForLgtCtrl 0;
BA_ "GenSigSendType" SG_ 640 TooManyCars 0;
BA_ "GenSigSendType" SG_ 400 TrafficSignForADB1AdbAbsDist 0;
BA_ "GenSigSendType" SG_ 400 TrafficSignForADB1AdbDetdQly 0;
BA_ "GenSigSendType" SG_ 400 TrafficSignForADB1AdbHozlAgLe 0;
BA_ "GenSigStartValue" SG_ 400 TrafficSignForADB1AdbHozlAgLe 800;
BA_ "GenSigSendType" SG_ 400 TrafficSignForADB1AdbHozlAgRi 0;
BA_ "GenSigStartValue" SG_ 400 TrafficSignForADB1AdbHozlAgRi 800;
BA_ "GenSigSendType" SG_ 400 TrafficSignForADB1AdbTrkInfo 0;
BA_ "GenSigSendType" SG_ 400 TrafficSignForADB1AdbVertAgBot 0;
BA_ "GenSigStartValue" SG_ 400 TrafficSignForADB1AdbVertAgBot 60;
BA_ "GenSigSendType" SG_ 400 TrafficSignForADB1AdbVertAgTop 0;
BA_ "GenSigStartValue" SG_ 400 TrafficSignForADB1AdbVertAgTop 60;
BA_ "GenSigSendType" SG_ 400 TrafficSignForADB2AdbAbsDist 0;
BA_ "GenSigSendType" SG_ 400 TrafficSignForADB2AdbDetdQly 0;
BA_ "GenSigSendType" SG_ 400 TrafficSignForADB2AdbHozlAgLe 0;
BA_ "GenSigStartValue" SG_ 400 TrafficSignForADB2AdbHozlAgLe 800;
BA_ "GenSigSendType" SG_ 400 TrafficSignForADB2AdbHozlAgRi 0;
BA_ "GenSigStartValue" SG_ 400 TrafficSignForADB2AdbHozlAgRi 800;
BA_ "GenSigSendType" SG_ 400 TrafficSignForADB2AdbTrkInfo 0;
BA_ "GenSigSendType" SG_ 400 TrafficSignForADB2AdbVertAgBot 0;
BA_ "GenSigStartValue" SG_ 400 TrafficSignForADB2AdbVertAgBot 60;
BA_ "GenSigSendType" SG_ 400 TrafficSignForADB2AdbVertAgTop 0;
BA_ "GenSigStartValue" SG_ 400 TrafficSignForADB2AdbVertAgTop 60;
BA_ "GenSigSendType" SG_ 752 TrfcInfoMiscFirst 0;
BA_ "GenSigSendType" SG_ 864 TurnIndicReqByALCA 0;
BA_ "GenSigSendType" SG_ 400 VehObjforAHBAdbAbsDist 0;
BA_ "GenSigSendType" SG_ 400 VehObjforAHBAdbClassn 0;
BA_ "GenSigSendType" SG_ 400 VehObjforAHBAdbClassnQly 0;
BA_ "GenSigSendType" SG_ 400 VehObjforAHBAdbDetdQly 0;
BA_ "GenSigSendType" SG_ 400 VehObjforAHBAdbHozlAg 0;
BA_ "GenSigStartValue" SG_ 400 VehObjforAHBAdbHozlAg 800;
BA_ "GenSigSendType" SG_ 400 VehObjforAHBAdbObjDir 0;
BA_ "GenSigSendType" SG_ 400 VehObjforAHBAdbObjHozlAgSpd 0;
BA_ "GenSigStartValue" SG_ 400 VehObjforAHBAdbObjHozlAgSpd 2880;
BA_ "GenSigSendType" SG_ 400 VehObjforAHBAdbObjVertAgSpd 0;
BA_ "GenSigStartValue" SG_ 400 VehObjforAHBAdbObjVertAgSpd 720;
BA_ "GenSigSendType" SG_ 400 VehObjforAHBAdbTrkInfo 0;
BA_ "GenSigSendType" SG_ 400 VehObjforAHBAdbVertAg 0;
BA_ "GenSigStartValue" SG_ 400 VehObjforAHBAdbVertAg 75;
BA_ "GenSigSendType" SG_ 400 WarnForAsyEmgyLaneKeepAid 0;

VAL_ 306 AsyLgtCtrlTakeOverReq 0 "NoYes1_No" 1 "NoYes1_Yes";
VAL_ 448 AsySteerWhlHptcWarnReq 0 "OnOff1_Off" 1 "OnOff1_On";
VAL_ 448 CllsnFwdWarn 0 "CllsnFwdWarnReq_NoWarning" 1 "CllsnFwdWarnReq_WarningActive" 2 "CllsnFwdWarnReq_LatentWarning";
VAL_ 448 LaneChgWarnSts 0 "OnOff1_Off" 1 "OnOff1_On";
VAL_ 496 ADDimLight 0 "ADDimLight_NoRequest" 1 "ADDimLight_Level2" 2 "ADDimLight_Level2plus" 3 "ADDimLight_Level3" 4 "ADDimLight_MildAlert" 5 "ADDimLight_SeriousAlert" 6 "ADDimLight_SafetyStop";
VAL_ 496 AsyAutDrvCtrlTyp 0 "AsyAutDrvCtrlTyp_Inactive" 1 "AsyAutDrvCtrlTyp_ACC" 2 "AsyAutDrvCtrlTyp_GPilot";
VAL_ 496 AsyAutDrvgAvlSound 0 "AsyAutDrvgAvl_NoMsg" 1 "AsyAutDrvgAvl_LatCtrlNotAvl" 2 "AsyAutDrvgAvl_HiSpd" 3 "AsyAutDrvgAvl_VehToFolwMiss" 4 "AsyAutDrvgAvl_OvrdTiMaxExcdd" 5 "AsyAutDrvgAvl_DrvrNotInLoopDetd" 6 "AsyAutDrvgAvl_DrvrBucdRqrd" 7 "AsyAutDrvgAvl_DrvrDoorNotClsd" 8 "AsyAutDrvgAvl_GearNotInDrv" 9 "AsyAutDrvgAvl_SnsrBlkd" 10 "AsyAutDrvgAvl_HldTiMaxExcdd" 11 "AsyAutDrvgAvl_DrvModSeldNotOk" 12 "AsyAutDrvgAvl_EpbAppld" 13 "AsyAutDrvgAvl_SpdLowLimExcdd" 14 "AsyAutDrvgAvl_TrlrPrsnt" 15 "AsyAutDrvgAvl_MltpleMonRoadReq" 16 "AsyAutDrvgAvl_EndOfHndsOffAllwdArea" 17 "AsyAutDrvgAvl_RoadMonWm" 18 "AsyAutDrvgAvl_CannotReactivate" 19 "AsyAutDrvgAvl_NotInUse1" 20 "AsyAutDrvgAvl_ESC_OF" 21 "AsyAutDrvgAvl_HDC_ON" 22 "AsyAutDrvgAvl_Reserved3" 23 "AsyAutDrvgAvl_Reserved4" 24 "AsyAutDrvgAvl_Reserved5" 25 "AsyAutDrvgAvl_Reserved6" 26 "AsyAutDrvgAvl_Reserved7" 27 "AsyAutDrvgAvl_Reserved8" 28 "AsyAutDrvgAvl_Reserved9" 29 "AsyAutDrvgAvl_Reserved10" 30 "AsyAutDrvgAvl_Reserved11" 31 "AsyAutDrvgAvl_Reserved12";
VAL_ 496 AsyEmgyLaneKeepAidSts 0 "AsyALatSts_Off" 1 "AsyALatSts_Standby" 2 "AsyALatSts_Active" 3 "AsyALatSts_Override" 4 "AsyALatSts_TemporaryError" 5 "AsyALatSts_PermanentError" 6 "AsyALatSts_NotEnableButNotError";
VAL_ 496 AsyLaneKeepAidSts 0 "AsyALatSts_Off" 1 "AsyALatSts_Standby" 2 "AsyALatSts_Active" 3 "AsyALatSts_Override" 4 "AsyALatSts_TemporaryError" 5 "AsyALatSts_PermanentError" 6 "AsyALatSts_NotEnableButNotError";
VAL_ 496 AsyLatDegSts 0 "NoYes1_No" 1 "NoYes1_Yes";
VAL_ 496 AsyLineLe2Color 0 "AsyLineLeColor_Grey" 1 "AsyLineLeColor_White" 2 "AsyLineLeColor_Blue" 3 "AsyLineLeColor_Red" 4 "AsyLineLeColor_Yellow";
VAL_ 496 AsyLineLe2RampTyp 0 "NoRamp" 1 "LeftEnter" 2 "LeftExit" 3 "RightEnter" 4 "RightExit";
VAL_ 496 AsyLineLe2Typ 0 "AsyLineLeTyp_NoDisplay" 1 "AsyLineLeTyp_SolidLine" 2 "AsyLineLeTyp_DashLine";
VAL_ 496 AsyLineLeColor 0 "AsyLineLeColor_Grey" 1 "AsyLineLeColor_White" 2 "AsyLineLeColor_Blue" 3 "AsyLineLeColor_Red" 4 "AsyLineLeColor_Yellow";
VAL_ 496 AsyLineLeRampTyp 0 "NoRamp" 1 "LeftEnter" 2 "LeftExit" 3 "RightEnter" 4 "RightExit";
VAL_ 496 AsyLineLeTyp 0 "AsyLineLeTyp_NoDisplay" 1 "AsyLineLeTyp_SolidLine" 2 "AsyLineLeTyp_DashLine";
VAL_ 496 AsyLineRi2Color 0 "AsyLineLeColor_Grey" 1 "AsyLineLeColor_White" 2 "AsyLineLeColor_Blue" 3 "AsyLineLeColor_Red" 4 "AsyLineLeColor_Yellow";
VAL_ 496 AsyLineRi2RampTyp 0 "NoRamp" 1 "LeftEnter" 2 "LeftExit" 3 "RightEnter" 4 "RightExit";
VAL_ 496 AsyLineRi2Typ 0 "AsyLineLeTyp_NoDisplay" 1 "AsyLineLeTyp_SolidLine" 2 "AsyLineLeTyp_DashLine";
VAL_ 496 AsyLineRiColor 0 "AsyLineLeColor_Grey" 1 "AsyLineLeColor_White" 2 "AsyLineLeColor_Blue" 3 "AsyLineLeColor_Red" 4 "AsyLineLeColor_Yellow";
VAL_ 496 AsyLineRiRampTyp 0 "NoRamp" 1 "LeftEnter" 2 "LeftExit" 3 "RightEnter" 4 "RightExit";
VAL_ 496 AsyNoaActvSuggest 0 "OnOff1_Off" 1 "OnOff1_On";
VAL_ 752 AccFusnTrfcSgn 0 "OnOff2_On" 1 "OnOff2_Off";
VAL_ 752 ActvSafeCtrlrSts 0 "SnsrSysStsLeFrnt_Off" 1 "SnsrSysStsLeFrnt_On" 2 "SnsrSysStsLeFrnt_Calibration" 3 "SnsrSysStsLeFrnt_BlockOrHot" 4 "SnsrSysStsLeFrnt_Faulty" 5 "SnsrSysStsLeFrnt_Resd1" 6 "SnsrSysStsLeFrnt_Resd2" 7 "SnsrSysStsLeFrnt_Resd3";
VAL_ 752 AsyEmgyLaneKeepAid 0 "OnOff1_Off" 1 "OnOff1_On";
VAL_ 752 AsyEmgyManoeuvreAidSts 0 "FctaOn1_StrtUpOn" 1 "FctaOn1_On" 2 "FctaOn1_Off" 3 "FctaOn1_TrlrOff" 4 "FctaOn1_TempError" 5 "FctaOn1_PermError";
VAL_ 752 AsyFctnIhbtByTrlr 0 "NoYes1_No" 1 "NoYes1_Yes";
VAL_ 752 AsyLaneChgWarnMod 0 "ChgWarnMod_No" 1 "ChgWarnMod_Sound" 2 "ChgWarnMod_Haptic";
VAL_ 752 AsySftyFctStsToEDRACCFctSTs 0 "FctSTs_Default" 1 "FctSTs_Faulted" 2 "FctSTs_Off" 3 "FctSTs_StandBy" 4 "FctSTs_Active";
VAL_ 752 AsySftyFctStsToEDRACSFB1FctSts 0 "FctSTs_Default" 1 "FctSTs_Faulted" 2 "FctSTs_Off" 3 "FctSTs_StandBy" 4 "FctSTs_Active";
VAL_ 752 AsySftyFctStsToEDRACSFB2FctSts 0 "FctSTs_Default" 1 "FctSTs_Faulted" 2 "FctSTs_Off" 3 "FctSTs_StandBy" 4 "FctSTs_Active";
VAL_ 752 AsySftyFctStsToEDRACSFCFctSts 0 "FctSTs_Default" 1 "FctSTs_Faulted" 2 "FctSTs_Off" 3 "FctSTs_StandBy" 4 "FctSTs_Active";
VAL_ 752 AsySftyFctStsToEDRACSFDFctSts 0 "FctSTs_Default" 1 "FctSTs_Faulted" 2 "FctSTs_Off" 3 "FctSTs_StandBy" 4 "FctSTs_Active";
VAL_ 752 AsySftyFctStsToEDRACSFEFctSts 0 "FctSTs_Default" 1 "FctSTs_Faulted" 2 "FctSTs_Off" 3 "FctSTs_StandBy" 4 "FctSTs_Active";
VAL_ 752 AsySftyFctStsToEDRAEBSFctSts 0 "AEBSFctSts_Default" 1 "AEBSFctSts_Faulted" 2 "AEBSFctSts_Off" 3 "AEBSFctSts_OnButNotEngaged" 4 "AEBSFctSts_WarningButNotEngaged" 5 "AEBSFctSts_Engaged";
VAL_ 752 AsySftyFctStsToEDRCSFFctSts 0 "FctSTs_Default" 1 "FctSTs_Faulted" 2 "FctSTs_Off" 3 "FctSTs_StandBy" 4 "FctSTs_Active";
VAL_ 752 AsySftyFctStsToEDRESFFctSts 0 "FctSTs_Default" 1 "FctSTs_Faulted" 2 "FctSTs_Off" 3 "FctSTs_StandBy" 4 "FctSTs_Active";
VAL_ 752 AsySftyFctStsToEDRLDWSFctSts 0 "LDWSFctSts_Default" 1 "LDWSFctSts_Faulted" 2 "LDWSFctSts_Off" 3 "LDWSFctSts_OnButNotEngaged" 4 "LDWSFctSts_WarningLeft" 5 "LDWSFctSts_WarningRight";
VAL_ 752 AsySftyHWLReq 0 "AsySftyHWLReq_NoRequest" 1 "AsySftyHWLReq_TurnOn" 2 "AsySftyHWLReq_TurnOff" 3 "AsySftyHWLReq_Reserved";
VAL_ 752 CllsnAidPostEMA 0 "NoYes1_No" 1 "NoYes1_Yes";
VAL_ 752 CllsnMtgtnFctSts 0 "CllsnMtgtnFctSts_Reserved1" 1 "CllsnMtgtnFctSts_OFF" 2 "CllsnMtgtnFctSts_ON" 3 "CllsnMtgtnFctSts_TemporaryError" 4 "CllsnMtgtnFctSts_PermenentError" 5 "CllsnMtgtnFctSts_AEB_PEDNotAvalid" 6 "CllsnMtgtnFctSts_Reserved2" 7 "CllsnMtgtnFctSts_Reserved3";
VAL_ 752 CllsnMtgtnWarnSts 0 "CllsnMtgtnWarnSts_Reserved1" 1 "CllsnMtgtnWarnSts_OFF" 2 "CllsnMtgtnWarnSts_LowSensitive" 3 "CllsnMtgtnWarnSts_MediumSensitive" 4 "CllsnMtgtnWarnSts_HighSensitive" 5 "CllsnMtgtnWarnSts_Reserved2" 6 "CllsnMtgtnWarnSts_Reserved3" 7 "CllsnMtgtnWarnSts_Reserved4";
VAL_ 752 CllsnWarnReOn1 0 "LcmaCtraOn_Off" 1 "LcmaCtraOn_Passive" 2 "LcmaCtraOn_Active" 3 "LcmaCtraOn_TrlrOff";
VAL_ 752 CpmOn1 0 "OnOff1_Off" 1 "OnOff1_On";
VAL_ 752 CtraOn1 0 "LcmaCtraOn_Off" 1 "LcmaCtraOn_Passive" 2 "LcmaCtraOn_Active" 3 "LcmaCtraOn_TrlrOff";
VAL_ 752 DoorOpenwarnOn1 0 "LcmaCtraOn_Off" 1 "LcmaCtraOn_Passive" 2 "LcmaCtraOn_Active" 3 "LcmaCtraOn_TrlrOff";
VAL_ 752 LaneChgAutActvSts 0 "OnOff1_Off" 1 "OnOff1_On";
VAL_ 752 LcmaAudWarn 0 "OnOff1_Off" 1 "OnOff1_On";
VAL_ 752 RoadMiscSgnInfoSts 0 "OnOff1_Off" 1 "OnOff1_On";
VAL_ 752 RsdsSysSts 0 "RsdsMstSt_Cfg" 1 "RsdsMstSt_StrtUp" 2 "RsdsMstSt_Runng" 3 "RsdsMstSt_Blkd" 4 "RsdsMstSt_Faulty" 5 "RsdsMstSt_Shutdown" 6 "RsdsMstSt_Hot" 7 "RsdsMstSt_Cal";
VAL_ 752 SpdAlrmActvSts 0 "DY1_NoRequest" 1 "DY1_NoWarning" 2 "DY1_Flashing" 3 "DY1_FlashingAndAudio";
VAL_ 752 SpdLimCamFirst 0 "OnOff1_Off" 1 "OnOff1_On";
VAL_ 752 SpdLimUnit 0 "SpdUnit1_KiloMtrPerHr" 1 "SpdUnit1_MilePerHr";
VAL_ 752 TrfcInfoMiscFirst 0 "TrfcInfoMiscFirst_Off" 1 "TrfcInfoMiscFirst_NoEntrance" 2 "TrfcInfoMiscFirst_VehiclePassingNotAllowed" 3 "TrfcInfoMiscFirst_EndOfVehiclePassingNotAllowed" 4 "TrfcInfoMiscFirst_Stop" 5 "TrfcInfoMiscFirst_SpeedLimitControl" 6 "TrfcInfoMiscFirst_USNightSpeedLimit" 7 "TrfcInfoMiscFirst_Schoolandchildrenwarning" 8 "TrfcInfoMiscFirst_Roadwork" 9 "TrfcInfoMiscFirst_leftcurve" 10 "TrfcInfoMiscFirst_rightcurve" 11 "TrfcInfoMiscFirst_seriescurves" 12 "TrfcInfoMiscFirst_Reserved";
VAL_ 416 AdjSpdLimnActvnOk 0 "OnOff1_Off" 1 "OnOff1_On";
VAL_ 416 AdjSpdLimnMsg 0 "AdjSpdLimnMsg1_NoMsg0" 1 "AdjSpdLimnMsg1_AdjSpdLimnCncl" 2 "AdjSpdLimnMsg1_AdjSpdLimnInhb" 3 "AdjSpdLimnMsg1_AVSLDegradated";
VAL_ 416 AdjSpdLimnStbOk 0 "OnOff1_Off" 1 "OnOff1_On";
VAL_ 416 AdjSpdLimnSts 1 "AdjSpdLimnSts2_Off" 2 "AdjSpdLimnSts2_Stb" 3 "AdjSpdLimnSts2_Actv" 4 "AdjSpdLimnSts2_Ovrd";
VAL_ 416 ADThemeDisp 0 "ThemeDisp_NoRequest" 1 "ThemeDisp_GP_ADAS" 2 "ThemeDisp_GP_AD";
VAL_ 416 AsyALgtCtrlMod1 0 "AsyALgtCtrlMod_NoReq" 10 "AsyALgtCtrlMod_PEB" 11 "AsyALgtCtrlMod_APA" 12 "AsyALgtCtrlMod_RPA" 13 "AsyALgtCtrlMod_HPA";
VAL_ 416 AsyALgtStsAsyALgtSts 0 "AsyALgtSts_Reserved1" 1 "AsyALgtSts_AccSts1_StandBy" 2 "AsyALgtSts_AccSts1_Active" 3 "AsyALgtSts_Reserved2" 4 "AsyALgtSts_AccSts1_Override" 5 "AsyALgtSts_AccSts1_StandActive" 6 "AsyALgtSts_AccSts1_StandWait" 7 "AsyALgtSts_AccSts1_TemporaryFailure" 8 "AsyALgtSts_AccSts1_PermanentFailure" 9 "AsyALgtSts_Reserved3";
VAL_ 416 AsyLatCtrlModReqGroupAsyLatCtrlModReq 0 "AsyLatCtrlModReq_NoReq" 1 "AsyLatCtrlModReq_HighWayAssist" 2 "AsyLatCtrlModReq_EmgyLaneKeepAidForObjRe" 3 "AsyLatCtrlModReq_EmgyLaneKeepAidForStat" 4 "AsyLatCtrlModReq_SftyLaneKeepAid" 5 "AsyLatCtrlModReq_SteerAssc" 6 "AsyLatCtrlModReq_Reserved1" 7 "AsyLatCtrlModReq_Reserved2" 8 "AsyLatCtrlModReq_Reserved3" 9 "AsyLatCtrlModReq_EmgyManvAssi" 10 "AsyLatCtrlModReq_Reserved4" 11 "AsyLatCtrlModReq_Reserved5" 12 "AsyLatCtrlModReq_SHWA" 13 "AsyLatCtrlModReq_APA" 14 "AsyLatCtrlModReq_RPA" 15 "AsyLatCtrlModReq_HPA";
VAL_ 416 AsySftyEnaDecelByDBSAsySftyEnaDecelByDBS 0 "OnOff1_Off" 1 "OnOff1_On";
VAL_ 416 AsyStandStillReqForCmft 0 "VehStopReq1_NoReqOnVehStop" 1 "VehStopReq1_ReqOnVehStopSoftToStandStill";
VAL_ 416 BrkHptcWarnReqForAutDrvBrkHptcWarnReqForAutDrv 0 "CllsnThreat1_Ukwn" 1 "CllsnThreat1_ThreatLo" 2 "CllsnThreat1_ThreatMed" 3 "CllsnThreat1_ThreatHi";
VAL_ 416 CllsnThreat 0 "CllsnThreat1_Ukwn" 1 "CllsnThreat1_ThreatLo" 2 "CllsnThreat1_ThreatMed" 3 "CllsnThreat1_ThreatHi";
VAL_ 416 CnclWarnForAutDrv 0 "LvlWarn2_NoWarn" 1 "LvlWarn2_Lvl1" 2 "LvlWarn2_Lvl2" 3 "LvlWarn2_Lvl3";
VAL_ 416 DispTSIInfoForLgtCtrl 0 "DispTSRInfoForLgtCtrl_NoDisplay" 1 "DispTSRInfoForLgtCtrl_Yes" 2 "DispTSRInfoForLgtCtrl_No";
VAL_ 416 DrvOffReqForLgtCtrl 0 "NoYes1_No" 1 "NoYes1_Yes";
VAL_ 416 FctaIndcnLe 0 "LcmaIndcn_NoLcmaWarn" 1 "LcmaIndcn_LcmaWarnLvl1" 2 "LcmaIndcn_NotUsed" 3 "LcmaIndcn_LcmaWarnLvl2";
VAL_ 416 FctaIndcnRi 0 "LcmaIndcn_NoLcmaWarn" 1 "LcmaIndcn_LcmaWarnLvl1" 2 "LcmaIndcn_NotUsed" 3 "LcmaIndcn_LcmaWarnLvl2";
VAL_ 416 LimSts 0 "LimSts_Unknown" 1 "LimSts_ManuallySet" 2 "LimSts_AutomaticallySet" 3 "LimSts_Reserved";
VAL_ 416 NonTrvrsbleRoadEdgeOnLeft 0 "NoYes1_No" 1 "NoYes1_Yes";
VAL_ 416 NonTrvrsbleRoadEdgeOnRight 0 "NoYes1_No" 1 "NoYes1_Yes";
VAL_ 416 ObjFrnt1ColorOfObjFrnt1 0 "AsyLineLeColor_Grey" 1 "AsyLineLeColor_White" 2 "AsyLineLeColor_Blue" 3 "AsyLineLeColor_Red" 4 "AsyLineLeColor_Yellow";
VAL_ 416 ObjFrnt1HdDirOfObjFrnt1 0 "Straight" 1 "Left_lean" 2 "Right_lean";
VAL_ 416 ObjFrnt1TypOfObjFrnt1 0 "TypOfObjFrnt1_NoDisplay" 1 "TypOfObjFrnt1_Car" 2 "TypOfObjFrnt1_Pedestrian" 3 "TypOfObjFrnt1_Bikecycle" 4 "TypOfObjFrnt1_Animal" 5 "TypOfObjFrnt1_Motocycle" 6 "TypOfObjFrnt1_Bus" 7 "TypOfObjFrnt1_Truck";
VAL_ 416 ObjFrnt2ColorOfObjFrnt2 0 "AsyLineLeColor_Grey" 1 "AsyLineLeColor_White" 2 "AsyLineLeColor_Blue" 3 "AsyLineLeColor_Red" 4 "AsyLineLeColor_Yellow";
VAL_ 416 ObjFrnt2HdDirOfObjFrnt2 0 "Straight" 1 "Left_lean" 2 "Right_lean";
VAL_ 416 ObjFrnt2TypOfObjFrnt2 0 "TypOfObjFrnt1_NoDisplay" 1 "TypOfObjFrnt1_Car" 2 "TypOfObjFrnt1_Pedestrian" 3 "TypOfObjFrnt1_Bikecycle" 4 "TypOfObjFrnt1_Animal" 5 "TypOfObjFrnt1_Motocycle" 6 "TypOfObjFrnt1_Bus" 7 "TypOfObjFrnt1_Truck";
VAL_ 416 ObjFrntLeColorOfObjFrntLe 0 "AsyLineLeColor_Grey" 1 "AsyLineLeColor_White" 2 "AsyLineLeColor_Blue" 3 "AsyLineLeColor_Red" 4 "AsyLineLeColor_Yellow";
VAL_ 416 ObjFrntLeHdDirOfObjFrntLe 0 "Straight" 1 "Left_lean" 2 "Right_lean";
VAL_ 416 ObjFrntLeTypOfObjFrntLe 0 "TypOfObjFrnt1_NoDisplay" 1 "TypOfObjFrnt1_Car" 2 "TypOfObjFrnt1_Pedestrian" 3 "TypOfObjFrnt1_Bikecycle" 4 "TypOfObjFrnt1_Animal" 5 "TypOfObjFrnt1_Motocycle" 6 "TypOfObjFrnt1_Bus" 7 "TypOfObjFrnt1_Truck";
VAL_ 416 ObjFrntRiColorOfObjFrntRi 0 "AsyLineLeColor_Grey" 1 "AsyLineLeColor_White" 2 "AsyLineLeColor_Blue" 3 "AsyLineLeColor_Red" 4 "AsyLineLeColor_Yellow";
VAL_ 416 ObjFrntRiHdDirOfObjFrntRi 0 "Straight" 1 "Left_lean" 2 "Right_lean";
VAL_ 416 ObjFrntRiTypOfObjFrntRi 0 "TypOfObjFrnt1_NoDisplay" 1 "TypOfObjFrnt1_Car" 2 "TypOfObjFrnt1_Pedestrian" 3 "TypOfObjFrnt1_Bikecycle" 4 "TypOfObjFrnt1_Animal" 5 "TypOfObjFrnt1_Motocycle" 6 "TypOfObjFrnt1_Bus" 7 "TypOfObjFrnt1_Truck";
VAL_ 416 RcwmBrkReqRcwmBrkReq 0 "OnOff1_Off" 1 "OnOff1_On";
VAL_ 416 RoadSgnInfoSts 0 "TrfcSgnInfoSts_TSIUnknown" 1 "TrfcSgnInfoSts_TSIOff" 2 "TrfcSgnInfoSts_TSIOn_fusion" 3 "TrfcSgnInfoSts_TSIOn_visiononlymode" 4 "TrfcSgnInfoSts_TSIOn_navigationonlymode" 5 "TrfcSgnInfoSts_TSIUnavailable" 6 "TrfcSgnInfoSts_TSIServicerequired" 7 "TrfcSgnInfoSts_Reserved";
VAL_ 416 SftyDecelGroupSafeAsySftyEnaDecel 0 "OnOff1_Off" 1 "OnOff1_On";
VAL_ 1152 AsyObjForBigData1SnsrSrcOfAbsLatSpd 0 "SnsrSrc1_Ukwn" 1 "SnsrSrc1_Radar" 2 "SnsrSrc1_Cam" 3 "SnsrSrc1_Fusn";
VAL_ 1152 AsyObjForBigData1SnsrSrcOfAbsLgtSpd 0 "SnsrSrc1_Ukwn" 1 "SnsrSrc1_Radar" 2 "SnsrSrc1_Cam" 3 "SnsrSrc1_Fusn";
VAL_ 1152 AsyObjForBigData1Type 0 "AsyObjType_Car" 1 "AsyObjType_Pedestrian" 2 "AsyObjType_Cyclist" 3 "AsyObjType_Motorbike" 4 "AsyObjType_Bus" 5 "AsyObjType_Truck" 6 "AsyObjType_Tree" 7 "AsyObjType_Wall" 8 "AsyObjType_Animal" 9 "AsyObjType_Unknown";
VAL_ 1152 AsyObjForBigData2SnsrSrcOfAbsLatSpd 0 "SnsrSrc1_Ukwn" 1 "SnsrSrc1_Radar" 2 "SnsrSrc1_Cam" 3 "SnsrSrc1_Fusn";
VAL_ 1152 AsyObjForBigData2SnsrSrcOfAbsLgtSpd 0 "SnsrSrc1_Ukwn" 1 "SnsrSrc1_Radar" 2 "SnsrSrc1_Cam" 3 "SnsrSrc1_Fusn";
VAL_ 1152 AsyObjForBigData2Type 0 "AsyObjType_Car" 1 "AsyObjType_Pedestrian" 2 "AsyObjType_Cyclist" 3 "AsyObjType_Motorbike" 4 "AsyObjType_Bus" 5 "AsyObjType_Truck" 6 "AsyObjType_Tree" 7 "AsyObjType_Wall" 8 "AsyObjType_Animal" 9 "AsyObjType_Unknown";
VAL_ 1152 ExtLiDataDayNight 0 "DayNight_Unkwn" 1 "DayNight_Day" 2 "DayNight_TwliTwilight" 3 "DayNight_Night";
VAL_ 1152 ExtLiDataHiWay 0 "NoYes1_No" 1 "NoYes1_Yes";
VAL_ 1152 ExtLiDataInCity 0 "NoYes1_No" 1 "NoYes1_Yes";
VAL_ 1152 ExtLiDataInTunnel 0 "NoYes1_No" 1 "NoYes1_Yes";
VAL_ 1152 ExtLiDataTrfcSide 0 "TrfcSide_Unkwn" 1 "TrfcSide_Le" 2 "TrfcSide_Ri" 3 "TrfcSide_NotUsed";
VAL_ 1152 RctaBrkReqQM 0 "OnOff1_Off" 1 "OnOff1_On";
VAL_ 511 AsyLineRiTyp 0 "AsyLineLeTyp_NoDisplay" 1 "AsyLineLeTyp_SolidLine" 2 "AsyLineLeTyp_DashLine";
VAL_ 511 AsySafeStopSts 0 "Inact_Inactive" 1 "Inact_Active";
VAL_ 511 AsySodPilotCfirm 0 "ActvnAvl2_NoCmd" 1 "ActvnAvl2_Actvn" 2 "ActvnAvl2_Deactvn";
VAL_ 511 AvlStsForLongAutDrvSound 0 "AvlStsForLongAutDrv4_NoMsg" 1 "AvlStsForLongAutDrv4_LgtCtrlNotAvl" 2 "AvlStsForLongAutDrv4_AccCncl" 3 "AvlStsForLongAutDrv4_NoVehAhd" 4 "AvlStsForLongAutDrv4_DrvrBucdRqrd" 5 "AvlStsForLongAutDrv4_DrvrDoorNotClsd" 6 "AvlStsForLongAutDrv4_GearNotInDrv" 7 "AvlStsForLongAutDrv4_GearNeut" 8 "AvlStsForLongAutDrv4_SnsrBlkd" 9 "AvlStsForLongAutDrv4_HldTiMaxExcdd" 10 "AvlStsForLongAutDrv4_OvrdTiMaxExcdd" 11 "AvlStsForLongAutDrv4_SpdLowLimExcdd" 12 "AvlStsForLongAutDrv4_DrvModSeldNotOk" 13 "AvlStsForLongAutDrv4_EpbAppld" 14 "AvlStsForLongAutDrv4_ESC_OFF" 15 "AvlStsForLongAutDrv4_HDC_ON";
VAL_ 511 CnclWarnForAutDrvSound 0 "LvlWarn2_NoWarn" 1 "LvlWarn2_Lvl1" 2 "LvlWarn2_Lvl2" 3 "LvlWarn2_Lvl3";
VAL_ 511 CnclWarnLgtForAutDrvSound 0 "NoYesCrit1_NotVld1" 1 "NoYesCrit1_No" 2 "NoYesCrit1_Yes" 3 "NoYesCrit1_NotVld2";
VAL_ 511 FrntLidarSts0 0 "RsdsMstSt_Cfg" 1 "RsdsMstSt_StrtUp" 2 "RsdsMstSt_Runng" 3 "RsdsMstSt_Blkd" 4 "RsdsMstSt_Faulty" 5 "RsdsMstSt_Shutdown" 6 "RsdsMstSt_Hot" 7 "RsdsMstSt_Cal";
VAL_ 511 FrntSideCamLeSts0 0 "RsdsMstSt_Cfg" 1 "RsdsMstSt_StrtUp" 2 "RsdsMstSt_Runng" 3 "RsdsMstSt_Blkd" 4 "RsdsMstSt_Faulty" 5 "RsdsMstSt_Shutdown" 6 "RsdsMstSt_Hot" 7 "RsdsMstSt_Cal";
VAL_ 511 FrntSideCamRiSts0 0 "RsdsMstSt_Cfg" 1 "RsdsMstSt_StrtUp" 2 "RsdsMstSt_Runng" 3 "RsdsMstSt_Blkd" 4 "RsdsMstSt_Faulty" 5 "RsdsMstSt_Shutdown" 6 "RsdsMstSt_Hot" 7 "RsdsMstSt_Cal";
VAL_ 511 HmiAsyVehiclePahDisp 0 "YesNo2_No" 1 "YesNo2_Yes";
VAL_ 511 HmiAutoLaneChgStyle 0 "HmiAutoLaneChgStyle_Normal" 1 "HmiAutoLaneChgStyle_Gentle" 2 "HmiAutoLaneChgStyle_Rapid" 3 "HmiAutoLaneChgStyle_Fault";
VAL_ 511 HmiCrosswalkcolor 0 "LineColor_White" 1 "LineColor_Yellow" 2 "LineColor_Red" 3 "LineColor_Blue" 4 "LineColor_Orange" 5 "LineColor_Green" 6 "LineColor_Other";
VAL_ 511 HmiLaneChgInfo 0 "HmiLaneChgInfo_Default" 1 "HmiLaneChgInfo_FrontVehicleSpeedSlow" 2 "HmiLaneChgInfo_PlsChangeToRightLane" 3 "HmiLaneChgInfo_PlsChangeToLeftLane";
VAL_ 511 OvrdWrnForFstActv 0 "NoYes1_No" 1 "NoYes1_Yes";
VAL_ 640 AsyALatIndcr 0 "AsyIndcrDispSts_NoDisp" 1 "AsyIndcrDispSts_OffDisp" 2 "AsyIndcrDispSts_StandByDisp" 3 "AsyIndcrDispSts_ActiveDisp" 4 "AsyIndcrDispSts_OverrideDisp" 5 "AsyIndcrDispSts_FailureDisp" 6 "AsyIndcrDispSts_Passive";
VAL_ 640 AsyALgtIndcr 0 "AsyIndcrDispSts_NoDisp" 1 "AsyIndcrDispSts_OffDisp" 2 "AsyIndcrDispSts_StandByDisp" 3 "AsyIndcrDispSts_ActiveDisp" 4 "AsyIndcrDispSts_OverrideDisp" 5 "AsyIndcrDispSts_FailureDisp" 6 "AsyIndcrDispSts_Passive";
VAL_ 640 AsyObjForBigData0SnsrSrcOfAbsLatSpd 0 "SnsrSrc1_Ukwn" 1 "SnsrSrc1_Radar" 2 "SnsrSrc1_Cam" 3 "SnsrSrc1_Fusn";
VAL_ 640 AsyObjForBigData0SnsrSrcOfAbsLgtSpd 0 "SnsrSrc1_Ukwn" 1 "SnsrSrc1_Radar" 2 "SnsrSrc1_Cam" 3 "SnsrSrc1_Fusn";
VAL_ 640 AsyObjForBigData0Type 0 "AsyObjType_Car" 1 "AsyObjType_Pedestrian" 2 "AsyObjType_Cyclist" 3 "AsyObjType_Motorbike" 4 "AsyObjType_Bus" 5 "AsyObjType_Truck" 6 "AsyObjType_Tree" 7 "AsyObjType_Wall" 8 "AsyObjType_Animal" 9 "AsyObjType_Unknown";
VAL_ 640 AsyObjType 0 "AsyObjType_Car" 1 "AsyObjType_Pedestrian" 2 "AsyObjType_Cyclist" 3 "AsyObjType_Motorbike" 4 "AsyObjType_Bus" 5 "AsyObjType_Truck" 6 "AsyObjType_Tree" 7 "AsyObjType_Wall" 8 "AsyObjType_Animal" 9 "AsyObjType_Unknown";
VAL_ 640 AsyWarnForSteerCncl 0 "OnOff1_Off" 1 "OnOff1_On";
VAL_ 640 AvlStsForLongAutDrv 0 "AvlStsForLongAutDrv4_NoMsg" 1 "AvlStsForLongAutDrv4_LgtCtrlNotAvl" 2 "AvlStsForLongAutDrv4_AccCncl" 3 "AvlStsForLongAutDrv4_NoVehAhd" 4 "AvlStsForLongAutDrv4_DrvrBucdRqrd" 5 "AvlStsForLongAutDrv4_DrvrDoorNotClsd" 6 "AvlStsForLongAutDrv4_GearNotInDrv" 7 "AvlStsForLongAutDrv4_GearNeut" 8 "AvlStsForLongAutDrv4_SnsrBlkd" 9 "AvlStsForLongAutDrv4_HldTiMaxExcdd" 10 "AvlStsForLongAutDrv4_OvrdTiMaxExcdd" 11 "AvlStsForLongAutDrv4_SpdLowLimExcdd" 12 "AvlStsForLongAutDrv4_DrvModSeldNotOk" 13 "AvlStsForLongAutDrv4_EpbAppld" 14 "AvlStsForLongAutDrv4_ESC_OFF" 15 "AvlStsForLongAutDrv4_HDC_ON";
VAL_ 640 CamStatus0 0 "RsdsMstSt_Cfg" 1 "RsdsMstSt_StrtUp" 2 "RsdsMstSt_Runng" 3 "RsdsMstSt_Blkd" 4 "RsdsMstSt_Faulty" 5 "RsdsMstSt_Shutdown" 6 "RsdsMstSt_Hot" 7 "RsdsMstSt_Cal";
VAL_ 640 CllsnAidPost 0 "OnOff1_Off" 1 "OnOff1_On";
VAL_ 640 CllsnMtgtnFaultSts 0 "CllsnMtgtnFaultSts_NoFault" 1 "CllsnMtgtnFaultSts_Front" 2 "CllsnMtgtnFaultSts_FrontSide" 3 "CllsnMtgtnFaultSts_Both";
VAL_ 640 CllsnMtgtnOnoffSts 0 "OnOff1_Off" 1 "OnOff1_On";
VAL_ 640 CllsnWarnReIndcn 0 "LcmaIndcn_NoLcmaWarn" 1 "LcmaIndcn_LcmaWarnLvl1" 2 "LcmaIndcn_NotUsed" 3 "LcmaIndcn_LcmaWarnLvl2";
VAL_ 640 CnclWarnLgtForAutDrv 0 "NoYesCrit1_NotVld1" 1 "NoYesCrit1_No" 2 "NoYesCrit1_Yes" 3 "NoYesCrit1_NotVld2";
VAL_ 640 DrvOffMod 0 "OnOffSts_default" 1 "OnOffSts_on" 2 "OnOffSts_off" 3 "OnOffSts_off_interrupted";
VAL_ 640 DrvOffWarn 0 "LvlWarn2_NoWarn" 1 "LvlWarn2_Lvl1" 2 "LvlWarn2_Lvl2" 3 "LvlWarn2_Lvl3";
VAL_ 640 FrntRdrSts0 0 "RsdsMstSt_Cfg" 1 "RsdsMstSt_StrtUp" 2 "RsdsMstSt_Runng" 3 "RsdsMstSt_Blkd" 4 "RsdsMstSt_Faulty" 5 "RsdsMstSt_Shutdown" 6 "RsdsMstSt_Hot" 7 "RsdsMstSt_Cal";
VAL_ 640 FrntSideRdrLeSts0 0 "RsdsMstSt_Cfg" 1 "RsdsMstSt_StrtUp" 2 "RsdsMstSt_Runng" 3 "RsdsMstSt_Blkd" 4 "RsdsMstSt_Faulty" 5 "RsdsMstSt_Shutdown" 6 "RsdsMstSt_Hot" 7 "RsdsMstSt_Cal";
VAL_ 640 FrntSideRdrRiSts0 0 "RsdsMstSt_Cfg" 1 "RsdsMstSt_StrtUp" 2 "RsdsMstSt_Runng" 3 "RsdsMstSt_Blkd" 4 "RsdsMstSt_Faulty" 5 "RsdsMstSt_Shutdown" 6 "RsdsMstSt_Hot" 7 "RsdsMstSt_Cal";
VAL_ 640 HmiAutoLaneChgStsForAsyAIAsistAudio 0 "NoLaneChg" 1 "LaneChgOnLeSideFinsh" 2 "LaneChgOnRiSideFinsh" 3 "LaneChgFailrOnLeSide" 4 "LaneChgFailrOnRiSide" 5 "LaneChgNotAvlOnLeSide" 6 "LaneChgNotAvlOnRiSide" 7 "LaneChgOnLeSideProgress" 8 "LaneChgOnRiSideProgress" 9 "LaneChgCncOnLeSide" 10 "LaneChgCncOnRiSide";
VAL_ 640 IHUSetDispAD 0 "SettingDispSts_Normal" 1 "SettingDispSts_AlcaUnavailable" 2 "SettingDispSts_BothUnavailable" 3 "SettingDispSts_TsiFusnUnavailable";
VAL_ 640 LcmaOn 0 "LcmaCtraOn_Off" 1 "LcmaCtraOn_Passive" 2 "LcmaCtraOn_Active" 3 "LcmaCtraOn_TrlrOff";
VAL_ 640 LeTTCLv 0 "WarnLvl_NoWarn" 1 "WarnLvl_WarnLvl1" 2 "WarnLvl_WarnLvl2_NoAudio" 3 "WarnLvl_WarnLvl3_Audio";
VAL_ 640 OffsForSpdWarnSetgSts 0 "OffsForSpdWarnSetgSts_Minus10" 1 "OffsForSpdWarnSetgSts_Minus5" 2 "OffsForSpdWarnSetgSts_Zero" 3 "OffsForSpdWarnSetgSts_Plus5" 4 "OffsForSpdWarnSetgSts_Plus10" 5 "OffsForSpdWarnSetgSts_reserved";
VAL_ 640 ReSideRdrLeSts0 0 "RsdsMstSt_Cfg" 1 "RsdsMstSt_StrtUp" 2 "RsdsMstSt_Runng" 3 "RsdsMstSt_Blkd" 4 "RsdsMstSt_Faulty" 5 "RsdsMstSt_Shutdown" 6 "RsdsMstSt_Hot" 7 "RsdsMstSt_Cal";
VAL_ 640 ReSideRdrRiSts0 0 "RsdsMstSt_Cfg" 1 "RsdsMstSt_StrtUp" 2 "RsdsMstSt_Runng" 3 "RsdsMstSt_Blkd" 4 "RsdsMstSt_Faulty" 5 "RsdsMstSt_Shutdown" 6 "RsdsMstSt_Hot" 7 "RsdsMstSt_Cal";
VAL_ 640 RiTTCLv 0 "WarnLvl_NoWarn" 1 "WarnLvl_WarnLvl1" 2 "WarnLvl_WarnLvl2_NoAudio" 3 "WarnLvl_WarnLvl3_Audio";
VAL_ 640 SpdLimCoupldFirst 0 "SpdCoupldSgn3_NoSpdInfo" 1 "SpdCoupldSgn3_EndOfAllLiml" 2 "SpdCoupldSgn3_HiWaySgn1" 3 "SpdCoupldSgn3_HiWaySgn2" 4 "SpdCoupldSgn3_EndOfHiWaySgn1" 5 "SpdCoupldSgn3_EndOfHiWaySgn2" 6 "SpdCoupldSgn3_FreeWaySgn1" 7 "SpdCoupldSgn3_FreeWaySgn2" 8 "SpdCoupldSgn3_EndOfFreeWaySgn1" 9 "SpdCoupldSgn3_EndOfFreeWaySgn2" 10 "SpdCoupldSgn3_StrtOfCty" 11 "SpdCoupldSgn3_EndOfCty" 12 "SpdCoupldSgn3_StrtOfTown" 13 "SpdCoupldSgn3_EndOfTown" 14 "SpdCoupldSgn3_StrtOfSpdArLo" 15 "SpdCoupldSgn3_EndOfSpdArLo" 16 "SpdCoupldSgn3_EndOfSpdLim" 17 "SpdCoupldSgn3_StrtOfTownSec" 18 "SpdCoupldSgn3_EndOfTownSec";
VAL_ 640 SpdLimSpplFirst 0 "SpplTrfcSgnInfo_Off" 1 "SpplTrfcSgnInfo_Left" 2 "SpplTrfcSgnInfo_Right" 3 "SpplTrfcSgnInfo_Rain" 4 "SpplTrfcSgnInfo_Snow" 5 "SpplTrfcSgnInfo_Snowandrain" 6 "SpplTrfcSgnInfo_Wet" 7 "SpplTrfcSgnInfo_Ice" 8 "SpplTrfcSgnInfo_Trailer" 9 "SpplTrfcSgnInfo_Zone" 10 "SpplTrfcSgnInfo_Timelimit" 11 "SpplTrfcSgnInfo_Distanceto" 12 "SpplTrfcSgnInfo_Distanceduring" 13 "SpplTrfcSgnInfo_Schoolarea" 14 "SpplTrfcSgnInfo_Fog" 15 "SpplTrfcSgnInfo_Night" 16 "SpplTrfcSgnInfo_Ramp" 17 "SpplTrfcSgnInfo_Generalsupplementarysign" 18 "SpplTrfcSgnInfo_End";
VAL_ 640 SpdLimWarnReq 0 "SpdLimWarnReq1_NoWarn" 1 "SpdLimWarnReq1_SpdHi" 2 "SpdLimWarnReq1_SpdHiAndSpdCtrlPassd";
VAL_ 640 SpdLimWarnReqAud 0 "YesNo2_No" 1 "YesNo2_Yes";
VAL_ 640 TooManyCars 0 "NoYes1_No" 1 "NoYes1_Yes";
VAL_ 288 AsyAutDrvgAvl 0 "AsyAutDrvgAvl_NoMsg" 1 "AsyAutDrvgAvl_LatCtrlNotAvl" 2 "AsyAutDrvgAvl_HiSpd" 3 "AsyAutDrvgAvl_VehToFolwMiss" 4 "AsyAutDrvgAvl_OvrdTiMaxExcdd" 5 "AsyAutDrvgAvl_DrvrNotInLoopDetd" 6 "AsyAutDrvgAvl_DrvrBucdRqrd" 7 "AsyAutDrvgAvl_DrvrDoorNotClsd" 8 "AsyAutDrvgAvl_GearNotInDrv" 9 "AsyAutDrvgAvl_SnsrBlkd" 10 "AsyAutDrvgAvl_HldTiMaxExcdd" 11 "AsyAutDrvgAvl_DrvModSeldNotOk" 12 "AsyAutDrvgAvl_EpbAppld" 13 "AsyAutDrvgAvl_SpdLowLimExcdd" 14 "AsyAutDrvgAvl_TrlrPrsnt" 15 "AsyAutDrvgAvl_MltpleMonRoadReq" 16 "AsyAutDrvgAvl_EndOfHndsOffAllwdArea" 17 "AsyAutDrvgAvl_RoadMonWm" 18 "AsyAutDrvgAvl_CannotReactivate" 19 "AsyAutDrvgAvl_NotInUse1" 20 "AsyAutDrvgAvl_ESC_OF" 21 "AsyAutDrvgAvl_HDC_ON" 22 "AsyAutDrvgAvl_Reserved3" 23 "AsyAutDrvgAvl_Reserved4" 24 "AsyAutDrvgAvl_Reserved5" 25 "AsyAutDrvgAvl_Reserved6" 26 "AsyAutDrvgAvl_Reserved7" 27 "AsyAutDrvgAvl_Reserved8" 28 "AsyAutDrvgAvl_Reserved9" 29 "AsyAutDrvgAvl_Reserved10" 30 "AsyAutDrvgAvl_Reserved11" 31 "AsyAutDrvgAvl_Reserved12";
VAL_ 288 AsySteerApplyRqrd 0 "LvlWarn1_NoWarn" 1 "LvlWarn1_Lvl1" 2 "LvlWarn1_Lvl2";
VAL_ 288 BrkPrecActv 0 "OnOff1_Off" 1 "OnOff1_On";
VAL_ 288 DoorOpenwarnLeIndcn 0 "LcmaIndcn_NoLcmaWarn" 1 "LcmaIndcn_LcmaWarnLvl1" 2 "LcmaIndcn_NotUsed" 3 "LcmaIndcn_LcmaWarnLvl2";
VAL_ 288 DoorOpenwarnRiIndcn 0 "LcmaIndcn_NoLcmaWarn" 1 "LcmaIndcn_LcmaWarnLvl1" 2 "LcmaIndcn_NotUsed" 3 "LcmaIndcn_LcmaWarnLvl2";
VAL_ 288 IntvAndWarnModInfoSts 0 "IntvAndWarnModForLaneKeepAidSts_Inactive" 1 "IntvAndWarnModForLaneKeepAidSts_InterventionAndWarning" 2 "IntvAndWarnModForLaneKeepAidSts_InterventionOnly" 3 "IntvAndWarnModForLaneKeepAidSts_WarningOnly";
VAL_ 288 LaneChgAutInfoForAsyHiWay 0 "NoLaneChgAvl" 1 "LaneChgAvlOnLeSide" 2 "LaneChgAvlOnRiSide" 3 "LaneChgAvlOnRiLeSide";
VAL_ 288 LaneChgAutStsForAsyHiWay 0 "NoLaneChg" 1 "LaneChgOnLeSideFinsh" 2 "LaneChgOnRiSideFinsh" 3 "LaneChgFailrOnLeSide" 4 "LaneChgFailrOnRiSide" 5 "LaneChgNotAvlOnLeSide" 6 "LaneChgNotAvlOnRiSide" 7 "LaneChgOnLeSideProgress" 8 "LaneChgOnRiSideProgress" 9 "LaneChgCncOnLeSide" 10 "LaneChgCncOnRiSide";
VAL_ 288 LcmaIndcnLe 0 "WarnLvl_NoWarn" 1 "WarnLvl_WarnLvl1" 2 "WarnLvl_WarnLvl2_NoAudio" 3 "WarnLvl_WarnLvl3_Audio";
VAL_ 288 LcmaIndcnRi 0 "WarnLvl_NoWarn" 1 "WarnLvl_WarnLvl1" 2 "WarnLvl_WarnLvl2_NoAudio" 3 "WarnLvl_WarnLvl3_Audio";
VAL_ 288 RctaBrkReqRctaBrkReq 0 "YesNo1_Yes" 1 "YesNo1_No";
VAL_ 288 RctaIndcnLe 0 "LcmaIndcn_NoLcmaWarn" 1 "LcmaIndcn_LcmaWarnLvl1" 2 "LcmaIndcn_NotUsed" 3 "LcmaIndcn_LcmaWarnLvl2";
VAL_ 288 RctaIndcnRi 0 "LcmaIndcn_NoLcmaWarn" 1 "LcmaIndcn_LcmaWarnLvl1" 2 "LcmaIndcn_NotUsed" 3 "LcmaIndcn_LcmaWarnLvl2";
VAL_ 288 TiGapSetForLgtCtrl 0 "TiGapSetForLgtCtrl_None" 1 "TiGapSetForLgtCtrl_TimeGap_1" 2 "TiGapSetForLgtCtrl_TimeGap_2" 3 "TiGapSetForLgtCtrl_TimeGap_3";
VAL_ 864 CameraStsforAHBC 0 "AdbCamSts_Idle" 1 "AdbCamSts_Normal" 2 "AdbCamSts_Blocking" 3 "AdbCamSts_Unknown";
VAL_ 864 LitArea 0 "NoYes1_No" 1 "NoYes1_Yes";
VAL_ 864 RcwmLiReq 0 "YesNo1_Yes" 1 "YesNo1_No";
VAL_ 864 TurnIndicReqByALCA 0 "IndcrTypExt1_Off" 1 "IndcrTypExt1_Le" 2 "IndcrTypExt1_Ri";
VAL_ 437 FrntSideLidarLeSts0 0 "RsdsMstSt_Cfg" 1 "RsdsMstSt_StrtUp" 2 "RsdsMstSt_Runng" 3 "RsdsMstSt_Blkd" 4 "RsdsMstSt_Faulty" 5 "RsdsMstSt_Shutdown" 6 "RsdsMstSt_Hot" 7 "RsdsMstSt_Cal";
VAL_ 437 FrntSideLidarRiSts0 0 "RsdsMstSt_Cfg" 1 "RsdsMstSt_StrtUp" 2 "RsdsMstSt_Runng" 3 "RsdsMstSt_Blkd" 4 "RsdsMstSt_Faulty" 5 "RsdsMstSt_Shutdown" 6 "RsdsMstSt_Hot" 7 "RsdsMstSt_Cal";
VAL_ 437 HmiMovgObj10ColorOfHmiMovgObj 0 "ColorOfHmiMovgObj_Grey" 1 "ColorOfHmiMovgObj_WhiteaActiveNotmainobjColor" 2 "ColorOfHmiMovgObj_ActiveMainobjColor" 3 "ColorOfHmiMovgObj_Warninglv2Color" 4 "ColorOfHmiMovgObj_Warninglvl1Color";
VAL_ 437 HmiMovgObj10HmiMovgObjTyp 0 "HmiMovgObjTyp_NoDisplay" 1 "HmiMovgObjTyp_Car" 2 "HmiMovgObjTyp_Pedestrian" 3 "HmiMovgObjTyp_Bikecycle" 4 "HmiMovgObjTyp_Animal" 5 "HmiMovgObjTyp_Motocycle" 6 "HmiMovgObjTyp_Bus" 7 "HmiMovgObjTyp_Truck" 8 "HmiMovgObjTyp_Rickshaw" 9 "HmiMovgObjTyp_Tanker" 10 "HmiMovgObjTyp_OpenBackTruck";
VAL_ 437 HmiMovgObj11ColorOfHmiMovgObj 0 "ColorOfHmiMovgObj_Grey" 1 "ColorOfHmiMovgObj_WhiteaActiveNotmainobjColor" 2 "ColorOfHmiMovgObj_ActiveMainobjColor" 3 "ColorOfHmiMovgObj_Warninglv2Color" 4 "ColorOfHmiMovgObj_Warninglvl1Color";
VAL_ 437 HmiMovgObj11HmiMovgObjTyp 0 "HmiMovgObjTyp_NoDisplay" 1 "HmiMovgObjTyp_Car" 2 "HmiMovgObjTyp_Pedestrian" 3 "HmiMovgObjTyp_Bikecycle" 4 "HmiMovgObjTyp_Animal" 5 "HmiMovgObjTyp_Motocycle" 6 "HmiMovgObjTyp_Bus" 7 "HmiMovgObjTyp_Truck" 8 "HmiMovgObjTyp_Rickshaw" 9 "HmiMovgObjTyp_Tanker" 10 "HmiMovgObjTyp_OpenBackTruck";
VAL_ 437 HmiMovgObj1ColorOfHmiMovgObj 0 "ColorOfHmiMovgObj_Grey" 1 "ColorOfHmiMovgObj_WhiteaActiveNotmainobjColor" 2 "ColorOfHmiMovgObj_ActiveMainobjColor" 3 "ColorOfHmiMovgObj_Warninglv2Color" 4 "ColorOfHmiMovgObj_Warninglvl1Color";
VAL_ 437 HmiMovgObj1HmiMovgObjTyp 0 "HmiMovgObjTyp_NoDisplay" 1 "HmiMovgObjTyp_Car" 2 "HmiMovgObjTyp_Pedestrian" 3 "HmiMovgObjTyp_Bikecycle" 4 "HmiMovgObjTyp_Animal" 5 "HmiMovgObjTyp_Motocycle" 6 "HmiMovgObjTyp_Bus" 7 "HmiMovgObjTyp_Truck" 8 "HmiMovgObjTyp_Rickshaw" 9 "HmiMovgObjTyp_Tanker" 10 "HmiMovgObjTyp_OpenBackTruck";
VAL_ 437 HmiMovgObj2ColorOfHmiMovgObj 0 "ColorOfHmiMovgObj_Grey" 1 "ColorOfHmiMovgObj_WhiteaActiveNotmainobjColor" 2 "ColorOfHmiMovgObj_ActiveMainobjColor" 3 "ColorOfHmiMovgObj_Warninglv2Color" 4 "ColorOfHmiMovgObj_Warninglvl1Color";
VAL_ 437 HmiMovgObj2HmiMovgObjTyp 0 "HmiMovgObjTyp_NoDisplay" 1 "HmiMovgObjTyp_Car" 2 "HmiMovgObjTyp_Pedestrian" 3 "HmiMovgObjTyp_Bikecycle" 4 "HmiMovgObjTyp_Animal" 5 "HmiMovgObjTyp_Motocycle" 6 "HmiMovgObjTyp_Bus" 7 "HmiMovgObjTyp_Truck" 8 "HmiMovgObjTyp_Rickshaw" 9 "HmiMovgObjTyp_Tanker" 10 "HmiMovgObjTyp_OpenBackTruck";
VAL_ 437 HmiMovgObj3ColorOfHmiMovgObj 0 "ColorOfHmiMovgObj_Grey" 1 "ColorOfHmiMovgObj_WhiteaActiveNotmainobjColor" 2 "ColorOfHmiMovgObj_ActiveMainobjColor" 3 "ColorOfHmiMovgObj_Warninglv2Color" 4 "ColorOfHmiMovgObj_Warninglvl1Color";
VAL_ 437 HmiMovgObj3HmiMovgObjTyp 0 "HmiMovgObjTyp_NoDisplay" 1 "HmiMovgObjTyp_Car" 2 "HmiMovgObjTyp_Pedestrian" 3 "HmiMovgObjTyp_Bikecycle" 4 "HmiMovgObjTyp_Animal" 5 "HmiMovgObjTyp_Motocycle" 6 "HmiMovgObjTyp_Bus" 7 "HmiMovgObjTyp_Truck" 8 "HmiMovgObjTyp_Rickshaw" 9 "HmiMovgObjTyp_Tanker" 10 "HmiMovgObjTyp_OpenBackTruck";
VAL_ 437 HmiMovgObj4ColorOfHmiMovgObj 0 "ColorOfHmiMovgObj_Grey" 1 "ColorOfHmiMovgObj_WhiteaActiveNotmainobjColor" 2 "ColorOfHmiMovgObj_ActiveMainobjColor" 3 "ColorOfHmiMovgObj_Warninglv2Color" 4 "ColorOfHmiMovgObj_Warninglvl1Color";
VAL_ 437 HmiMovgObj4HmiMovgObjTyp 0 "HmiMovgObjTyp_NoDisplay" 1 "HmiMovgObjTyp_Car" 2 "HmiMovgObjTyp_Pedestrian" 3 "HmiMovgObjTyp_Bikecycle" 4 "HmiMovgObjTyp_Animal" 5 "HmiMovgObjTyp_Motocycle" 6 "HmiMovgObjTyp_Bus" 7 "HmiMovgObjTyp_Truck" 8 "HmiMovgObjTyp_Rickshaw" 9 "HmiMovgObjTyp_Tanker" 10 "HmiMovgObjTyp_OpenBackTruck";
VAL_ 437 HmiMovgObj5ColorOfHmiMovgObj 0 "ColorOfHmiMovgObj_Grey" 1 "ColorOfHmiMovgObj_WhiteaActiveNotmainobjColor" 2 "ColorOfHmiMovgObj_ActiveMainobjColor" 3 "ColorOfHmiMovgObj_Warninglv2Color" 4 "ColorOfHmiMovgObj_Warninglvl1Color";
VAL_ 437 HmiMovgObj5HmiMovgObjTyp 0 "HmiMovgObjTyp_NoDisplay" 1 "HmiMovgObjTyp_Car" 2 "HmiMovgObjTyp_Pedestrian" 3 "HmiMovgObjTyp_Bikecycle" 4 "HmiMovgObjTyp_Animal" 5 "HmiMovgObjTyp_Motocycle" 6 "HmiMovgObjTyp_Bus" 7 "HmiMovgObjTyp_Truck" 8 "HmiMovgObjTyp_Rickshaw" 9 "HmiMovgObjTyp_Tanker" 10 "HmiMovgObjTyp_OpenBackTruck";
VAL_ 437 HmiMovgObj6ColorOfHmiMovgObj 0 "ColorOfHmiMovgObj_Grey" 1 "ColorOfHmiMovgObj_WhiteaActiveNotmainobjColor" 2 "ColorOfHmiMovgObj_ActiveMainobjColor" 3 "ColorOfHmiMovgObj_Warninglv2Color" 4 "ColorOfHmiMovgObj_Warninglvl1Color";
VAL_ 437 HmiMovgObj6HmiMovgObjTyp 0 "HmiMovgObjTyp_NoDisplay" 1 "HmiMovgObjTyp_Car" 2 "HmiMovgObjTyp_Pedestrian" 3 "HmiMovgObjTyp_Bikecycle" 4 "HmiMovgObjTyp_Animal" 5 "HmiMovgObjTyp_Motocycle" 6 "HmiMovgObjTyp_Bus" 7 "HmiMovgObjTyp_Truck" 8 "HmiMovgObjTyp_Rickshaw" 9 "HmiMovgObjTyp_Tanker" 10 "HmiMovgObjTyp_OpenBackTruck";
VAL_ 437 HmiMovgObj7ColorOfHmiMovgObj 0 "ColorOfHmiMovgObj_Grey" 1 "ColorOfHmiMovgObj_WhiteaActiveNotmainobjColor" 2 "ColorOfHmiMovgObj_ActiveMainobjColor" 3 "ColorOfHmiMovgObj_Warninglv2Color" 4 "ColorOfHmiMovgObj_Warninglvl1Color";
VAL_ 437 HmiMovgObj7HmiMovgObjTyp 0 "HmiMovgObjTyp_NoDisplay" 1 "HmiMovgObjTyp_Car" 2 "HmiMovgObjTyp_Pedestrian" 3 "HmiMovgObjTyp_Bikecycle" 4 "HmiMovgObjTyp_Animal" 5 "HmiMovgObjTyp_Motocycle" 6 "HmiMovgObjTyp_Bus" 7 "HmiMovgObjTyp_Truck" 8 "HmiMovgObjTyp_Rickshaw" 9 "HmiMovgObjTyp_Tanker" 10 "HmiMovgObjTyp_OpenBackTruck";
VAL_ 437 HmiMovgObj8ColorOfHmiMovgObj 0 "ColorOfHmiMovgObj_Grey" 1 "ColorOfHmiMovgObj_WhiteaActiveNotmainobjColor" 2 "ColorOfHmiMovgObj_ActiveMainobjColor" 3 "ColorOfHmiMovgObj_Warninglv2Color" 4 "ColorOfHmiMovgObj_Warninglvl1Color";
VAL_ 437 HmiMovgObj8HmiMovgObjTyp 0 "HmiMovgObjTyp_NoDisplay" 1 "HmiMovgObjTyp_Car" 2 "HmiMovgObjTyp_Pedestrian" 3 "HmiMovgObjTyp_Bikecycle" 4 "HmiMovgObjTyp_Animal" 5 "HmiMovgObjTyp_Motocycle" 6 "HmiMovgObjTyp_Bus" 7 "HmiMovgObjTyp_Truck" 8 "HmiMovgObjTyp_Rickshaw" 9 "HmiMovgObjTyp_Tanker" 10 "HmiMovgObjTyp_OpenBackTruck";
VAL_ 437 HmiMovgObj9ColorOfHmiMovgObj 0 "ColorOfHmiMovgObj_Grey" 1 "ColorOfHmiMovgObj_WhiteaActiveNotmainobjColor" 2 "ColorOfHmiMovgObj_ActiveMainobjColor" 3 "ColorOfHmiMovgObj_Warninglv2Color" 4 "ColorOfHmiMovgObj_Warninglvl1Color";
VAL_ 437 HmiMovgObj9HmiMovgObjTyp 0 "HmiMovgObjTyp_NoDisplay" 1 "HmiMovgObjTyp_Car" 2 "HmiMovgObjTyp_Pedestrian" 3 "HmiMovgObjTyp_Bikecycle" 4 "HmiMovgObjTyp_Animal" 5 "HmiMovgObjTyp_Motocycle" 6 "HmiMovgObjTyp_Bus" 7 "HmiMovgObjTyp_Truck" 8 "HmiMovgObjTyp_Rickshaw" 9 "HmiMovgObjTyp_Tanker" 10 "HmiMovgObjTyp_OpenBackTruck";
VAL_ 437 HmiNOPCofmOfLanChag 0 "YesNoRes_Resd1" 1 "YesNoRes_Yes" 2 "YesNoRes_No" 3 "YesNoRes_Resd2";
VAL_ 437 HmiReCamSts0 0 "HmiSnsrSts_Cfg" 1 "HmiSnsrSts_StrtUp" 2 "HmiSnsrSts_Runng" 3 "HmiSnsrSts_Blkd" 4 "HmiSnsrSts_Faulty" 5 "HmiSnsrSts_Shutdown" 6 "HmiSnsrSts_Hot" 7 "HmiSnsrSts_Cal" 8 "HmiSnsrSts_AutCalProc" 9 "HmiSnsrSts_AutCalFish" 10 "HmiSnsrSts_AutCalFail";
VAL_ 437 HWALeadingPointValid 0 "Validity_NotValid" 1 "Validity_Valid";
VAL_ 437 LaneKeepAidInfoSts 0 "OnOff1_Off" 1 "OnOff1_On";
VAL_ 437 ReLidarSts0 0 "RsdsMstSt_Cfg" 1 "RsdsMstSt_StrtUp" 2 "RsdsMstSt_Runng" 3 "RsdsMstSt_Blkd" 4 "RsdsMstSt_Faulty" 5 "RsdsMstSt_Shutdown" 6 "RsdsMstSt_Hot" 7 "RsdsMstSt_Cal";
VAL_ 437 ReSideLidarLeSts0 0 "RsdsMstSt_Cfg" 1 "RsdsMstSt_StrtUp" 2 "RsdsMstSt_Runng" 3 "RsdsMstSt_Blkd" 4 "RsdsMstSt_Faulty" 5 "RsdsMstSt_Shutdown" 6 "RsdsMstSt_Hot" 7 "RsdsMstSt_Cal";
VAL_ 437 ReSideLidarRiSts0 0 "RsdsMstSt_Cfg" 1 "RsdsMstSt_StrtUp" 2 "RsdsMstSt_Runng" 3 "RsdsMstSt_Blkd" 4 "RsdsMstSt_Faulty" 5 "RsdsMstSt_Shutdown" 6 "RsdsMstSt_Hot" 7 "RsdsMstSt_Cal";
VAL_ 480 HmiRoadArrow1HmiRoadArrowLane 0 "Lane_Unassigned" 1 "Lane_Current" 2 "Lane_FirstLeft" 3 "Lane_SecondLeft" 4 "Lane_FirstRight" 5 "Lane_SecondRight";
VAL_ 480 HmiRoadArrow1HmiRoadArrowTyp 0 "HmiRoadArrowTyp_Unknown" 1 "HmiRoadArrowTyp_Left" 2 "HmiRoadArrowTyp_Right" 3 "HmiRoadArrowTyp_Forward" 4 "HmiRoadArrowTyp_LeftForward" 5 "HmiRoadArrowTyp_LeftRight" 6 "HmiRoadArrowTyp_RightForward" 7 "HmiRoadArrowTyp_LeftRightForward" 8 "HmiRoadArrowTyp_Diamond" 9 "HmiRoadArrowTyp_UTurn" 10 "HmiRoadArrowTyp_UTurnForward" 11 "HmiRoadArrowTyp_NoDisplay" 12 "HmiRoadArrowTyp_Reserved1" 13 "HmiRoadArrowTyp_Reserved2" 14 "HmiRoadArrowTyp_Reserved3" 15 "HmiRoadArrowTyp_Reserved4";
VAL_ 480 HmiRoadArrow2HmiRoadArrowLane 0 "Lane_Unassigned" 1 "Lane_Current" 2 "Lane_FirstLeft" 3 "Lane_SecondLeft" 4 "Lane_FirstRight" 5 "Lane_SecondRight";
VAL_ 480 HmiRoadArrow2HmiRoadArrowTyp 0 "HmiRoadArrowTyp_Unknown" 1 "HmiRoadArrowTyp_Left" 2 "HmiRoadArrowTyp_Right" 3 "HmiRoadArrowTyp_Forward" 4 "HmiRoadArrowTyp_LeftForward" 5 "HmiRoadArrowTyp_LeftRight" 6 "HmiRoadArrowTyp_RightForward" 7 "HmiRoadArrowTyp_LeftRightForward" 8 "HmiRoadArrowTyp_Diamond" 9 "HmiRoadArrowTyp_UTurn" 10 "HmiRoadArrowTyp_UTurnForward" 11 "HmiRoadArrowTyp_NoDisplay" 12 "HmiRoadArrowTyp_Reserved1" 13 "HmiRoadArrowTyp_Reserved2" 14 "HmiRoadArrowTyp_Reserved3" 15 "HmiRoadArrowTyp_Reserved4";
VAL_ 480 HmiRoadArrow3HmiRoadArrowLane 0 "Lane_Unassigned" 1 "Lane_Current" 2 "Lane_FirstLeft" 3 "Lane_SecondLeft" 4 "Lane_FirstRight" 5 "Lane_SecondRight";
VAL_ 480 HmiRoadArrow3HmiRoadArrowTyp 0 "HmiRoadArrowTyp_Unknown" 1 "HmiRoadArrowTyp_Left" 2 "HmiRoadArrowTyp_Right" 3 "HmiRoadArrowTyp_Forward" 4 "HmiRoadArrowTyp_LeftForward" 5 "HmiRoadArrowTyp_LeftRight" 6 "HmiRoadArrowTyp_RightForward" 7 "HmiRoadArrowTyp_LeftRightForward" 8 "HmiRoadArrowTyp_Diamond" 9 "HmiRoadArrowTyp_UTurn" 10 "HmiRoadArrowTyp_UTurnForward" 11 "HmiRoadArrowTyp_NoDisplay" 12 "HmiRoadArrowTyp_Reserved1" 13 "HmiRoadArrowTyp_Reserved2" 14 "HmiRoadArrowTyp_Reserved3" 15 "HmiRoadArrowTyp_Reserved4";
VAL_ 480 HmiRoadArrow4HmiRoadArrowLane 0 "Lane_Unassigned" 1 "Lane_Current" 2 "Lane_FirstLeft" 3 "Lane_SecondLeft" 4 "Lane_FirstRight" 5 "Lane_SecondRight";
VAL_ 480 HmiRoadArrow4HmiRoadArrowTyp 0 "HmiRoadArrowTyp_Unknown" 1 "HmiRoadArrowTyp_Left" 2 "HmiRoadArrowTyp_Right" 3 "HmiRoadArrowTyp_Forward" 4 "HmiRoadArrowTyp_LeftForward" 5 "HmiRoadArrowTyp_LeftRight" 6 "HmiRoadArrowTyp_RightForward" 7 "HmiRoadArrowTyp_LeftRightForward" 8 "HmiRoadArrowTyp_Diamond" 9 "HmiRoadArrowTyp_UTurn" 10 "HmiRoadArrowTyp_UTurnForward" 11 "HmiRoadArrowTyp_NoDisplay" 12 "HmiRoadArrowTyp_Reserved1" 13 "HmiRoadArrowTyp_Reserved2" 14 "HmiRoadArrowTyp_Reserved3" 15 "HmiRoadArrowTyp_Reserved4";
VAL_ 480 HmiRoadArrow5HmiRoadArrowLane 0 "Lane_Unassigned" 1 "Lane_Current" 2 "Lane_FirstLeft" 3 "Lane_SecondLeft" 4 "Lane_FirstRight" 5 "Lane_SecondRight";
VAL_ 480 HmiRoadArrow5HmiRoadArrowTyp 0 "HmiRoadArrowTyp_Unknown" 1 "HmiRoadArrowTyp_Left" 2 "HmiRoadArrowTyp_Right" 3 "HmiRoadArrowTyp_Forward" 4 "HmiRoadArrowTyp_LeftForward" 5 "HmiRoadArrowTyp_LeftRight" 6 "HmiRoadArrowTyp_RightForward" 7 "HmiRoadArrowTyp_LeftRightForward" 8 "HmiRoadArrowTyp_Diamond" 9 "HmiRoadArrowTyp_UTurn" 10 "HmiRoadArrowTyp_UTurnForward" 11 "HmiRoadArrowTyp_NoDisplay" 12 "HmiRoadArrowTyp_Reserved1" 13 "HmiRoadArrowTyp_Reserved2" 14 "HmiRoadArrowTyp_Reserved3" 15 "HmiRoadArrowTyp_Reserved4";
VAL_ 480 HmiStaticObj1HmiStaticObjTyp 0 "HmiStaticObjTyp_NoDisplay" 1 "HmiStaticObjTyp_Cone" 2 "HmiStaticObjTyp_Pole" 3 "HmiStaticObjTyp_Reflector" 4 "HmiStaticObjTyp_Sign" 5 "HmiStaticObjTyp_Barrel" 6 "HmiStaticObjTyp_TrashCan" 7 "HmiStaticObjTyp_Stroller" 8 "HmiStaticObjTyp_Wheelchair" 9 "HmiStaticObjTyp_SupermarketCart" 10 "HmiStaticObjTyp_Box" 11 "HmiStaticObjTyp_Boundery" 12 "HmiStaticObjTyp_Other" 13 "HmiStaticObjTyp_NumTypes" 14 "HmiStaticObjTyp_Reserved1" 15 "HmiStaticObjTyp_Reserved2";
VAL_ 480 HmiStaticObj2HmiStaticObjTyp 0 "HmiStaticObjTyp_NoDisplay" 1 "HmiStaticObjTyp_Cone" 2 "HmiStaticObjTyp_Pole" 3 "HmiStaticObjTyp_Reflector" 4 "HmiStaticObjTyp_Sign" 5 "HmiStaticObjTyp_Barrel" 6 "HmiStaticObjTyp_TrashCan" 7 "HmiStaticObjTyp_Stroller" 8 "HmiStaticObjTyp_Wheelchair" 9 "HmiStaticObjTyp_SupermarketCart" 10 "HmiStaticObjTyp_Box" 11 "HmiStaticObjTyp_Boundery" 12 "HmiStaticObjTyp_Other" 13 "HmiStaticObjTyp_NumTypes" 14 "HmiStaticObjTyp_Reserved1" 15 "HmiStaticObjTyp_Reserved2";
VAL_ 480 HmiStaticObj3HmiStaticObjTyp 0 "HmiStaticObjTyp_NoDisplay" 1 "HmiStaticObjTyp_Cone" 2 "HmiStaticObjTyp_Pole" 3 "HmiStaticObjTyp_Reflector" 4 "HmiStaticObjTyp_Sign" 5 "HmiStaticObjTyp_Barrel" 6 "HmiStaticObjTyp_TrashCan" 7 "HmiStaticObjTyp_Stroller" 8 "HmiStaticObjTyp_Wheelchair" 9 "HmiStaticObjTyp_SupermarketCart" 10 "HmiStaticObjTyp_Box" 11 "HmiStaticObjTyp_Boundery" 12 "HmiStaticObjTyp_Other" 13 "HmiStaticObjTyp_NumTypes" 14 "HmiStaticObjTyp_Reserved1" 15 "HmiStaticObjTyp_Reserved2";
VAL_ 480 HmiStaticObj4HmiStaticObjTyp 0 "HmiStaticObjTyp_NoDisplay" 1 "HmiStaticObjTyp_Cone" 2 "HmiStaticObjTyp_Pole" 3 "HmiStaticObjTyp_Reflector" 4 "HmiStaticObjTyp_Sign" 5 "HmiStaticObjTyp_Barrel" 6 "HmiStaticObjTyp_TrashCan" 7 "HmiStaticObjTyp_Stroller" 8 "HmiStaticObjTyp_Wheelchair" 9 "HmiStaticObjTyp_SupermarketCart" 10 "HmiStaticObjTyp_Box" 11 "HmiStaticObjTyp_Boundery" 12 "HmiStaticObjTyp_Other" 13 "HmiStaticObjTyp_NumTypes" 14 "HmiStaticObjTyp_Reserved1" 15 "HmiStaticObjTyp_Reserved2";
VAL_ 480 HmiStaticObj5HmiStaticObjTyp 0 "HmiStaticObjTyp_NoDisplay" 1 "HmiStaticObjTyp_Cone" 2 "HmiStaticObjTyp_Pole" 3 "HmiStaticObjTyp_Reflector" 4 "HmiStaticObjTyp_Sign" 5 "HmiStaticObjTyp_Barrel" 6 "HmiStaticObjTyp_TrashCan" 7 "HmiStaticObjTyp_Stroller" 8 "HmiStaticObjTyp_Wheelchair" 9 "HmiStaticObjTyp_SupermarketCart" 10 "HmiStaticObjTyp_Box" 11 "HmiStaticObjTyp_Boundery" 12 "HmiStaticObjTyp_Other" 13 "HmiStaticObjTyp_NumTypes" 14 "HmiStaticObjTyp_Reserved1" 15 "HmiStaticObjTyp_Reserved2";
VAL_ 480 HmiStaticObj6HmiStaticObjTyp 0 "HmiStaticObjTyp_NoDisplay" 1 "HmiStaticObjTyp_Cone" 2 "HmiStaticObjTyp_Pole" 3 "HmiStaticObjTyp_Reflector" 4 "HmiStaticObjTyp_Sign" 5 "HmiStaticObjTyp_Barrel" 6 "HmiStaticObjTyp_TrashCan" 7 "HmiStaticObjTyp_Stroller" 8 "HmiStaticObjTyp_Wheelchair" 9 "HmiStaticObjTyp_SupermarketCart" 10 "HmiStaticObjTyp_Box" 11 "HmiStaticObjTyp_Boundery" 12 "HmiStaticObjTyp_Other" 13 "HmiStaticObjTyp_NumTypes" 14 "HmiStaticObjTyp_Reserved1" 15 "HmiStaticObjTyp_Reserved2";
VAL_ 480 HmiStaticObj7HmiStaticObjTyp 0 "HmiStaticObjTyp_NoDisplay" 1 "HmiStaticObjTyp_Cone" 2 "HmiStaticObjTyp_Pole" 3 "HmiStaticObjTyp_Reflector" 4 "HmiStaticObjTyp_Sign" 5 "HmiStaticObjTyp_Barrel" 6 "HmiStaticObjTyp_TrashCan" 7 "HmiStaticObjTyp_Stroller" 8 "HmiStaticObjTyp_Wheelchair" 9 "HmiStaticObjTyp_SupermarketCart" 10 "HmiStaticObjTyp_Box" 11 "HmiStaticObjTyp_Boundery" 12 "HmiStaticObjTyp_Other" 13 "HmiStaticObjTyp_NumTypes" 14 "HmiStaticObjTyp_Reserved1" 15 "HmiStaticObjTyp_Reserved2";
VAL_ 480 HmiStaticObj8HmiStaticObjTyp 0 "HmiStaticObjTyp_NoDisplay" 1 "HmiStaticObjTyp_Cone" 2 "HmiStaticObjTyp_Pole" 3 "HmiStaticObjTyp_Reflector" 4 "HmiStaticObjTyp_Sign" 5 "HmiStaticObjTyp_Barrel" 6 "HmiStaticObjTyp_TrashCan" 7 "HmiStaticObjTyp_Stroller" 8 "HmiStaticObjTyp_Wheelchair" 9 "HmiStaticObjTyp_SupermarketCart" 10 "HmiStaticObjTyp_Box" 11 "HmiStaticObjTyp_Boundery" 12 "HmiStaticObjTyp_Other" 13 "HmiStaticObjTyp_NumTypes" 14 "HmiStaticObjTyp_Reserved1" 15 "HmiStaticObjTyp_Reserved2";
VAL_ 480 HmiStopLineStopLinePresent 0 "Boolean_FALSE" 1 "Boolean_TRUE";
VAL_ 480 ReSideCamLeSts0 0 "RsdsMstSt_Cfg" 1 "RsdsMstSt_StrtUp" 2 "RsdsMstSt_Runng" 3 "RsdsMstSt_Blkd" 4 "RsdsMstSt_Faulty" 5 "RsdsMstSt_Shutdown" 6 "RsdsMstSt_Hot" 7 "RsdsMstSt_Cal";
VAL_ 480 ReSideCamRiSts0 0 "RsdsMstSt_Cfg" 1 "RsdsMstSt_StrtUp" 2 "RsdsMstSt_Runng" 3 "RsdsMstSt_Blkd" 4 "RsdsMstSt_Faulty" 5 "RsdsMstSt_Shutdown" 6 "RsdsMstSt_Hot" 7 "RsdsMstSt_Cal";
VAL_ 480 SelfLaneColor 0 "SelfLaneColor_LowLight" 1 "SelfLaneColor_HighLlight" 2 "SelfLaneColor_Reserved";
VAL_ 400 StopReqOfLgtCtrlForPrpsn 0 "NoYes1_No" 1 "NoYes1_Yes";
VAL_ 400 StrtReqOfLgtCtrlForPrpsn 0 "NoYes1_No" 1 "NoYes1_Yes";
VAL_ 400 TrafficSignForADB1AdbDetdQly 0 "ClassnQly_Low" 1 "ClassnQly_Medium" 2 "ClassnQly_High";
VAL_ 400 TrafficSignForADB1AdbTrkInfo 0 "NotTracked" 1 "Tracking";
VAL_ 400 TrafficSignForADB2AdbDetdQly 0 "ClassnQly_Low" 1 "ClassnQly_Medium" 2 "ClassnQly_High";
VAL_ 400 TrafficSignForADB2AdbTrkInfo 0 "NotTracked" 1 "Tracking";
VAL_ 400 VehObjforAHBAdbClassn 0 "AdbClassn_NoVehicle" 1 "AdbClassn_Car" 2 "AdbClassn_Truck" 3 "AdbClassn_Bus" 4 "AdbClassn_BikeOrMotorBike" 5 "AdbClassn_Pedestrain" 6 "AdbClassn_Mixed" 7 "AdbClassn_Unknown";
VAL_ 400 VehObjforAHBAdbClassnQly 0 "ClassnQly_Low" 1 "ClassnQly_Medium" 2 "ClassnQly_High";
VAL_ 400 VehObjforAHBAdbDetdQly 0 "ClassnQly_Low" 1 "ClassnQly_Medium" 2 "ClassnQly_High";
VAL_ 400 VehObjforAHBAdbObjDir 0 "AdbObjDir_Idle" 1 "AdbObjDir_Oncoming" 2 "AdbObjDir_Preceding" 3 "AdbObjDir_Others";
VAL_ 400 VehObjforAHBAdbTrkInfo 0 "NotTracked" 1 "Tracking";
VAL_ 400 WarnForAsyEmgyLaneKeepAid 0 "OnOff1_Off" 1 "OnOff1_On";
SIG_GROUP_ 416 AsyALgtCtrlMod 1 : AsyALgtCtrlMod1 AsyALgtCtrlModChks AsyALgtCtrlModCntr;
SIG_GROUP_ 416 AsyALgtReqForCmft 1 : AsyALgtReqForCmftAsyCmftLgtNegLimForJerk AsyALgtReqForCmftAsyCmftLgtPosLimForJerk AsyALgtReqForCmftMax AsyALgtReqForCmftMin;
SIG_GROUP_ 416 AsyALgtSts 1 : AsyALgtStsAsyALgtSts AsyALgtStsChks AsyALgtStsCntr;
SIG_GROUP_ 416 AsyLatCtrlModReqGroup 1 : AsyLatCtrlModReqGroupAsyLatCtrlModReq AsyLatCtrlModReqGroupChks AsyLatCtrlModReqGroupCntr;
SIG_GROUP_ 496 AsyLineLe2Pah 1 : AsyLineLe2PahPrmA AsyLineLe2PahPrmB AsyLineLe2PahPrmC AsyLineLe2PahPrmD;
SIG_GROUP_ 496 AsyLineLe2Pah2 1 : AsyLineLe2Pah2PrmA AsyLineLe2Pah2PrmB AsyLineLe2Pah2PrmC AsyLineLe2Pah2PrmD;
SIG_GROUP_ 496 AsyLineLePah 1 : AsyLineLePahPrmA AsyLineLePahPrmB AsyLineLePahPrmC AsyLineLePahPrmD;
SIG_GROUP_ 496 AsyLineLePah2 1 : AsyLineLePah2PrmA AsyLineLePah2PrmB AsyLineLePah2PrmC AsyLineLePah2PrmD;
SIG_GROUP_ 496 AsyLineRi2Pah 1 : AsyLineRi2PahPrmA AsyLineRi2PahPrmB AsyLineRi2PahPrmC AsyLineRi2PahPrmD;
SIG_GROUP_ 511 AsyLineRi2Pah2 1 : AsyLineRi2Pah2PrmA AsyLineRi2Pah2PrmB AsyLineRi2Pah2PrmC AsyLineRi2Pah2PrmD;
SIG_GROUP_ 511 AsyLineRiPah 1 : AsyLineRiPahPrmA AsyLineRiPahPrmB AsyLineRiPahPrmC AsyLineRiPahPrmD;
SIG_GROUP_ 511 AsyLineRiPah2 1 : AsyLineRiPah2PrmA AsyLineRiPah2PrmB AsyLineRiPah2PrmC AsyLineRiPah2PrmD;
SIG_GROUP_ 640 AsyObjForBigData0 1 : AsyObjForBigData0AbsLatSpd AsyObjForBigData0AbsLgtSpd AsyObjForBigData0Confidence AsyObjForBigData0RlvtLatDst AsyObjForBigData0RlvtLgtDst AsyObjForBigData0SnsrSrcOfAbsLatSpd AsyObjForBigData0SnsrSrcOfAbsLgtSpd AsyObjForBigData0TTC AsyObjForBigData0Type;
SIG_GROUP_ 1152 AsyObjForBigData1 1 : AsyObjForBigData1AbsLatSpd AsyObjForBigData1AbsLgtSpd AsyObjForBigData1Confidence AsyObjForBigData1RlvtLatDst AsyObjForBigData1RlvtLgtDst AsyObjForBigData1SnsrSrcOfAbsLatSpd AsyObjForBigData1SnsrSrcOfAbsLgtSpd AsyObjForBigData1TTC AsyObjForBigData1Type;
SIG_GROUP_ 1152 AsyObjForBigData2 1 : AsyObjForBigData2AbsLatSpd AsyObjForBigData2AbsLgtSpd AsyObjForBigData2Confidence AsyObjForBigData2RlvtLatDst AsyObjForBigData2RlvtLgtDst AsyObjForBigData2SnsrSrcOfAbsLatSpd AsyObjForBigData2SnsrSrcOfAbsLgtSpd AsyObjForBigData2TTC AsyObjForBigData2Type;
SIG_GROUP_ 1152 AsyPinionAgReqSafe 1 : AsyPinionAgReqSafeAsyPinionAgReq AsyPinionAgReqSafeAsyPinionAgReqChks AsyPinionAgReqSafeAsyPinionAgReqCntr;
SIG_GROUP_ 416 AsySftyEnaDecelByDBS 1 : AsySftyEnaDecelByDBSAsySftyEnaDecelByDBS AsySftyEnaDecelByDBSChks AsySftyEnaDecelByDBSCntr;
SIG_GROUP_ 752 AsySftyFctStsToEDR 1 : AsySftyFctStsToEDRACCFctSTs AsySftyFctStsToEDRACSFB1FctSts AsySftyFctStsToEDRACSFB2FctSts AsySftyFctStsToEDRACSFCFctSts AsySftyFctStsToEDRACSFDFctSts AsySftyFctStsToEDRACSFEFctSts AsySftyFctStsToEDRAEBSFctSts AsySftyFctStsToEDRCSFFctSts AsySftyFctStsToEDRESFFctSts AsySftyFctStsToEDRLDWSFctSts;
SIG_GROUP_ 416 BrkHptcWarnReqForAutDrv 1 : BrkHptcWarnReqForAutDrvBrkHptcWarnReqForAutDrv BrkHptcWarnReqForAutDrvChks BrkHptcWarnReqForAutDrvCntr;
SIG_GROUP_ 1152 ExtLiData 1 : ExtLiDataDayNight ExtLiDataHiWay ExtLiDataInCity ExtLiDataInTunnel ExtLiDataTiStamp ExtLiDataTrfcSide;
SIG_GROUP_ 511 HmiAsyVehiclePah 1 : HmiAsyVehiclePahPrmA HmiAsyVehiclePahPrmB HmiAsyVehiclePahPrmC HmiAsyVehiclePahPrmD;
SIG_GROUP_ 511 HmiAsyVehiclePah2 1 : HmiAsyVehiclePah2PrmA HmiAsyVehiclePah2PrmB HmiAsyVehiclePah2PrmC HmiAsyVehiclePah2PrmD;
SIG_GROUP_ 511 HmiCrosswalk 1 : HmiCrosswalkAngle HmiCrosswalkcolor HmiCrosswalklateralDistance HmiCrosswalklength HmiCrosswalklongitudinalDistance HmiCrosswalkTiStamp HmiCrosswalkwidth;
SIG_GROUP_ 437 HmiMovgObj1 1 : HmiMovgObj1ColorOfHmiMovgObj HmiMovgObj1DstLatOfMovgObj HmiMovgObj1DstLgtOfMovgObj HmiMovgObj1HdDirOfMovgObj HmiMovgObj1HmiMovgObjTyp;
SIG_GROUP_ 437 HmiMovgObj10 1 : HmiMovgObj10ColorOfHmiMovgObj HmiMovgObj10DstLatOfMovgObj HmiMovgObj10DstLgtOfMovgObj HmiMovgObj10HdDirOfMovgObj HmiMovgObj10HmiMovgObjTyp;
SIG_GROUP_ 437 HmiMovgObj11 1 : HmiMovgObj11ColorOfHmiMovgObj HmiMovgObj11DstLatOfMovgObj HmiMovgObj11DstLgtOfMovgObj HmiMovgObj11HdDirOfMovgObj HmiMovgObj11HmiMovgObjTyp;
SIG_GROUP_ 437 HmiMovgObj2 1 : HmiMovgObj2ColorOfHmiMovgObj HmiMovgObj2DstLatOfMovgObj HmiMovgObj2DstLgtOfMovgObj HmiMovgObj2HdDirOfMovgObj HmiMovgObj2HmiMovgObjTyp;
SIG_GROUP_ 437 HmiMovgObj3 1 : HmiMovgObj3ColorOfHmiMovgObj HmiMovgObj3DstLatOfMovgObj HmiMovgObj3DstLgtOfMovgObj HmiMovgObj3HdDirOfMovgObj HmiMovgObj3HmiMovgObjTyp;
SIG_GROUP_ 437 HmiMovgObj4 1 : HmiMovgObj4ColorOfHmiMovgObj HmiMovgObj4DstLatOfMovgObj HmiMovgObj4DstLgtOfMovgObj HmiMovgObj4HdDirOfMovgObj HmiMovgObj4HmiMovgObjTyp;
SIG_GROUP_ 437 HmiMovgObj5 1 : HmiMovgObj5ColorOfHmiMovgObj HmiMovgObj5DstLatOfMovgObj HmiMovgObj5DstLgtOfMovgObj HmiMovgObj5HdDirOfMovgObj HmiMovgObj5HmiMovgObjTyp;
SIG_GROUP_ 437 HmiMovgObj6 1 : HmiMovgObj6ColorOfHmiMovgObj HmiMovgObj6DstLatOfMovgObj HmiMovgObj6DstLgtOfMovgObj HmiMovgObj6HdDirOfMovgObj HmiMovgObj6HmiMovgObjTyp;
SIG_GROUP_ 437 HmiMovgObj7 1 : HmiMovgObj7ColorOfHmiMovgObj HmiMovgObj7DstLatOfMovgObj HmiMovgObj7DstLgtOfMovgObj HmiMovgObj7HdDirOfMovgObj HmiMovgObj7HmiMovgObjTyp;
SIG_GROUP_ 437 HmiMovgObj8 1 : HmiMovgObj8ColorOfHmiMovgObj HmiMovgObj8DstLatOfMovgObj HmiMovgObj8DstLgtOfMovgObj HmiMovgObj8HdDirOfMovgObj HmiMovgObj8HmiMovgObjTyp;
SIG_GROUP_ 437 HmiMovgObj9 1 : HmiMovgObj9ColorOfHmiMovgObj HmiMovgObj9DstLatOfMovgObj HmiMovgObj9DstLgtOfMovgObj HmiMovgObj9HdDirOfMovgObj HmiMovgObj9HmiMovgObjTyp;
SIG_GROUP_ 480 HmiRoadArrow1 1 : HmiRoadArrow1HmiRoadArrowLane HmiRoadArrow1HmiRoadArrowTyp HmiRoadArrow1LatPosition HmiRoadArrow1LongPosition;
SIG_GROUP_ 480 HmiRoadArrow2 1 : HmiRoadArrow2HmiRoadArrowLane HmiRoadArrow2HmiRoadArrowTyp HmiRoadArrow2LatPosition HmiRoadArrow2LongPosition;
SIG_GROUP_ 480 HmiRoadArrow3 1 : HmiRoadArrow3HmiRoadArrowLane HmiRoadArrow3HmiRoadArrowTyp HmiRoadArrow3LatPosition HmiRoadArrow3LongPosition;
SIG_GROUP_ 480 HmiRoadArrow4 1 : HmiRoadArrow4HmiRoadArrowLane HmiRoadArrow4HmiRoadArrowTyp HmiRoadArrow4LatPosition HmiRoadArrow4LongPosition;
SIG_GROUP_ 480 HmiRoadArrow5 1 : HmiRoadArrow5HmiRoadArrowLane HmiRoadArrow5HmiRoadArrowTyp HmiRoadArrow5LatPosition HmiRoadArrow5LongPosition;
SIG_GROUP_ 480 HmiStaticObj1 1 : HmiStaticObj1DstLatOfStaticObj HmiStaticObj1DstLgtOfStaticObj HmiStaticObj1HmiStaticObjTyp;
SIG_GROUP_ 480 HmiStaticObj2 1 : HmiStaticObj2DstLatOfStaticObj HmiStaticObj2DstLgtOfStaticObj HmiStaticObj2HmiStaticObjTyp;
SIG_GROUP_ 480 HmiStaticObj3 1 : HmiStaticObj3DstLatOfStaticObj HmiStaticObj3DstLgtOfStaticObj HmiStaticObj3HmiStaticObjTyp;
SIG_GROUP_ 480 HmiStaticObj4 1 : HmiStaticObj4DstLatOfStaticObj HmiStaticObj4DstLgtOfStaticObj HmiStaticObj4HmiStaticObjTyp;
SIG_GROUP_ 480 HmiStaticObj5 1 : HmiStaticObj5DstLatOfStaticObj HmiStaticObj5DstLgtOfStaticObj HmiStaticObj5HmiStaticObjTyp;
SIG_GROUP_ 480 HmiStaticObj6 1 : HmiStaticObj6DstLatOfStaticObj HmiStaticObj6DstLgtOfStaticObj HmiStaticObj6HmiStaticObjTyp;
SIG_GROUP_ 480 HmiStaticObj7 1 : HmiStaticObj7DstLatOfStaticObj HmiStaticObj7DstLgtOfStaticObj HmiStaticObj7HmiStaticObjTyp;
SIG_GROUP_ 480 HmiStaticObj8 1 : HmiStaticObj8DstLatOfStaticObj HmiStaticObj8DstLgtOfStaticObj HmiStaticObj8HmiStaticObjTyp;
SIG_GROUP_ 480 HmiStopLine 1 : HmiStopLineConfidence HmiStopLineDistanceToStopLine HmiStopLineStopLinePresent HmiStopLineTiStamp;
SIG_GROUP_ 437 HWALeadingPoint 1 : HWALeadingPointCenterX HWALeadingPointCenterY HWALeadingPointValid;
SIG_GROUP_ 416 ObjFrnt1 1 : ObjFrnt1ColorOfObjFrnt1 ObjFrnt1DstLatOfObjFrnt1 ObjFrnt1DstLgtOfObjFrnt1 ObjFrnt1HdDirOfObjFrnt1 ObjFrnt1TypOfObjFrnt1;
SIG_GROUP_ 416 ObjFrnt2 1 : ObjFrnt2ColorOfObjFrnt2 ObjFrnt2DstLatOfObjFrnt2 ObjFrnt2DstLgtOfObjFrnt2 ObjFrnt2HdDirOfObjFrnt2 ObjFrnt2TypOfObjFrnt2;
SIG_GROUP_ 416 ObjFrntLe 1 : ObjFrntLeColorOfObjFrntLe ObjFrntLeDstLatOfObjFrntLe ObjFrntLeDstLgtOfObjFrntLe ObjFrntLeHdDirOfObjFrntLe ObjFrntLeTypOfObjFrntLe;
SIG_GROUP_ 416 ObjFrntRi 1 : ObjFrntRiColorOfObjFrntRi ObjFrntRiDstLatOfObjFrntRi ObjFrntRiDstLgtOfObjFrntRi ObjFrntRiHdDirOfObjFrntRi ObjFrntRiTypOfObjFrntRi;
SIG_GROUP_ 416 PtVehSpdMax 1 : PtVehSpdMaxChks PtVehSpdMaxCntr PtVehSpdMaxReq;
SIG_GROUP_ 288 RctaBrkReq 1 : RctaBrkReqChks RctaBrkReqCntr RctaBrkReqRctaBrkReq;
SIG_GROUP_ 416 RcwmBrkReq 1 : RcwmBrkReqChks RcwmBrkReqCntr RcwmBrkReqRcwmBrkReq;
SIG_GROUP_ 416 SftyDecelGroupSafe 1 : SftyDecelGroupSafeAsySftyDecelReq SftyDecelGroupSafeAsySftyEnaDecel SftyDecelGroupSafeChks SftyDecelGroupSafeCntr;
SIG_GROUP_ 400 SteerTqAddlForEma 1 : SteerTqAddlForEmaChks SteerTqAddlForEmaCntr SteerTqAddlForEmaSteerTqAddlForEma;
SIG_GROUP_ 400 TrafficSignForADB1 1 : TrafficSignForADB1AdbAbsDist TrafficSignForADB1AdbDetdQly TrafficSignForADB1AdbHozlAgLe TrafficSignForADB1AdbHozlAgRi TrafficSignForADB1AdbTrkInfo TrafficSignForADB1AdbVertAgBot TrafficSignForADB1AdbVertAgTop;
SIG_GROUP_ 400 TrafficSignForADB2 1 : TrafficSignForADB2AdbAbsDist TrafficSignForADB2AdbDetdQly TrafficSignForADB2AdbHozlAgLe TrafficSignForADB2AdbHozlAgRi TrafficSignForADB2AdbTrkInfo TrafficSignForADB2AdbVertAgBot TrafficSignForADB2AdbVertAgTop;
SIG_GROUP_ 400 VehObjforAHB 1 : VehObjforAHBAdbAbsDist VehObjforAHBAdbClassn VehObjforAHBAdbClassnQly VehObjforAHBAdbDetdQly VehObjforAHBAdbHozlAg VehObjforAHBAdbObjDir VehObjforAHBAdbObjHozlAgSpd VehObjforAHBAdbObjVertAgSpd VehObjforAHBAdbTrkInfo VehObjforAHBAdbVertAg;
