VERSION "ZCU_CANFD2"

NS_ :

BS_ :

BU_ :  ETC IHU ZCUD ZCUP

BO_ 1161 ZCUDZCUCANFD2Fr19 : 64 ZCUD
 SG_ DmcStsFrntToEsc_UB : 97|1@0+ (1,0) [0|1] "" IHU
 SG_ DmcStsFrntToEscChks : 143|8@0+ (1.0,0.0) [0.0|255.0] "Unitless" IHU
 SG_ DmcStsFrntToEscCntr : 151|4@0+ (1.0,0.0) [0.0|15.0] "Unitless" IHU
 SG_ DmcStsFrntToEscDmcActAppTarTq : 159|16@0- (1.0,0.0) [-30000.0|30000.0] "NewtonMeter" IHU
 SG_ DmcStsFrntToEscDmcSts : 147|4@0+ (1,0) [0|15] "" IHU
 SG_ DmcStsFrntToEscDmcSWInfo : 175|16@0+ (1.0,0.0) [0.0|65535.0] "Unitless" IHU
 SG_ DrvrSteerActv_UB : 209|1@0+ (1,0) [0|1] "" IHU
 SG_ DrvrSteerActvChks : 223|8@0+ (1.0,0.0) [0.0|255.0] "Unitless" IHU
 SG_ DrvrSteerActvCntr : 231|4@0+ (1.0,0.0) [0.0|15.0] "Unitless" IHU
 SG_ DrvrSteerActvDrvrSteerActv : 208|1@0+ (1,0) [0|1] "" IHU
 SG_ ElecMot2IDc : 247|14@0+ (0.1,-818.8) [-818.8|819.2] "A" Vector__XXX
 SG_ ElecMot2IDc_UB : 79|1@0+ (1,0) [0|1] "" Vector__XXX
 SG_ EngN2 : 263|15@0+ (0.5,0.0) [0.0|16383.5] "rpm" IHU
 SG_ EngN2_UB : 78|1@0+ (1,0) [0|1] "" IHU
 SG_ EpbAvlSec_UB : 484|1@0+ (1,0) [0|1] "" IHU
 SG_ EpbAvlSecChks : 495|8@0+ (1.0,0.0) [0.0|255.0] "Unitless" IHU
 SG_ EpbAvlSecCntr : 483|4@0+ (1.0,0.0) [0.0|15.0] "Unitless" IHU
 SG_ EpbAvlSecCommunicationAvailable : 503|1@0+ (1,0) [0|1] "" IHU
 SG_ EpbAvlSecHostAvailabilityFull : 502|1@0+ (1,0) [0|1] "" IHU
 SG_ EpbAvlSecHostAvailabilityRelOnly : 501|1@0+ (1,0) [0|1] "" IHU
 SG_ EpbAvlSecReserved1 : 500|1@0+ (1,0) [0|1] "" IHU
 SG_ EpbAvlSecReserved2 : 499|1@0+ (1,0) [0|1] "" IHU
 SG_ EpbAvlSecReserved3 : 498|1@0+ (1,0) [0|1] "" IHU
 SG_ EpbAvlSecReserved4 : 497|1@0+ (1,0) [0|1] "" IHU
 SG_ EpbAvlSecReserved5 : 496|1@0+ (1,0) [0|1] "" IHU
 SG_ EpbAvlSecReserved6 : 511|1@0+ (1,0) [0|1] "" IHU
 SG_ EpbAvlSecReserved7 : 510|1@0+ (1,0) [0|1] "" IHU
 SG_ IsgErrIndcnReq : 11|1@0+ (1,0) [0|1] "" IHU
 SG_ IsgErrIndcnReq_UB : 10|1@0+ (1,0) [0|1] "" IHU
 SG_ IsgLimnIndcn : 63|16@0+ (1.0,0.0) [0.0|65535.0] "Unitless" IHU
 SG_ IsgLimnIndcn_UB : 48|1@0+ (1,0) [0|1] "" IHU
 SG_ IsgSpdActSgnSafe_UB : 191|1@0+ (1,0) [0|1] "" IHU
 SG_ IsgSpdActSgnSafeChks : 207|8@0+ (1.0,0.0) [0.0|255.0] "Unitless" IHU
 SG_ IsgSpdActSgnSafeCntr : 215|4@0+ (1.0,0.0) [0.0|15.0] "Unitless" IHU
 SG_ IsgSpdActSgnSafeIsgSpdWSgnTyp : 190|15@0- (1.0,0.0) [-16384.0|16383.0] "rpm" IHU
 SG_ IsgSpdActSgnSafeQf : 211|2@0+ (1,0) [0|3] "" IHU
 SG_ IsgTqAvl_UB : 9|1@0+ (1,0) [0|1] "" IHU
 SG_ IsgTqAvlMax : 77|14@0+ (1.0,-8188.0) [-8188.0|8192.0] "NewtonMeter" IHU
 SG_ IsgTqAvlMin : 95|14@0+ (1.0,-8188.0) [-8188.0|8192.0] "NewtonMeter" IHU
 SG_ Mot1ReqSafe_UB : 249|1@0+ (1,0) [0|1] "" Vector__XXX
 SG_ Mot1ReqSafeChks : 279|8@0+ (1.0,0.0) [0.0|255.0] "Unitless" Vector__XXX
 SG_ Mot1ReqSafeCntr : 287|4@0+ (1.0,0.0) [0.0|15.0] "Unitless" Vector__XXX
 SG_ Mot1ReqSafemod : 283|4@0+ (1,0) [0|15] "" Vector__XXX
 SG_ Mot1ReqSafeRsv : 327|4@0+ (1.0,0.0) [0.0|15.0] "Unitless" Vector__XXX
 SG_ Mot1ReqSafespd : 295|15@0- (1.0,0.0) [-16384.0|16383.0] "rpm" Vector__XXX
 SG_ Mot1ReqSafetq : 311|14@0+ (1.0,-8188.0) [-8188.0|8192.0] "NewtonMeter" Vector__XXX
 SG_ Mot3ReqSafe_UB : 248|1@0+ (1,0) [0|1] "" Vector__XXX
 SG_ Mot3ReqSafeChks : 335|8@0+ (1.0,0.0) [0.0|255.0] "Unitless" Vector__XXX
 SG_ Mot3ReqSafeCntr : 343|4@0+ (1.0,0.0) [0.0|15.0] "Unitless" Vector__XXX
 SG_ Mot3ReqSafemod : 339|4@0+ (1,0) [0|15] "" Vector__XXX
 SG_ Mot3ReqSafeRsv : 323|4@0+ (1.0,0.0) [0.0|15.0] "Unitless" Vector__XXX
 SG_ Mot3ReqSafespd : 351|15@0- (1.0,0.0) [-16384.0|16383.0] "rpm" Vector__XXX
 SG_ Mot3ReqSafetq : 367|14@0+ (1.0,-8188.0) [-8188.0|8192.0] "NewtonMeter" Vector__XXX
 SG_ PtClu0TqReq : 369|10@0+ (1.0,0.0) [0.0|1023.0] "Unitless" Vector__XXX
 SG_ PtClu0TqReq_UB : 227|1@0+ (1,0) [0|1] "" Vector__XXX
 SG_ PtCluTq_UB : 226|1@0+ (1,0) [0|1] "" Vector__XXX
 SG_ PtCluTq2Req : 391|11@0+ (1.0,-1024.0) [-1024.0|1023.0] "NewtonMeter" IHU
 SG_ PtCluTq2Req_UB : 225|1@0+ (1,0) [0|1] "" IHU
 SG_ PtCluTqDyn : 394|11@0+ (1.0,-1024.0) [-1024.0|1023.0] "NewtonMeter" Vector__XXX
 SG_ PtCluTqPtCluTq : 415|11@0+ (1.0,-1024.0) [-1024.0|1023.0] "NewtonMeter" Vector__XXX
 SG_ PtCluTqQly : 420|3@0+ (1,0) [0|7] "" Vector__XXX
 SG_ PtGearTarReq : 396|2@0+ (1,0) [0|3] "" Vector__XXX
 SG_ PtGearTarReq_UB : 224|1@0+ (1,0) [0|1] "" Vector__XXX
 SG_ PtParkReqToWhlsRe : 479|1@0+ (1,0) [0|1] "" IHU
 SG_ PtParkReqToWhlsRe_UB : 131|1@0+ (1,0) [0|1] "" IHU
 SG_ SteerExtFctSts_UB : 446|1@0+ (1,0) [0|1] "" IHU
 SG_ SteerExtFctStsChks : 431|8@0+ (1.0,0.0) [0.0|255.0] "Unitless" IHU
 SG_ SteerExtFctStsCntr : 439|4@0+ (1.0,0.0) [0.0|15.0] "Unitless" IHU
 SG_ SteerExtFctStsDrvrSteerOvrd : 417|1@0+ (1,0) [0|1] "" IHU
 SG_ SteerExtFctStsExtFctLowerLimActive : 416|1@0+ (1,0) [0|1] "" IHU
 SG_ SteerExtFctStsExtFctRateLimActive : 435|1@0+ (1,0) [0|1] "" IHU
 SG_ SteerExtFctStsExtFctUpperLimActive : 434|1@0+ (1,0) [0|1] "" IHU
 SG_ SteerExtFctStsExtSafeLimActive : 433|1@0+ (1,0) [0|1] "" IHU
 SG_ SteerExtFctStsLatAgReqNotInRange : 432|1@0+ (1,0) [0|1] "" IHU
 SG_ SteerExtFctStsLatCtrlReqNotInRange : 447|1@0+ (1,0) [0|1] "" IHU
 SG_ SuspFailrSts_UB : 96|1@0+ (1,0) [0|1] "" Vector__XXX
 SG_ SuspFailrStsChks : 119|8@0+ (1.0,0.0) [0.0|255.0] "Unitless" Vector__XXX
 SG_ SuspFailrStsCntr : 127|4@0+ (1.0,0.0) [0.0|15.0] "Unitless" Vector__XXX
 SG_ SuspFailrStsSuspFailrSts : 123|3@0+ (1,0) [0|7] "" Vector__XXX
 SG_ SuspFailrStsTypQf : 135|2@0+ (1,0) [0|3] "" Vector__XXX
 SG_ TqAssAddl : 445|14@0- (0.00390625,0.0) [-30.0|30.0] "NewtonMeter" IHU
 SG_ TqAssAddl_UB : 128|1@0+ (1,0) [0|1] "" IHU
 SG_ TrlrModVMMFltSts : 130|1@0+ (1,0) [0|1] "" IHU
 SG_ TrlrModVMMFltSts_UB : 129|1@0+ (1,0) [0|1] "" IHU
 SG_ TrsmActrPosnSafeAux_UB : 464|1@0+ (1,0) [0|1] "" IHU
 SG_ TrsmActrPosnSafeAuxTrsmActrPosn : 467|3@0+ (1,0) [0|7] "" IHU
 SG_ TrsmActrPosnSafeAuxTrsmActrPosnChks : 463|8@0+ (1.0,0.0) [0.0|255.0] "Unitless" IHU
 SG_ TrsmActrPosnSafeAuxTrsmActrPosnCntr : 471|4@0+ (1.0,0.0) [0.0|15.0] "Unitless" IHU
 SG_ TrsmModNotAvlSts : 7|8@0+ (1.0,0.0) [0.0|255.0] "Unitless" IHU
 SG_ TrsmModNotAvlSts_UB : 14|1@0+ (1,0) [0|1] "" IHU
 SG_ TrsmNeutFailr : 15|1@0+ (1,0) [0|1] "" IHU
 SG_ TrsmNeutFailr_UB : 13|1@0+ (1,0) [0|1] "" IHU
 SG_ TrsmOilT : 23|8@0+ (1.0,-60.0) [-60.0|195.0] "degC" IHU
 SG_ TrsmOilT_UB : 12|1@0+ (1,0) [0|1] "" IHU
 SG_ TrsmTqLoss_UB : 49|1@0+ (1,0) [0|1] "" IHU
 SG_ TrsmTqLossChks : 31|8@0+ (1.0,0.0) [0.0|255.0] "Unitless" IHU
 SG_ TrsmTqLossCntr : 53|4@0+ (1.0,0.0) [0.0|15.0] "Unitless" IHU
 SG_ TrsmTqLossTrsmTqEff : 47|10@0+ (0.1,0.0) [0.0|100.0] "%" IHU
 SG_ TrsmTqLossTrsmTqLoss : 39|8@0+ (0.5,0.0) [0.0|127.0] "Unitless" IHU
 SG_ WrmUpCyc : 133|1@0+ (1,0) [0|1] "" Vector__XXX
 SG_ WrmUpCyc_UB : 132|1@0+ (1,0) [0|1] "" Vector__XXX

BO_ 1173 ZCUDZCUCANFD2Fr20 : 64 ZCUD
 SG_ BswRstAddress : 447|32@0+ (1.0,0.0) [0.0|4294967295.0] "Unitless" IHU
 SG_ BswRstAddress_UB : 439|1@0+ (1,0) [0|1] "" IHU
 SG_ BswRstReason : 19|3@0+ (1,0) [0|7] "" IHU
 SG_ BswRstReason_UB : 16|1@0+ (1,0) [0|1] "" IHU
 SG_ CarLoctrToExtrLiVisReq : 7|8@0+ (1,0) [0|255] "" IHU
 SG_ CarLoctrToExtrLiVisReq_UB : 15|1@0+ (1,0) [0|1] "" IHU
 SG_ DiagcSigSWM : 14|2@0+ (1,0) [0|3] "" IHU
 SG_ DiagcSigSWM_UB : 12|1@0+ (1,0) [0|1] "" IHU
 SG_ EnaOfflineMonitor : 9|1@0+ (1,0) [0|1] "" IHU
 SG_ EnaOfflineMonitor_UB : 8|1@0+ (1,0) [0|1] "" IHU
 SG_ EngLoadReqElec : 31|16@0- (1.0,0.0) [-32768.0|32767.0] "W" IHU
 SG_ EngLoadReqElec_UB : 11|1@0+ (1,0) [0|1] "" IHU
 SG_ EngNSafe_UB : 10|1@0+ (1,0) [0|1] "" ZCUP
 SG_ EngNSafeEngN : 71|15@0+ (0.5,0.0) [0.0|16383.5] "rpm" ZCUP
 SG_ EngNSafeEngNChks : 63|8@0+ (1.0,0.0) [0.0|255.0] "Unitless" ZCUP
 SG_ EngNSafeEngNCntr : 87|4@0+ (1.0,0.0) [0.0|15.0] "Unitless" ZCUP
 SG_ EngNSafeEngNGrdt : 47|16@0- (1.0,0.0) [-30000.0|32767.0] "RpmPerSec" ZCUP
 SG_ EngRunngReqByVehModMgr_UB : 83|1@0+ (1,0) [0|1] "" IHU
 SG_ EngRunngReqByVehModMgrChassie : 111|1@0+ (1,0) [0|1] "" IHU
 SG_ EngRunngReqByVehModMgrClimate : 110|1@0+ (1,0) [0|1] "" IHU
 SG_ EngRunngReqByVehModMgrElectricalSystem : 109|1@0+ (1,0) [0|1] "" IHU
 SG_ EngRunngReqByVehModMgrTrailerPrsnt : 108|1@0+ (1,0) [0|1] "" IHU
 SG_ EngSt1WdSts1 : 107|4@0+ (1,0) [0|15] "" IHU
 SG_ EngSt1WdSts1_UB : 124|1@0+ (1,0) [0|1] "" IHU
 SG_ FltOfBeamHiDrv : 23|1@0+ (1,0) [0|1] "" IHU
 SG_ FltOfBeamHiDrv_UB : 22|1@0+ (1,0) [0|1] "" IHU
 SG_ FltOfBeamLoDrv : 21|1@0+ (1,0) [0|1] "" IHU
 SG_ FltOfBeamLoDrv_UB : 20|1@0+ (1,0) [0|1] "" IHU
 SG_ FltOfCenHiMntdStopLamp : 287|1@0+ (1,0) [0|1] "" IHU
 SG_ FltOfCenHiMntdStopLamp_UB : 286|1@0+ (1,0) [0|1] "" IHU
 SG_ FltOfCenHiMntdStopLamp1 : 285|1@0+ (1,0) [0|1] "" IHU
 SG_ FltOfCenHiMntdStopLamp1_UB : 284|1@0+ (1,0) [0|1] "" IHU
 SG_ FltOfDaytiRunngLampDrv : 283|1@0+ (1,0) [0|1] "" IHU
 SG_ FltOfDaytiRunngLampDrv_UB : 282|1@0+ (1,0) [0|1] "" IHU
 SG_ FltOfFrntFogLampDrv : 281|1@0+ (1,0) [0|1] "" IHU
 SG_ FltOfFrntFogLampDrv_UB : 280|1@0+ (1,0) [0|1] "" IHU
 SG_ FltOfFrntPosnLampDrv : 295|1@0+ (1,0) [0|1] "" IHU
 SG_ FltOfFrntPosnLampDrv_UB : 294|1@0+ (1,0) [0|1] "" IHU
 SG_ FltOfRePosnLampDrv : 293|1@0+ (1,0) [0|1] "" IHU
 SG_ FltOfRePosnLampDrv_UB : 292|1@0+ (1,0) [0|1] "" IHU
 SG_ FltOfStopLampDrv : 291|1@0+ (1,0) [0|1] "" IHU
 SG_ FltOfStopLampDrv_UB : 290|1@0+ (1,0) [0|1] "" IHU
 SG_ FltOfStopLampPass : 289|1@0+ (1,0) [0|1] "" IHU
 SG_ FltOfStopLampPass_UB : 288|1@0+ (1,0) [0|1] "" IHU
 SG_ FrLeReadLiReq : 479|8@0+ (1.0,0.0) [0.0|100.0] "%" IHU
 SG_ FrLeReadLiReq_UB : 511|1@0+ (1,0) [0|1] "" IHU
 SG_ FrRiReadLiReq : 487|8@0+ (1.0,0.0) [0.0|100.0] "%" IHU
 SG_ FrRiReadLiReq_UB : 510|1@0+ (1,0) [0|1] "" IHU
 SG_ HornSwitchSts : 221|1@0+ (1,0) [0|1] "" IHU
 SG_ HornSwitchSts_UB : 220|1@0+ (1,0) [0|1] "" IHU
 SG_ HvActvForVehModReq : 147|1@0+ (1,0) [0|1] "" IHU
 SG_ HvActvForVehModReq_UB : 120|1@0+ (1,0) [0|1] "" IHU
 SG_ HvActvSts : 146|2@0+ (1,0) [0|3] "" IHU
 SG_ HvActvSts_UB : 144|1@0+ (1,0) [0|1] "" IHU
 SG_ HvCoolgPwrAllwd : 119|10@0+ (20.0,0.0) [0.0|20460.0] "W" IHU
 SG_ HvCoolgPwrAllwd_UB : 125|1@0+ (1,0) [0|1] "" IHU
 SG_ HvHeatgPwrAllwd : 143|10@0+ (20.0,0.0) [0.0|20460.0] "W" IHU
 SG_ HvHeatgPwrAllwd_UB : 149|1@0+ (1,0) [0|1] "" IHU
 SG_ HwRowFrstDrvrFrntHeiMotCtrl : 135|2@0+ (1,0) [0|3] "" IHU
 SG_ HwRowFrstDrvrFrntHeiMotCtrl_UB : 148|1@0+ (1,0) [0|1] "" IHU
 SG_ HwRowFrstDrvrHeiMotCtrl : 133|2@0+ (1,0) [0|3] "" IHU
 SG_ HwRowFrstDrvrHeiMotCtrl_UB : 123|1@0+ (1,0) [0|1] "" IHU
 SG_ HwRowFrstDrvrInclMotCtrl : 131|2@0+ (1,0) [0|3] "" IHU
 SG_ HwRowFrstDrvrInclMotCtrl_UB : 122|1@0+ (1,0) [0|1] "" IHU
 SG_ HwRowFrstDrvrSldMotCtrl : 129|2@0+ (1,0) [0|3] "" IHU
 SG_ HwRowFrstDrvrSldMotCtrl_UB : 121|1@0+ (1,0) [0|1] "" IHU
 SG_ IndicatorIntensityLvl : 95|8@0+ (1.0,0.0) [0.0|100.0] "%" IHU
 SG_ IndicatorIntensityLvl_UB : 80|1@0+ (1,0) [0|1] "" IHU
 SG_ IntLightTreadPlateSupply : 103|7@0+ (1.0,0.0) [0.0|100.0] "Unitless" IHU
 SG_ IntLightTreadPlateSupply_UB : 96|1@0+ (1,0) [0|1] "" IHU
 SG_ IntrBriStsFromIf : 507|4@0+ (1.0,0.0) [0.0|15.0] "Unitless" IHU
 SG_ IntrBriStsFromIf_UB : 437|1@0+ (1,0) [0|1] "" IHU
 SG_ IntrLiRoofAUTOIndication : 82|1@0+ (1,0) [0|1] "" IHU
 SG_ IntrLiRoofAUTOIndication_UB : 81|1@0+ (1,0) [0|1] "" IHU
 SG_ IntrMirrCmd_UB : 347|1@0+ (1,0) [0|1] "" IHU
 SG_ IntrMirrCmdDrvrSide : 335|1@0+ (1,0) [0|1] "" IHU
 SG_ IntrMirrCmdIntrMirrAsyFanCmpMag : 334|1@0+ (1,0) [0|1] "" IHU
 SG_ IntrMirrCmdIntrMirrDiagcRst : 333|1@0+ (1,0) [0|1] "" IHU
 SG_ IntrMirrCmdIntrMirrDimSnvty : 332|2@0+ (1,0) [0|3] "" IHU
 SG_ IntrMirrCmdIntrMirrEna : 330|1@0+ (1,0) [0|1] "" IHU
 SG_ IntrMirrCmdIntrMirrInhbDim : 329|1@0+ (1,0) [0|1] "" IHU
 SG_ IntrMirrCmdIntrMirrWindHeatrCmpMag : 328|1@0+ (1,0) [0|1] "" IHU
 SG_ LatCtrlModCfmd_UB : 216|1@0+ (1,0) [0|1] "" IHU
 SG_ LatCtrlModCfmdChks : 239|8@0+ (1.0,0.0) [0.0|255.0] "Unitless" IHU
 SG_ LatCtrlModCfmdCntr : 247|4@0+ (1.0,0.0) [0.0|15.0] "Unitless" IHU
 SG_ LatCtrlModCfmdLatCtrlMod : 243|4@0+ (1,0) [0|15] "" IHU
 SG_ MirrDefrstAtDrvrCmd : 346|1@0+ (1,0) [0|1] "" IHU
 SG_ MirrDefrstAtDrvrCmd_UB : 345|1@0+ (1,0) [0|1] "" IHU
 SG_ MirrSeldIndcn : 308|2@0+ (1,0) [0|3] "" IHU
 SG_ MirrSeldIndcn_UB : 310|1@0+ (1,0) [0|1] "" IHU
 SG_ PanicAlrmAcoustReq : 207|8@0+ (1,0) [0|255] "" IHU
 SG_ PanicAlrmAcoustReq_UB : 223|1@0+ (1,0) [0|1] "" IHU
 SG_ PanicAlrmToExtrLiVisReq : 215|8@0+ (1,0) [0|255] "" IHU
 SG_ PanicAlrmToExtrLiVisReq_UB : 222|1@0+ (1,0) [0|1] "" IHU
 SG_ PropsEnabfromAlcoLock : 219|1@0+ (1,0) [0|1] "" IHU
 SG_ PropsEnabfromAlcoLock_UB : 218|1@0+ (1,0) [0|1] "" IHU
 SG_ PtActvnReq1WdPtActvnReq : 273|2@0+ (1,0) [0|3] "" IHU
 SG_ PtActvnReq1WdPtActvnReq_UB : 309|1@0+ (1,0) [0|1] "" IHU
 SG_ PwrCnsVisy : 159|11@0+ (1.0,0.0) [0.0|2047.0] "W" IHU
 SG_ PwrCnsVisy_UB : 164|1@0+ (1,0) [0|1] "" IHU
 SG_ PwrCritDesVisy : 162|11@0+ (1.0,0.0) [0.0|2047.0] "W" IHU
 SG_ PwrCritDesVisy_UB : 163|1@0+ (1,0) [0|1] "" IHU
 SG_ PwrEstimdAtStbForVisy : 183|11@0+ (1.0,0.0) [0.0|2047.0] "W" IHU
 SG_ PwrEstimdAtStbForVisy_UB : 188|1@0+ (1,0) [0|1] "" IHU
 SG_ PwrNormDesVisy : 186|11@0+ (1.0,0.0) [0.0|2047.0] "W" IHU
 SG_ PwrNormDesVisy_UB : 187|1@0+ (1,0) [0|1] "" IHU
 SG_ RainSensActvn : 410|1@0+ (1,0) [0|1] "" IHU
 SG_ RainSensActvn_UB : 409|1@0+ (1,0) [0|1] "" IHU
 SG_ RainSnsrSnvtyForUsrSnvty_UB : 411|1@0+ (1,0) [0|1] "" IHU
 SG_ RainSnsrSnvtyForUsrSnvty0 : 391|4@0+ (1.0,0.0) [0.0|15.0] "Unitless" IHU
 SG_ RainSnsrSnvtyForUsrSnvty1 : 387|4@0+ (1.0,0.0) [0.0|15.0] "Unitless" IHU
 SG_ RainSnsrSnvtyForUsrSnvty2 : 399|4@0+ (1.0,0.0) [0.0|15.0] "Unitless" IHU
 SG_ RainSnsrSnvtyForUsrSnvty3 : 395|4@0+ (1.0,0.0) [0.0|15.0] "Unitless" IHU
 SG_ RainSnsrSnvtyForUsrSnvty4 : 407|4@0+ (1.0,0.0) [0.0|15.0] "Unitless" IHU
 SG_ RainSnsrSnvtyForUsrSnvty5 : 403|4@0+ (1.0,0.0) [0.0|15.0] "Unitless" IHU
 SG_ RainSnsrSnvtyForUsrSnvty6 : 415|4@0+ (1.0,0.0) [0.0|15.0] "Unitless" IHU
 SG_ ReAdaptReq : 253|1@0+ (1,0) [0|1] "" IHU
 SG_ ReAdaptReq_UB : 252|1@0+ (1,0) [0|1] "" IHU
 SG_ RelHumSnsrErr : 303|1@0+ (1,0) [0|1] "" IHU
 SG_ RelHumSnsrErr_UB : 296|1@0+ (1,0) [0|1] "" IHU
 SG_ RemStrtMsgToDrvr_UB : 311|1@0+ (1,0) [0|1] "" IHU
 SG_ RemStrtMsgToDrvrRemStrtBlkd1 : 302|4@0+ (1,0) [0|15] "" IHU
 SG_ RemStrtMsgToDrvrRemStrtDev1 : 298|2@0+ (1,0) [0|3] "" IHU
 SG_ RlyActvnForRoofCurtClsAut : 368|1@0+ (1,0) [0|1] "" IHU
 SG_ RlyActvnForRoofCurtClsAut_UB : 376|1@0+ (1,0) [0|1] "" IHU
 SG_ SecRowLeReadLiReq : 495|8@0+ (1.0,0.0) [0.0|100.0] "%" IHU
 SG_ SecRowLeReadLiReq_UB : 509|1@0+ (1,0) [0|1] "" IHU
 SG_ SecRowRiReadLiReq : 503|8@0+ (1.0,0.0) [0.0|100.0] "%" IHU
 SG_ SecRowRiReadLiReq_UB : 508|1@0+ (1,0) [0|1] "" IHU
 SG_ SteerLockEnagOfPrpsn : 425|2@0+ (1,0) [0|3] "" IHU
 SG_ SteerLockEnagOfPrpsn_UB : 432|1@0+ (1,0) [0|1] "" IHU
 SG_ SteerWhlTqAddl : 319|14@0- (0.00390625,0.0) [-30.0|30.0] "NewtonMeter" IHU
 SG_ SteerWhlTqAddl_UB : 377|1@0+ (1,0) [0|1] "" IHU
 SG_ StsOfLedHiBeamLe : 306|2@0+ (1,0) [0|3] "" IHU
 SG_ StsOfLedHiBeamLe_UB : 304|1@0+ (1,0) [0|1] "" IHU
 SG_ StsOfLedHiBeamRi : 321|2@0+ (1,0) [0|3] "" IHU
 SG_ StsOfLedHiBeamRi_UB : 408|1@0+ (1,0) [0|1] "" IHU
 SG_ StsOfLedLoBeamLe : 343|2@0+ (1,0) [0|3] "" IHU
 SG_ StsOfLedLoBeamLe_UB : 417|1@0+ (1,0) [0|1] "" IHU
 SG_ StsOfLedLoBeamRi : 341|2@0+ (1,0) [0|3] "" IHU
 SG_ StsOfLedLoBeamRi_UB : 431|1@0+ (1,0) [0|1] "" IHU
 SG_ StsOfSwvlgLe : 339|2@0+ (1,0) [0|3] "" IHU
 SG_ StsOfSwvlgLe_UB : 429|1@0+ (1,0) [0|1] "" IHU
 SG_ StsOfSwvlgRi : 337|2@0+ (1,0) [0|3] "" IHU
 SG_ StsOfSwvlgRi_UB : 416|1@0+ (1,0) [0|1] "" IHU
 SG_ SunCurtEna : 353|2@0+ (1,0) [0|3] "" IHU
 SG_ SunCurtEna_UB : 354|1@0+ (1,0) [0|1] "" IHU
 SG_ SunRoofAndCurtExtCmd : 359|4@0+ (1,0) [0|15] "" IHU
 SG_ SunRoofAndCurtExtCmd_UB : 355|1@0+ (1,0) [0|1] "" IHU
 SG_ SwtBeamHi : 351|2@0+ (1,0) [0|3] "" IHU
 SG_ SwtBeamHi_UB : 430|1@0+ (1,0) [0|1] "" IHU
 SG_ SwtLiHzrdWarn : 349|1@0+ (1,0) [0|1] "" IHU
 SG_ SwtLiHzrdWarn_UB : 428|1@0+ (1,0) [0|1] "" IHU
 SG_ TankFlapReqFromSwtIntrFild : 348|1@0+ (1,0) [0|1] "" IHU
 SG_ TankFlapReqFromSwtIntrFild_UB : 427|1@0+ (1,0) [0|1] "" IHU
 SG_ TrOpenerReq_UB : 426|1@0+ (1,0) [0|1] "" IHU
 SG_ TrOpenerReqTrigSrc : 383|3@0+ (1,0) [0|7] "" IHU
 SG_ TrOpenerReqTrOpenerReq : 380|3@0+ (1,0) [0|7] "" IHU
 SG_ TrsmParkLockSt : 371|2@0+ (1,0) [0|3] "" IHU
 SG_ TrsmParkLockSt_UB : 438|1@0+ (1,0) [0|1] "" IHU
 SG_ TrsmTqRat : 367|12@0+ (0.01,0.0) [0.0|40.95] "Unitless" IHU
 SG_ TrsmTqRat_UB : 436|1@0+ (1,0) [0|1] "" IHU
 SG_ WiprActv : 344|1@0+ (1,0) [0|1] "" IHU
 SG_ WiprActv_UB : 435|1@0+ (1,0) [0|1] "" IHU
 SG_ WiprInWipgAr : 369|1@0+ (1,0) [0|1] "" IHU
 SG_ WiprInWipgAr_UB : 434|1@0+ (1,0) [0|1] "" IHU
 SG_ WiprMotFrntLvrCmdSafe_UB : 433|1@0+ (1,0) [0|1] "" IHU
 SG_ WiprMotFrntLvrCmdSafeLvrInHiSpdPosnSafe : 423|2@0+ (1,0) [0|3] "" IHU
 SG_ WiprMotFrntLvrCmdSafeLvrInIntlPosn : 421|1@0+ (1,0) [0|1] "" IHU
 SG_ WiprMotFrntLvrCmdSafeLvrInLoSpdPosnSafe : 420|2@0+ (1,0) [0|3] "" IHU
 SG_ WiprMotFrntLvrCmdSafeLvrInSnglStrokePos : 418|1@0+ (1,0) [0|1] "" IHU

BO_ 81 ZCUDZCUCANFD2Fr21 : 64 ZCUD
 SG_ ClsdDueToRain : 307|1@0+ (1,0) [0|1] "" IHU
 SG_ ClsdDueToRain_UB : 76|1@0+ (1,0) [0|1] "" IHU
 SG_ DKDataFromCEM_UB : 75|1@0+ (1,0) [0|1] "" IHU
 SG_ DKDataFromCEMAcknowledgment : 391|8@0+ (1.0,0.0) [0.0|255.0] "Unitless" IHU
 SG_ DKDataFromCEMDKDataByte1 : 399|8@0+ (1.0,0.0) [0.0|255.0] "Unitless" IHU
 SG_ DKDataFromCEMDKDataByte2 : 407|8@0+ (1.0,0.0) [0.0|255.0] "Unitless" IHU
 SG_ DKDataFromCEMDKDataByte3 : 415|8@0+ (1.0,0.0) [0.0|255.0] "Unitless" IHU
 SG_ DKDataFromCEMDKDataByte4 : 423|8@0+ (1.0,0.0) [0.0|255.0] "Unitless" IHU
 SG_ DKDataFromCEMDKDataByte5 : 431|8@0+ (1.0,0.0) [0.0|255.0] "Unitless" IHU
 SG_ DKDataFromCEMDKDataByte6 : 439|8@0+ (1.0,0.0) [0.0|255.0] "Unitless" IHU
 SG_ DKDataFromCEMHeader : 447|8@0+ (1.0,0.0) [0.0|255.0] "Unitless" IHU

BO_ 659 ZCUDZCUCANFD2Fr23 : 64 ZCUD
 SG_ AcCmprVlvICns : 191|8@0+ (0.05,0.0) [0.0|12.600000000000001] "A" Vector__XXX
 SG_ AcCmprVlvICns_UB : 180|1@0+ (1,0) [0|1] "" Vector__XXX
 SG_ DiagFrameForECM_UB : 174|1@0+ (1,0) [0|1] "" IHU,ZCUP
 SG_ DiagFrameForECMByte0 : 263|8@0+ (1.0,0.0) [0.0|255.0] "Unitless" IHU,ZCUP
 SG_ DiagFrameForECMByte1 : 271|8@0+ (1.0,0.0) [0.0|255.0] "Unitless" IHU,ZCUP
 SG_ DiagFrameForECMByte2 : 279|8@0+ (1.0,0.0) [0.0|255.0] "Unitless" IHU,ZCUP
 SG_ DiagFrameForECMByte3 : 287|8@0+ (1.0,0.0) [0.0|255.0] "Unitless" IHU,ZCUP
 SG_ DiagFrameForECMByte4 : 295|8@0+ (1.0,0.0) [0.0|255.0] "Unitless" IHU,ZCUP
 SG_ DiagFrameForECMByte5 : 303|8@0+ (1.0,0.0) [0.0|255.0] "Unitless" IHU,ZCUP
 SG_ DiagFrameForECMByte6 : 311|8@0+ (1.0,0.0) [0.0|255.0] "Unitless" IHU,ZCUP
 SG_ DiagFrameForECMByte7 : 319|8@0+ (1.0,0.0) [0.0|255.0] "Unitless" IHU,ZCUP
 SG_ DstEstimdToEmptyForDrvgElecPred : 327|10@0+ (1.0,0.0) [0.0|1023.0] "KiloMtr" IHU
 SG_ DstEstimdToEmptyForDrvgElecPred_UB : 181|1@0+ (1,0) [0|1] "" IHU
 SG_ EngAmbTCalcd : 400|9@0+ (0.5,-60.0) [-60.0|195.5] "Unitless" IHU
 SG_ EngAmbTCalcd_UB : 401|1@0+ (1,0) [0|1] "" IHU
 SG_ HeatrPmpIAct : 351|8@0+ (0.2,0.0) [0.0|50.800000000000004] "A" IHU
 SG_ HeatrPmpIAct_UB : 333|1@0+ (1,0) [0|1] "" IHU
 SG_ HeatrPmpPwrCns : 331|12@0+ (1.0,0.0) [0.0|4095.0] "W" IHU
 SG_ HeatrPmpPwrCns_UB : 332|1@0+ (1,0) [0|1] "" IHU
 SG_ HeatrPmpUAct : 359|8@0+ (0.1,0.0) [0.0|25.0] "Volt" IHU
 SG_ HeatrPmpUAct_UB : 219|1@0+ (1,0) [0|1] "" IHU
 SG_ HvBattPmpPwrCns : 199|12@0+ (1.0,0.0) [0.0|4095.0] "W" IHU
 SG_ HvBattPmpPwrCns_UB : 160|1@0+ (1,0) [0|1] "" IHU
 SG_ HvBattThermInfoCorrInFuture_UB : 218|1@0+ (1,0) [0|1] "" IHU
 SG_ HvBattThermInfoCorrInFuturePwrAtTime : 367|16@0+ (50.0,-25000.0) [-25000.0|25000.0] "W" IHU
 SG_ HvBattThermInfoCorrInFutureSequenceNo : 383|5@0+ (1.0,0.0) [0.0|31.0] "Unitless" IHU
 SG_ HvBattThermInfoCorrInFutureTempAtTime : 391|8@0+ (1.0,-50.0) [-50.0|205.0] "degC" IHU
 SG_ HvBattThermInfoCorrInFutureThermModAtTime : 378|3@0+ (1,0) [0|7] "" IHU
 SG_ HvBattThermInfoCorrInFutureTime : 399|8@0+ (1.0,0.0) [0.0|255.0] "Unitless" IHU
 SG_ HvBattThermInfoCorrInFutureVersionNo : 407|3@0+ (1.0,0.0) [0.0|7.0] "Unitless" IHU
 SG_ HvWtrHeatrWtrTDes : 215|8@0+ (1.0,-40.0) [-40.0|215.0] "degC" IHU
 SG_ HvWtrHeatrWtrTDes_UB : 161|1@0+ (1,0) [0|1] "" IHU
 SG_ IsgCooltFlowMinReq2 : 247|10@0+ (0.02,0.0) [0.0|20.46] "L / min" Vector__XXX
 SG_ IsgCooltFlowMinReq2_UB : 153|1@0+ (1,0) [0|1] "" Vector__XXX
 SG_ IsgHeatPwrAct : 423|8@0+ (50.0,0.0) [0.0|12750.0] "W" IHU
 SG_ IsgHeatPwrAct_UB : 217|1@0+ (1,0) [0|1] "" IHU
 SG_ IsgHeatPwrMax : 431|8@0+ (50.0,0.0) [0.0|12750.0] "W" IHU
 SG_ IsgHeatPwrMax_UB : 216|1@0+ (1,0) [0|1] "" IHU
 SG_ LiBattInPWLock : 404|1@0+ (1,0) [0|1] "" IHU
 SG_ LiBattInPWLock_UB : 403|1@0+ (1,0) [0|1] "" IHU
 SG_ PrpsnDataPrdA_UB : 7|1@0+ (1,0) [0|1] "" Vector__XXX
 SG_ PrpsnDataPrdACnt : 6|7@0+ (1.0,0.0) [0.0|127.0] "Unitless" Vector__XXX
 SG_ PrpsnDataPrdAData1 : 15|8@0+ (1.0,0.0) [0.0|255.0] "Unitless" Vector__XXX
 SG_ PrpsnDataPrdAData2 : 23|8@0+ (1.0,0.0) [0.0|255.0] "Unitless" Vector__XXX
 SG_ PrpsnDataPrdAData3 : 31|8@0+ (1.0,0.0) [0.0|255.0] "Unitless" Vector__XXX
 SG_ PrpsnDataPrdAData4 : 39|8@0+ (1.0,0.0) [0.0|255.0] "Unitless" Vector__XXX
 SG_ PrpsnDataPrdAData5 : 47|8@0+ (1.0,0.0) [0.0|255.0] "Unitless" Vector__XXX
 SG_ PrpsnDataPrdAData6 : 55|8@0+ (1.0,0.0) [0.0|255.0] "Unitless" Vector__XXX
 SG_ PrpsnDataPrdAData7 : 63|8@0+ (1.0,0.0) [0.0|255.0] "Unitless" Vector__XXX
 SG_ PrpsnDataPrdB_UB : 71|1@0+ (1,0) [0|1] "" Vector__XXX
 SG_ PrpsnDataPrdBCnt : 70|7@0+ (1.0,0.0) [0.0|127.0] "Unitless" Vector__XXX
 SG_ PrpsnDataPrdBData1 : 79|8@0+ (1.0,0.0) [0.0|255.0] "Unitless" Vector__XXX
 SG_ PrpsnDataPrdBData2 : 87|8@0+ (1.0,0.0) [0.0|255.0] "Unitless" Vector__XXX
 SG_ PrpsnDataPrdBData3 : 95|8@0+ (1.0,0.0) [0.0|255.0] "Unitless" Vector__XXX
 SG_ PrpsnDataPrdBData4 : 103|8@0+ (1.0,0.0) [0.0|255.0] "Unitless" Vector__XXX
 SG_ PrpsnDataPrdBData5 : 111|8@0+ (1.0,0.0) [0.0|255.0] "Unitless" Vector__XXX
 SG_ PrpsnDataPrdBData6 : 119|8@0+ (1.0,0.0) [0.0|255.0] "Unitless" Vector__XXX
 SG_ PrpsnDataPrdBData7 : 127|8@0+ (1.0,0.0) [0.0|255.0] "Unitless" Vector__XXX
 SG_ PtCoolgPostRunActv : 145|1@0+ (1,0) [0|1] "" IHU
 SG_ PtCoolgPostRunActv_UB : 169|1@0+ (1,0) [0|1] "" IHU
 SG_ PtTotBrkTqReq_UB : 182|1@0+ (1,0) [0|1] "" IHU
 SG_ PtTotBrkTqReqPtTotBrkTqEna : 231|1@0+ (1,0) [0|1] "" IHU
 SG_ PtTotBrkTqReqPtTotBrkTqReq : 230|15@0- (1.0,0.0) [-16384.0|16380.0] "NewtonMeter" IHU
 SG_ RainSnsrActvnErrToHmi : 144|1@0+ (1,0) [0|1] "" IHU
 SG_ RainSnsrActvnErrToHmi_UB : 170|1@0+ (1,0) [0|1] "" IHU
 SG_ ResrvdSigForCCM1 : 439|8@0+ (1.0,0.0) [0.0|255.0] "Unitless" IHU,ZCUP
 SG_ ResrvdSigForCCM1_UB : 146|1@0+ (1,0) [0|1] "" IHU,ZCUP
 SG_ ResrvdSigForCCM2 : 447|8@0+ (1.0,0.0) [0.0|255.0] "Unitless" IHU,ZCUP
 SG_ ResrvdSigForCCM2_UB : 147|1@0+ (1,0) [0|1] "" IHU,ZCUP
 SG_ ResrvdSigForCCM3 : 455|16@0+ (1.0,0.0) [0.0|65535.0] "Unitless" IHU,ZCUP
 SG_ ResrvdSigForCCM3_UB : 148|1@0+ (1,0) [0|1] "" IHU,ZCUP
 SG_ ResrvdSigForCCM4 : 471|16@0+ (1.0,0.0) [0.0|65535.0] "Unitless" IHU,ZCUP
 SG_ ResrvdSigForCCM4_UB : 149|1@0+ (1,0) [0|1] "" IHU,ZCUP
 SG_ StandStillReqForCmftToBrkgForEPedl : 150|1@0+ (1,0) [0|1] "" IHU
 SG_ StandStillReqForCmftToBrkgForEPedl_UB : 253|1@0+ (1,0) [0|1] "" IHU
 SG_ SteerLockMgrWarnIndcn : 158|3@0+ (1,0) [0|7] "" IHU
 SG_ SteerLockMgrWarnIndcn_UB : 172|1@0+ (1,0) [0|1] "" IHU
 SG_ StrtRemSts1WdStrtRemSts : 155|2@0+ (1,0) [0|3] "" IHU,ZCUP
 SG_ StrtRemSts1WdStrtRemSts_UB : 173|1@0+ (1,0) [0|1] "" IHU,ZCUP
 SG_ VehPropSts : 152|1@0+ (1,0) [0|1] "" IHU
 SG_ VehPropSts_UB : 176|1@0+ (1,0) [0|1] "" IHU
 SG_ WiprSysFailrDetdSafe : 164|2@0+ (1,0) [0|3] "" IHU
 SG_ WiprSysFailrDetdSafe_UB : 178|1@0+ (1,0) [0|1] "" IHU
 SG_ WshrFldTankStsToHMI : 162|1@0+ (1,0) [0|1] "" IHU
 SG_ WshrFldTankStsToHMI_UB : 179|1@0+ (1,0) [0|1] "" IHU

BO_ 569 ZCUDZCUCANFD2Fr24 : 64 ZCUD
 SG_ ConvPwrRelsForb_UB : 219|1@0+ (1,0) [0|1] "" IHU
 SG_ ConvPwrRelsForbRelsFrbn1 : 187|1@0+ (1,0) [0|1] "" IHU
 SG_ ConvPwrRelsForbRelsMtnFrbn : 186|1@0+ (1,0) [0|1] "" IHU
 SG_ HeatrPmpStat_UB : 58|1@0+ (1,0) [0|1] "" IHU
 SG_ HeatrPmpStatCooltPmpDryErr : 7|2@0+ (1,0) [0|3] "" IHU
 SG_ HeatrPmpStatCooltPmpEmgyModSts : 5|2@0+ (1,0) [0|3] "" IHU
 SG_ HeatrPmpStatCooltPmpErrSts : 3|2@0+ (1,0) [0|3] "" IHU
 SG_ HeatrPmpStatCooltPmpI : 23|8@0+ (0.2,0.0) [0.0|50.800000000000004] "A" IHU
 SG_ HeatrPmpStatCooltPmpIErr : 1|2@0+ (1,0) [0|3] "" IHU
 SG_ HeatrPmpStatCooltPmpMonrSpd : 15|2@0+ (1,0) [0|3] "" IHU
 SG_ HeatrPmpStatCooltPmpPostRunSts : 13|2@0+ (1,0) [0|3] "" IHU
 SG_ HeatrPmpStatCooltPmpSetPostRunReq : 63|3@0+ (1,0) [0|7] "" IHU
 SG_ HeatrPmpStatCooltPmpSetSpdReq : 31|8@0+ (1.0,0.0) [0.0|254.0] "Unitless" IHU
 SG_ HeatrPmpStatCooltPmpSpd : 39|8@0+ (1.0,0.0) [0.0|254.0] "Unitless" IHU
 SG_ HeatrPmpStatCooltPmpT : 47|8@0+ (1.0,-50.0) [-50.0|200.0] "degC" IHU
 SG_ HeatrPmpStatCooltPmpTErr : 11|2@0+ (1,0) [0|3] "" IHU
 SG_ HeatrPmpStatCooltPmpU : 55|8@0+ (0.1,0.0) [0.0|25.0] "Volt" IHU
 SG_ HeatrPmpStatCooltPmpUErr : 9|2@0+ (1,0) [0|3] "" IHU
 SG_ HeatrPmpStatCooltPmpUnstallSts : 60|2@0+ (1,0) [0|3] "" IHU

BO_ 82 ZCUDZCUCANFD2Fr25 : 64 ZCUD
 SG_ NFCAndBLEKeyDiReq_UB : 504|1@0+ (1,0) [0|1] "" IHU
 SG_ NFCAndBLEKeyDiReqData1 : 7|8@0+ (1.0,0.0) [0.0|255.0] "Unitless" IHU
 SG_ NFCAndBLEKeyDiReqData10 : 15|8@0+ (1.0,0.0) [0.0|255.0] "Unitless" IHU
 SG_ NFCAndBLEKeyDiReqData11 : 23|8@0+ (1.0,0.0) [0.0|255.0] "Unitless" IHU
 SG_ NFCAndBLEKeyDiReqData12 : 31|8@0+ (1.0,0.0) [0.0|255.0] "Unitless" IHU
 SG_ NFCAndBLEKeyDiReqData13 : 39|8@0+ (1.0,0.0) [0.0|255.0] "Unitless" IHU
 SG_ NFCAndBLEKeyDiReqData14 : 47|8@0+ (1.0,0.0) [0.0|255.0] "Unitless" IHU
 SG_ NFCAndBLEKeyDiReqData15 : 55|8@0+ (1.0,0.0) [0.0|255.0] "Unitless" IHU
 SG_ NFCAndBLEKeyDiReqData16 : 63|8@0+ (1.0,0.0) [0.0|255.0] "Unitless" IHU
 SG_ NFCAndBLEKeyDiReqData2 : 71|8@0+ (1.0,0.0) [0.0|255.0] "Unitless" IHU
 SG_ NFCAndBLEKeyDiReqData3 : 79|8@0+ (1.0,0.0) [0.0|255.0] "Unitless" IHU
 SG_ NFCAndBLEKeyDiReqData4 : 87|8@0+ (1.0,0.0) [0.0|255.0] "Unitless" IHU
 SG_ NFCAndBLEKeyDiReqData5 : 95|8@0+ (1.0,0.0) [0.0|255.0] "Unitless" IHU
 SG_ NFCAndBLEKeyDiReqData6 : 103|8@0+ (1.0,0.0) [0.0|255.0] "Unitless" IHU
 SG_ NFCAndBLEKeyDiReqData7 : 111|8@0+ (1.0,0.0) [0.0|255.0] "Unitless" IHU
 SG_ NFCAndBLEKeyDiReqData8 : 119|8@0+ (1.0,0.0) [0.0|255.0] "Unitless" IHU
 SG_ NFCAndBLEKeyDiReqData9 : 127|8@0+ (1.0,0.0) [0.0|255.0] "Unitless" IHU
 SG_ NFCKeySearchReq_UB : 505|1@0+ (1,0) [0|1] "" IHU
 SG_ NFCKeySearchReqKeyLocn : 135|4@0+ (1,0) [0|15] "" IHU
 SG_ NFCKeySearchReqTirgger : 131|4@0+ (1,0) [0|15] "" IHU

BO_ 52 ZCUDZCUCANFD2Fr26 : 64 ZCUD
 SG_ BodyDataTraceZCUDM1_UB : 511|1@0+ (1,0) [0|1] "" IHU,ZCUP
 SG_ BodyDataTraceZCUDM1Functiondevpsignalgroup1 : 7|8@0+ (1.0,0.0) [0.0|255.0] "Unitless" IHU,ZCUP
 SG_ BodyDataTraceZCUDM1Functiondevpsignalgroup2 : 15|8@0+ (1.0,0.0) [0.0|255.0] "Unitless" IHU,ZCUP
 SG_ BodyDataTraceZCUDM1Functiondevpsignalgroup3 : 23|8@0+ (1.0,0.0) [0.0|255.0] "Unitless" IHU,ZCUP
 SG_ BodyDataTraceZCUDM1Functiondevpsignalgroup4 : 31|8@0+ (1.0,0.0) [0.0|255.0] "Unitless" IHU,ZCUP
 SG_ BodyDataTraceZCUDM1Functiondevpsignalgroup5 : 39|8@0+ (1.0,0.0) [0.0|255.0] "Unitless" IHU,ZCUP
 SG_ BodyDataTraceZCUDM1Functiondevpsignalgroup6 : 47|8@0+ (1.0,0.0) [0.0|255.0] "Unitless" IHU,ZCUP
 SG_ BodyDataTraceZCUDM1Functiondevpsignalgroup7 : 55|8@0+ (1.0,0.0) [0.0|255.0] "Unitless" IHU,ZCUP
 SG_ BodyDataTraceZCUDM1Functiondevpsignalgroup8 : 63|8@0+ (1.0,0.0) [0.0|255.0] "Unitless" IHU,ZCUP
 SG_ BodyDataTraceZCUDM2_UB : 510|1@0+ (1,0) [0|1] "" IHU,ZCUP
 SG_ BodyDataTraceZCUDM2Functiondevpsignalgroup1 : 71|8@0+ (1.0,0.0) [0.0|255.0] "Unitless" IHU,ZCUP
 SG_ BodyDataTraceZCUDM2Functiondevpsignalgroup2 : 79|8@0+ (1.0,0.0) [0.0|255.0] "Unitless" IHU,ZCUP
 SG_ BodyDataTraceZCUDM2Functiondevpsignalgroup3 : 87|8@0+ (1.0,0.0) [0.0|255.0] "Unitless" IHU,ZCUP
 SG_ BodyDataTraceZCUDM2Functiondevpsignalgroup4 : 95|8@0+ (1.0,0.0) [0.0|255.0] "Unitless" IHU,ZCUP
 SG_ BodyDataTraceZCUDM2Functiondevpsignalgroup5 : 103|8@0+ (1.0,0.0) [0.0|255.0] "Unitless" IHU,ZCUP
 SG_ BodyDataTraceZCUDM2Functiondevpsignalgroup6 : 111|8@0+ (1.0,0.0) [0.0|255.0] "Unitless" IHU,ZCUP
 SG_ BodyDataTraceZCUDM2Functiondevpsignalgroup7 : 119|8@0+ (1.0,0.0) [0.0|255.0] "Unitless" IHU,ZCUP
 SG_ BodyDataTraceZCUDM2Functiondevpsignalgroup8 : 127|8@0+ (1.0,0.0) [0.0|255.0] "Unitless" IHU,ZCUP
 SG_ BodyDataTraceZCUDM3_UB : 509|1@0+ (1,0) [0|1] "" IHU,ZCUP
 SG_ BodyDataTraceZCUDM3Functiondevpsignalgroup1 : 135|8@0+ (1.0,0.0) [0.0|255.0] "Unitless" IHU,ZCUP
 SG_ BodyDataTraceZCUDM3Functiondevpsignalgroup2 : 143|8@0+ (1.0,0.0) [0.0|255.0] "Unitless" IHU,ZCUP
 SG_ BodyDataTraceZCUDM3Functiondevpsignalgroup3 : 151|8@0+ (1.0,0.0) [0.0|255.0] "Unitless" IHU,ZCUP
 SG_ BodyDataTraceZCUDM3Functiondevpsignalgroup4 : 159|8@0+ (1.0,0.0) [0.0|255.0] "Unitless" IHU,ZCUP
 SG_ BodyDataTraceZCUDM3Functiondevpsignalgroup5 : 167|8@0+ (1.0,0.0) [0.0|255.0] "Unitless" IHU,ZCUP
 SG_ BodyDataTraceZCUDM3Functiondevpsignalgroup6 : 175|8@0+ (1.0,0.0) [0.0|255.0] "Unitless" IHU,ZCUP
 SG_ BodyDataTraceZCUDM3Functiondevpsignalgroup7 : 183|8@0+ (1.0,0.0) [0.0|255.0] "Unitless" IHU,ZCUP
 SG_ BodyDataTraceZCUDM3Functiondevpsignalgroup8 : 191|8@0+ (1.0,0.0) [0.0|255.0] "Unitless" IHU,ZCUP
 SG_ BodyDataTraceZCUDM4_UB : 508|1@0+ (1,0) [0|1] "" IHU,ZCUP
 SG_ BodyDataTraceZCUDM4Functiondevpsignalgroup1 : 199|8@0+ (1.0,0.0) [0.0|255.0] "Unitless" IHU,ZCUP
 SG_ BodyDataTraceZCUDM4Functiondevpsignalgroup2 : 207|8@0+ (1.0,0.0) [0.0|255.0] "Unitless" IHU,ZCUP
 SG_ BodyDataTraceZCUDM4Functiondevpsignalgroup3 : 215|8@0+ (1.0,0.0) [0.0|255.0] "Unitless" IHU,ZCUP
 SG_ BodyDataTraceZCUDM4Functiondevpsignalgroup4 : 223|8@0+ (1.0,0.0) [0.0|255.0] "Unitless" IHU,ZCUP
 SG_ BodyDataTraceZCUDM4Functiondevpsignalgroup5 : 231|8@0+ (1.0,0.0) [0.0|255.0] "Unitless" IHU,ZCUP
 SG_ BodyDataTraceZCUDM4Functiondevpsignalgroup6 : 239|8@0+ (1.0,0.0) [0.0|255.0] "Unitless" IHU,ZCUP
 SG_ BodyDataTraceZCUDM4Functiondevpsignalgroup7 : 247|8@0+ (1.0,0.0) [0.0|255.0] "Unitless" IHU,ZCUP
 SG_ BodyDataTraceZCUDM4Functiondevpsignalgroup8 : 255|8@0+ (1.0,0.0) [0.0|255.0] "Unitless" IHU,ZCUP
 SG_ BodyDataTraceZCUDM5_UB : 507|1@0+ (1,0) [0|1] "" IHU,ZCUP
 SG_ BodyDataTraceZCUDM5Functiondevpsignalgroup1 : 263|8@0+ (1.0,0.0) [0.0|255.0] "Unitless" IHU,ZCUP
 SG_ BodyDataTraceZCUDM5Functiondevpsignalgroup2 : 271|8@0+ (1.0,0.0) [0.0|255.0] "Unitless" IHU,ZCUP
 SG_ BodyDataTraceZCUDM5Functiondevpsignalgroup3 : 279|8@0+ (1.0,0.0) [0.0|255.0] "Unitless" IHU,ZCUP
 SG_ BodyDataTraceZCUDM5Functiondevpsignalgroup4 : 287|8@0+ (1.0,0.0) [0.0|255.0] "Unitless" IHU,ZCUP
 SG_ BodyDataTraceZCUDM5Functiondevpsignalgroup5 : 295|8@0+ (1.0,0.0) [0.0|255.0] "Unitless" IHU,ZCUP
 SG_ BodyDataTraceZCUDM5Functiondevpsignalgroup6 : 303|8@0+ (1.0,0.0) [0.0|255.0] "Unitless" IHU,ZCUP
 SG_ BodyDataTraceZCUDM5Functiondevpsignalgroup7 : 311|8@0+ (1.0,0.0) [0.0|255.0] "Unitless" IHU,ZCUP
 SG_ BodyDataTraceZCUDM5Functiondevpsignalgroup8 : 319|8@0+ (1.0,0.0) [0.0|255.0] "Unitless" IHU,ZCUP
 SG_ BodyDataTraceZCUDM6_UB : 506|1@0+ (1,0) [0|1] "" IHU,ZCUP
 SG_ BodyDataTraceZCUDM6Functiondevpsignalgroup1 : 327|8@0+ (1.0,0.0) [0.0|255.0] "Unitless" IHU,ZCUP
 SG_ BodyDataTraceZCUDM6Functiondevpsignalgroup2 : 335|8@0+ (1.0,0.0) [0.0|255.0] "Unitless" IHU,ZCUP
 SG_ BodyDataTraceZCUDM6Functiondevpsignalgroup3 : 343|8@0+ (1.0,0.0) [0.0|255.0] "Unitless" IHU,ZCUP
 SG_ BodyDataTraceZCUDM6Functiondevpsignalgroup4 : 351|8@0+ (1.0,0.0) [0.0|255.0] "Unitless" IHU,ZCUP
 SG_ BodyDataTraceZCUDM6Functiondevpsignalgroup5 : 359|8@0+ (1.0,0.0) [0.0|255.0] "Unitless" IHU,ZCUP
 SG_ BodyDataTraceZCUDM6Functiondevpsignalgroup6 : 367|8@0+ (1.0,0.0) [0.0|255.0] "Unitless" IHU,ZCUP
 SG_ BodyDataTraceZCUDM6Functiondevpsignalgroup7 : 375|8@0+ (1.0,0.0) [0.0|255.0] "Unitless" IHU,ZCUP
 SG_ BodyDataTraceZCUDM6Functiondevpsignalgroup8 : 383|8@0+ (1.0,0.0) [0.0|255.0] "Unitless" IHU,ZCUP
 SG_ BodyDataTraceZCUDM7_UB : 505|1@0+ (1,0) [0|1] "" IHU,ZCUP
 SG_ BodyDataTraceZCUDM7Functiondevpsignalgroup1 : 391|8@0+ (1.0,0.0) [0.0|255.0] "Unitless" IHU,ZCUP
 SG_ BodyDataTraceZCUDM7Functiondevpsignalgroup2 : 399|8@0+ (1.0,0.0) [0.0|255.0] "Unitless" IHU,ZCUP
 SG_ BodyDataTraceZCUDM7Functiondevpsignalgroup3 : 407|8@0+ (1.0,0.0) [0.0|255.0] "Unitless" IHU,ZCUP
 SG_ BodyDataTraceZCUDM7Functiondevpsignalgroup4 : 415|8@0+ (1.0,0.0) [0.0|255.0] "Unitless" IHU,ZCUP
 SG_ BodyDataTraceZCUDM7Functiondevpsignalgroup5 : 423|8@0+ (1.0,0.0) [0.0|255.0] "Unitless" IHU,ZCUP
 SG_ BodyDataTraceZCUDM7Functiondevpsignalgroup6 : 431|8@0+ (1.0,0.0) [0.0|255.0] "Unitless" IHU,ZCUP
 SG_ BodyDataTraceZCUDM7Functiondevpsignalgroup7 : 439|8@0+ (1.0,0.0) [0.0|255.0] "Unitless" IHU,ZCUP
 SG_ BodyDataTraceZCUDM7Functiondevpsignalgroup8 : 447|8@0+ (1.0,0.0) [0.0|255.0] "Unitless" IHU,ZCUP

BO_ 920 ZCUDZCUCANFD2Fr31 : 64 ZCUD
 SG_ AccPWMPerdTi : 167|16@0+ (1.0,0.0) [0.0|65535.0] "Unitless" IHU
 SG_ AccPWMPerdTi_UB : 158|1@0+ (1,0) [0|1] "" IHU
 SG_ ActnOfCenHiMntdStopLamp : 157|1@0+ (1,0) [0|1] "" IHU
 SG_ ActnOfCenHiMntdStopLamp_UB : 156|1@0+ (1,0) [0|1] "" IHU
 SG_ ActnOfCenHiMntdStopLamp1 : 155|1@0+ (1,0) [0|1] "" IHU
 SG_ ActnOfCenHiMntdStopLamp1_UB : 154|1@0+ (1,0) [0|1] "" IHU
 SG_ ActnOfDaytiRunngLampDrv : 153|1@0+ (1,0) [0|1] "" IHU
 SG_ ActnOfDaytiRunngLampDrv_UB : 152|1@0+ (1,0) [0|1] "" IHU
 SG_ ActnOfFrntFogLampDrv : 183|1@0+ (1,0) [0|1] "" IHU
 SG_ ActnOfFrntFogLampDrv_UB : 182|1@0+ (1,0) [0|1] "" IHU
 SG_ ActnOfFrntPosnLampDrv : 181|1@0+ (1,0) [0|1] "" IHU
 SG_ ActnOfFrntPosnLampDrv_UB : 180|1@0+ (1,0) [0|1] "" IHU
 SG_ ActnOfFrntSideMkrLampDrv : 179|1@0+ (1,0) [0|1] "" IHU
 SG_ ActnOfFrntSideMkrLampDrv_UB : 178|1@0+ (1,0) [0|1] "" IHU
 SG_ ActnOfFrntSideMkrLampPass : 177|1@0+ (1,0) [0|1] "" IHU
 SG_ ActnOfFrntSideMkrLampPass_UB : 176|1@0+ (1,0) [0|1] "" IHU
 SG_ ActnOfLedCornrgLampLe : 191|1@0+ (1,0) [0|1] "" IHU
 SG_ ActnOfLedCornrgLampLe_UB : 190|1@0+ (1,0) [0|1] "" IHU
 SG_ ActnOfLedCornrgLampRi : 189|1@0+ (1,0) [0|1] "" IHU
 SG_ ActnOfLedCornrgLampRi_UB : 188|1@0+ (1,0) [0|1] "" IHU
 SG_ ActnOfLedDaytiRunngLamp : 187|1@0+ (1,0) [0|1] "" IHU
 SG_ ActnOfLedDaytiRunngLamp_UB : 186|1@0+ (1,0) [0|1] "" IHU
 SG_ ActnOfLedFrntCrossLamp : 185|1@0+ (1,0) [0|1] "" IHU
 SG_ ActnOfLedFrntCrossLamp_UB : 184|1@0+ (1,0) [0|1] "" IHU
 SG_ ActnOfLedFrntCrossLampDyn : 199|1@0+ (1,0) [0|1] "" IHU
 SG_ ActnOfLedFrntCrossLampDyn_UB : 198|1@0+ (1,0) [0|1] "" IHU
 SG_ ActnOfLedFrntFogLamp : 197|1@0+ (1,0) [0|1] "" IHU
 SG_ ActnOfLedFrntFogLamp_UB : 196|1@0+ (1,0) [0|1] "" IHU
 SG_ ActnOfLedGrilleLamp : 195|1@0+ (1,0) [0|1] "" IHU
 SG_ ActnOfLedGrilleLamp_UB : 194|1@0+ (1,0) [0|1] "" IHU
 SG_ ActnOfLedGrilleLampDyn : 193|1@0+ (1,0) [0|1] "" IHU
 SG_ ActnOfLedGrilleLampDyn_UB : 192|1@0+ (1,0) [0|1] "" IHU
 SG_ ActnOfLedLeLogoLamp : 207|1@0+ (1,0) [0|1] "" IHU
 SG_ ActnOfLedLeLogoLamp_UB : 206|1@0+ (1,0) [0|1] "" IHU
 SG_ ActnOfLedLeLogoLampDyn : 205|1@0+ (1,0) [0|1] "" IHU
 SG_ ActnOfLedLeLogoLampDyn_UB : 204|1@0+ (1,0) [0|1] "" IHU
 SG_ ActnOfLedPosnLampDyn : 203|1@0+ (1,0) [0|1] "" IHU
 SG_ ActnOfLedPosnLampDyn_UB : 202|1@0+ (1,0) [0|1] "" IHU
 SG_ ActnOfLedReFogLamp : 201|1@0+ (1,0) [0|1] "" IHU
 SG_ ActnOfLedReFogLamp_UB : 200|1@0+ (1,0) [0|1] "" IHU
 SG_ ActnOfLedRePosnLamp : 215|1@0+ (1,0) [0|1] "" IHU
 SG_ ActnOfLedRePosnLamp_UB : 214|1@0+ (1,0) [0|1] "" IHU
 SG_ ActnOfLedRiLogoLamp : 213|1@0+ (1,0) [0|1] "" IHU
 SG_ ActnOfLedRiLogoLamp_UB : 212|1@0+ (1,0) [0|1] "" IHU
 SG_ ActnOfLedRiLogoLampDyn : 211|1@0+ (1,0) [0|1] "" IHU
 SG_ ActnOfLedRiLogoLampDyn_UB : 210|1@0+ (1,0) [0|1] "" IHU
 SG_ ActnOfLedRvsgLamp : 209|1@0+ (1,0) [0|1] "" IHU
 SG_ ActnOfLedRvsgLamp_UB : 208|1@0+ (1,0) [0|1] "" IHU
 SG_ ActnOfReFogLampPass : 223|1@0+ (1,0) [0|1] "" IHU
 SG_ ActnOfReFogLampPass_UB : 222|1@0+ (1,0) [0|1] "" IHU
 SG_ ActnOfRePosnLampDrv : 221|1@0+ (1,0) [0|1] "" IHU
 SG_ ActnOfRePosnLampDrv_UB : 220|1@0+ (1,0) [0|1] "" IHU
 SG_ ActnOfReSideMkrLampDrv : 219|1@0+ (1,0) [0|1] "" IHU
 SG_ ActnOfReSideMkrLampDrv_UB : 218|1@0+ (1,0) [0|1] "" IHU
 SG_ ActnOfReSideMkrLampPass : 217|1@0+ (1,0) [0|1] "" IHU
 SG_ ActnOfReSideMkrLampPass_UB : 216|1@0+ (1,0) [0|1] "" IHU
 SG_ ActnOfRvsgLampDrv : 231|1@0+ (1,0) [0|1] "" IHU
 SG_ ActnOfRvsgLampDrv_UB : 230|1@0+ (1,0) [0|1] "" IHU
 SG_ ActvnOfAfs : 229|1@0+ (1,0) [0|1] "" IHU
 SG_ ActvnOfAfs_UB : 228|1@0+ (1,0) [0|1] "" IHU
 SG_ ActvnOfAhl : 227|1@0+ (1,0) [0|1] "" IHU
 SG_ ActvnOfAhl_UB : 226|1@0+ (1,0) [0|1] "" IHU
 SG_ ActvnOfAlrmReqFromCmplxIf : 225|1@0+ (1,0) [0|1] "" IHU
 SG_ ActvnOfAlrmReqFromCmplxIf_UB : 224|1@0+ (1,0) [0|1] "" IHU
 SG_ ActvnOfBrkLi : 239|1@0+ (1,0) [0|1] "" IHU
 SG_ ActvnOfBrkLi_UB : 238|1@0+ (1,0) [0|1] "" IHU
 SG_ ActvnOfDbl : 237|1@0+ (1,0) [0|1] "" IHU
 SG_ ActvnOfDbl_UB : 236|1@0+ (1,0) [0|1] "" IHU
 SG_ ActvnOfDefrstFrnt : 235|1@0+ (1,0) [0|1] "" IHU
 SG_ ActvnOfDefrstFrnt_UB : 234|1@0+ (1,0) [0|1] "" IHU
 SG_ ActvnOfDefrstRe : 233|1@0+ (1,0) [0|1] "" IHU
 SG_ ActvnOfDefrstRe_UB : 232|1@0+ (1,0) [0|1] "" IHU
 SG_ ActvnOfDoorSwtIllmn : 247|1@0+ (1,0) [0|1] "" IHU
 SG_ ActvnOfDoorSwtIllmn_UB : 246|1@0+ (1,0) [0|1] "" IHU
 SG_ ActvnOfFootwellLamp : 255|8@0+ (1.0,0.0) [0.0|100.0] "%" IHU
 SG_ ActvnOfFootwellLamp_UB : 263|1@0+ (1,0) [0|1] "" IHU
 SG_ ActvnOfHndlDoorLi_UB : 262|1@0+ (1,0) [0|1] "" IHU
 SG_ ActvnOfHndlDoorLiHndlDoorLiDrvr : 271|1@0+ (1,0) [0|1] "" IHU
 SG_ ActvnOfHndlDoorLiHndlDoorLiDrvrRe : 270|1@0+ (1,0) [0|1] "" IHU
 SG_ ActvnOfHndlDoorLiHndlDoorLiPass : 269|1@0+ (1,0) [0|1] "" IHU
 SG_ ActvnOfHndlDoorLiHndlDoorLiPassRe : 268|1@0+ (1,0) [0|1] "" IHU
 SG_ ActvnOfReLogoLamp1 : 245|1@0+ (1,0) [0|1] "" IHU
 SG_ ActvnOfReLogoLamp1_UB : 244|1@0+ (1,0) [0|1] "" IHU
 SG_ ActvnOfRoofSwtIllmn : 243|1@0+ (1,0) [0|1] "" IHU
 SG_ ActvnOfRoofSwtIllmn_UB : 242|1@0+ (1,0) [0|1] "" IHU
 SG_ ActvnOfSillPlateIllmn : 279|8@0+ (1.0,0.0) [0.0|100.0] "%" IHU
 SG_ ActvnOfSillPlateIllmn_UB : 261|1@0+ (1,0) [0|1] "" IHU
 SG_ ActvnOfStrtIllmn : 287|8@0+ (1.0,0.0) [0.0|100.0] "%" IHU
 SG_ ActvnOfStrtIllmn_UB : 260|1@0+ (1,0) [0|1] "" IHU
 SG_ ActvnOfTouristMod : 241|1@0+ (1,0) [0|1] "" IHU
 SG_ ActvnOfTouristMod_UB : 240|1@0+ (1,0) [0|1] "" IHU
 SG_ ActvnOfWiprMech : 266|2@0+ (1.0,0.0) [0.0|3.0] "Unitless" IHU
 SG_ ActvnOfWiprMech_UB : 264|1@0+ (1,0) [0|1] "" IHU
 SG_ ActvnOfWshrFrntNotSafe : 259|1@0+ (1,0) [0|1] "" IHU
 SG_ ActvnOfWshrFrntNotSafe_UB : 258|1@0+ (1,0) [0|1] "" IHU
 SG_ ActvnOfWshrRe : 257|1@0+ (1,0) [0|1] "" IHU
 SG_ ActvnOfWshrRe_UB : 256|1@0+ (1,0) [0|1] "" IHU
 SG_ AlrmAcoustReq01 : 295|8@0+ (1,0) [0|255] "" IHU
 SG_ AlrmAcoustReq01_UB : 267|1@0+ (1,0) [0|1] "" IHU
 SG_ AlrmToExtrLiFbVisReq : 319|3@0+ (1,0) [0|7] "" IHU
 SG_ AlrmToExtrLiFbVisReq_UB : 310|1@0+ (1,0) [0|1] "" IHU
 SG_ AlrmToExtrLiVisReq : 303|8@0+ (1,0) [0|255] "" IHU
 SG_ AlrmToExtrLiVisReq_UB : 311|1@0+ (1,0) [0|1] "" IHU
 SG_ AutWinWipgCmd : 316|3@0+ (1,0) [0|7] "" IHU
 SG_ AutWinWipgCmd_UB : 309|1@0+ (1,0) [0|1] "" IHU
 SG_ BswCha1NmState : 327|3@0+ (1,0) [0|7] "" IHU
 SG_ BswCha1NmState_UB : 308|1@0+ (1,0) [0|1] "" IHU
 SG_ BswChainNmState : 324|3@0+ (1,0) [0|7] "" IHU
 SG_ BswChainNmState_UB : 307|1@0+ (1,0) [0|1] "" IHU
 SG_ BswCpu0LoadAvg : 335|7@0+ (1.0,0.0) [0.0|100.0] "%" IHU
 SG_ BswCpu0LoadAvg_UB : 328|1@0+ (1,0) [0|1] "" IHU
 SG_ BswCpu0LoadMax : 343|7@0+ (1.0,0.0) [0.0|100.0] "%" IHU
 SG_ BswCpu0LoadMax_UB : 336|1@0+ (1,0) [0|1] "" IHU
 SG_ BswCpu1LoadAvg : 351|7@0+ (1.0,0.0) [0.0|100.0] "%" IHU
 SG_ BswCpu1LoadAvg_UB : 344|1@0+ (1,0) [0|1] "" IHU
 SG_ BswCpu1LoadMax : 359|7@0+ (1.0,0.0) [0.0|100.0] "%" IHU
 SG_ BswCpu1LoadMax_UB : 352|1@0+ (1,0) [0|1] "" IHU
 SG_ BswCpu2LoadAvg : 367|7@0+ (1.0,0.0) [0.0|100.0] "%" IHU
 SG_ BswCpu2LoadAvg_UB : 360|1@0+ (1,0) [0|1] "" IHU
 SG_ BswCpu2LoadMax : 375|7@0+ (1.0,0.0) [0.0|100.0] "%" IHU
 SG_ BswCpu2LoadMax_UB : 368|1@0+ (1,0) [0|1] "" IHU
 SG_ BswCpu3LoadAvg : 383|7@0+ (1.0,0.0) [0.0|100.0] "%" IHU
 SG_ BswCpu3LoadAvg_UB : 376|1@0+ (1,0) [0|1] "" IHU
 SG_ BswCpu3LoadMax : 391|7@0+ (1.0,0.0) [0.0|100.0] "%" IHU
 SG_ BswCpu3LoadMax_UB : 384|1@0+ (1,0) [0|1] "" IHU
 SG_ BswCpu4LoadAvg : 399|7@0+ (1.0,0.0) [0.0|100.0] "%" IHU
 SG_ BswCpu4LoadAvg_UB : 392|1@0+ (1,0) [0|1] "" IHU
 SG_ BswCpu4LoadMax : 407|7@0+ (1.0,0.0) [0.0|100.0] "%" IHU
 SG_ BswCpu4LoadMax_UB : 400|1@0+ (1,0) [0|1] "" IHU
 SG_ BswCpu5LoadAvg : 415|7@0+ (1.0,0.0) [0.0|100.0] "%" IHU
 SG_ BswCpu5LoadAvg_UB : 408|1@0+ (1,0) [0|1] "" IHU
 SG_ BswCpu5LoadMax : 423|7@0+ (1.0,0.0) [0.0|100.0] "%" IHU
 SG_ BswCpu5LoadMax_UB : 416|1@0+ (1,0) [0|1] "" IHU
 SG_ BswIcState : 431|32@0+ (1.0,0.0) [0.0|4294967295.0] "Unitless" IHU
 SG_ BswIcState_UB : 306|1@0+ (1,0) [0|1] "" IHU
 SG_ BswKeepWakeUpReason : 463|8@0+ (1.0,0.0) [0.0|255.0] "Unitless" IHU
 SG_ BswKeepWakeUpReason_UB : 305|1@0+ (1,0) [0|1] "" IHU
 SG_ BswOsTaskTime : 471|16@0+ (1.0,0.0) [0.0|65535.0] "Unitless" IHU
 SG_ BswOsTaskTime_UB : 304|1@0+ (1,0) [0|1] "" IHU
 SG_ BswPriNmState : 487|3@0+ (1,0) [0|7] "" IHU
 SG_ BswPriNmState_UB : 484|1@0+ (1,0) [0|1] "" IHU
 SG_ BswPropNmState : 483|3@0+ (1,0) [0|7] "" IHU
 SG_ BswPropNmState_UB : 480|1@0+ (1,0) [0|1] "" IHU
 SG_ BswWakeupSourceState : 495|3@0+ (1,0) [0|7] "" IHU
 SG_ BswWakeupSourceState_UB : 492|1@0+ (1,0) [0|1] "" IHU
 SG_ DwnLoadStsFbOfHdlampLe : 7|2@0+ (1,0) [0|3] "" IHU
 SG_ DwnLoadStsFbOfHdlampLe_UB : 15|1@0+ (1,0) [0|1] "" IHU
 SG_ DwnLoadStsFbOfHdlampRi : 5|2@0+ (1,0) [0|3] "" IHU
 SG_ DwnLoadStsFbOfHdlampRi_UB : 14|1@0+ (1,0) [0|1] "" IHU
 SG_ DwnLoadStsFbOfLogoLampLe : 3|2@0+ (1,0) [0|3] "" IHU
 SG_ DwnLoadStsFbOfLogoLampLe_UB : 13|1@0+ (1,0) [0|1] "" IHU
 SG_ DwnLoadStsFbOfLogoLampRi : 1|2@0+ (1,0) [0|3] "" IHU
 SG_ DwnLoadStsFbOfLogoLampRi_UB : 12|1@0+ (1,0) [0|1] "" IHU
 SG_ ExtrLiShowActvnFrntLeFb : 23|2@0+ (1,0) [0|3] "" IHU
 SG_ ExtrLiShowActvnFrntLeFb_UB : 11|1@0+ (1,0) [0|1] "" IHU
 SG_ ExtrLiShowActvnFrntRiFb : 21|2@0+ (1,0) [0|3] "" IHU
 SG_ ExtrLiShowActvnFrntRiFb_UB : 10|1@0+ (1,0) [0|1] "" IHU
 SG_ ExtrLiShowActvnLeLogoFb : 19|2@0+ (1,0) [0|3] "" IHU
 SG_ ExtrLiShowActvnLeLogoFb_UB : 9|1@0+ (1,0) [0|1] "" IHU
 SG_ ExtrLiShowActvnRiLogoFb : 17|2@0+ (1,0) [0|3] "" IHU
 SG_ ExtrLiShowActvnRiLogoFb_UB : 8|1@0+ (1,0) [0|1] "" IHU
 SG_ HdlampLeInpSts1 : 31|1@0+ (1,0) [0|1] "" IHU
 SG_ HdlampLeInpSts1_UB : 30|1@0+ (1,0) [0|1] "" IHU
 SG_ HdlampLeInpSts2 : 29|1@0+ (1,0) [0|1] "" IHU
 SG_ HdlampLeInpSts2_UB : 28|1@0+ (1,0) [0|1] "" IHU
 SG_ HdlampRiInpSts1 : 27|1@0+ (1,0) [0|1] "" IHU
 SG_ HdlampRiInpSts1_UB : 26|1@0+ (1,0) [0|1] "" IHU
 SG_ HdlampRiInpSts2 : 25|1@0+ (1,0) [0|1] "" IHU
 SG_ HdlampRiInpSts2_UB : 24|1@0+ (1,0) [0|1] "" IHU
 SG_ ShortDropWinDrvrSts : 313|2@0+ (1,0) [0|3] "" IHU
 SG_ ShortDropWinDrvrSts_UB : 321|1@0+ (1,0) [0|1] "" IHU
 SG_ ShortDropWinReLeSts : 497|2@0+ (1,0) [0|3] "" IHU
 SG_ ShortDropWinReLeSts_UB : 320|1@0+ (1,0) [0|1] "" IHU
 SG_ SnsrSoundrBattBackedSts_UB : 504|1@0+ (1,0) [0|1] "" Vector__XXX
 SG_ SnsrSoundrBattBackedStsArmSts : 511|1@0+ (1,0) [0|1] "" Vector__XXX
 SG_ SnsrSoundrBattBackedStsCfgSts : 510|2@0+ (1,0) [0|3] "" Vector__XXX
 SG_ SnsrSoundrBattBackedStsSnsrInclnExist : 508|1@0+ (1,0) [0|1] "" Vector__XXX
 SG_ SnsrSoundrBattBackedStsSoundrBattBackedErrSts : 507|2@0+ (1,0) [0|3] "" Vector__XXX
 SG_ SnsrSoundrBattBackedStsSoundSts : 505|1@0+ (1,0) [0|1] "" Vector__XXX
 SG_ StsOfAfsLe : 39|2@0+ (1,0) [0|3] "" IHU
 SG_ StsOfAfsLe_UB : 47|1@0+ (1,0) [0|1] "" IHU
 SG_ StsOfAfsRi : 37|2@0+ (1,0) [0|3] "" IHU
 SG_ StsOfAfsRi_UB : 46|1@0+ (1,0) [0|1] "" IHU
 SG_ StsOfAhbcLe : 35|2@0+ (1,0) [0|3] "" IHU
 SG_ StsOfAhbcLe_UB : 45|1@0+ (1,0) [0|1] "" IHU
 SG_ StsOfAhbcRi : 33|2@0+ (1,0) [0|3] "" IHU
 SG_ StsOfAhbcRi_UB : 44|1@0+ (1,0) [0|1] "" IHU
 SG_ StsOfFrntSideMkrLampLe2 : 55|2@0+ (1,0) [0|3] "" IHU
 SG_ StsOfFrntSideMkrLampLe2_UB : 43|1@0+ (1,0) [0|1] "" IHU
 SG_ StsOfFrntSideMkrLampRi2 : 53|2@0+ (1,0) [0|3] "" IHU
 SG_ StsOfFrntSideMkrLampRi2_UB : 42|1@0+ (1,0) [0|1] "" IHU
 SG_ StsOfLedCornrgLampLe : 51|2@0+ (1,0) [0|3] "" IHU
 SG_ StsOfLedCornrgLampLe_UB : 41|1@0+ (1,0) [0|1] "" IHU
 SG_ StsOfLedCornrgLampRi : 49|2@0+ (1,0) [0|3] "" IHU
 SG_ StsOfLedCornrgLampRi_UB : 40|1@0+ (1,0) [0|1] "" IHU
 SG_ StsOfLedDaytiRunngLampLe : 63|2@0+ (1,0) [0|3] "" IHU
 SG_ StsOfLedDaytiRunngLampLe_UB : 71|1@0+ (1,0) [0|1] "" IHU
 SG_ StsOfLedDaytiRunngLampRi : 61|2@0+ (1,0) [0|3] "" IHU
 SG_ StsOfLedDaytiRunngLampRi_UB : 70|1@0+ (1,0) [0|1] "" IHU
 SG_ StsOfLedFrntFogLampLe : 59|2@0+ (1,0) [0|3] "" IHU
 SG_ StsOfLedFrntFogLampLe_UB : 69|1@0+ (1,0) [0|1] "" IHU
 SG_ StsOfLedFrntFogLampRi : 57|2@0+ (1,0) [0|3] "" IHU
 SG_ StsOfLedFrntFogLampRi_UB : 68|1@0+ (1,0) [0|1] "" IHU
 SG_ StsOfLedFrntPosnLampLe : 79|2@0+ (1,0) [0|3] "" IHU
 SG_ StsOfLedFrntPosnLampLe_UB : 67|1@0+ (1,0) [0|1] "" IHU
 SG_ StsOfLedFrntPosnLampRi : 77|2@0+ (1,0) [0|3] "" IHU
 SG_ StsOfLedFrntPosnLampRi_UB : 66|1@0+ (1,0) [0|1] "" IHU
 SG_ StsOfLedFrntTurnIndcrLe : 75|2@0+ (1,0) [0|3] "" IHU
 SG_ StsOfLedFrntTurnIndcrLe_UB : 65|1@0+ (1,0) [0|1] "" IHU
 SG_ StsOfLedFrntTurnIndcrRi : 73|2@0+ (1,0) [0|3] "" IHU
 SG_ StsOfLedFrntTurnIndcrRi_UB : 64|1@0+ (1,0) [0|1] "" IHU
 SG_ StsOfLedLeLogoLamp : 119|2@0+ (1,0) [0|3] "" IHU
 SG_ StsOfLedLeLogoLamp_UB : 127|1@0+ (1,0) [0|1] "" IHU
 SG_ StsOfLedRiLogoLamp : 117|2@0+ (1,0) [0|3] "" IHU
 SG_ StsOfLedRiLogoLamp_UB : 126|1@0+ (1,0) [0|1] "" IHU
 SG_ StsOfLvlgLe_UB : 89|1@0+ (1,0) [0|1] "" IHU
 SG_ StsOfLvlgLeChks : 87|8@0+ (1.0,0.0) [0.0|255.0] "Unitless" IHU
 SG_ StsOfLvlgLeCntr : 95|4@0+ (1.0,0.0) [0.0|15.0] "Unitless" IHU
 SG_ StsOfLvlgLeStsOfLvlgLe : 91|2@0+ (1,0) [0|3] "" IHU
 SG_ StsOfLvlgRi_UB : 88|1@0+ (1,0) [0|1] "" IHU
 SG_ StsOfLvlgRiChks : 103|8@0+ (1.0,0.0) [0.0|255.0] "Unitless" IHU
 SG_ StsOfLvlgRiCntr : 111|4@0+ (1.0,0.0) [0.0|15.0] "Unitless" IHU
 SG_ StsOfLvlgRiStsOfLvlgRi : 107|2@0+ (1,0) [0|3] "" IHU
 SG_ StsOfTouristModLe : 115|2@0+ (1,0) [0|3] "" IHU
 SG_ StsOfTouristModLe_UB : 125|1@0+ (1,0) [0|1] "" IHU
 SG_ StsOfTouristModRi : 113|2@0+ (1,0) [0|3] "" IHU
 SG_ StsOfTouristModRi_UB : 124|1@0+ (1,0) [0|1] "" IHU
 SG_ StsOfWelGbyFrntLe : 123|1@0+ (1,0) [0|1] "" IHU
 SG_ StsOfWelGbyFrntLe_UB : 122|1@0+ (1,0) [0|1] "" IHU
 SG_ StsOfWelGbyFrntRi : 121|1@0+ (1,0) [0|1] "" IHU
 SG_ StsOfWelGbyFrntRi_UB : 120|1@0+ (1,0) [0|1] "" IHU
 SG_ SunRoofAndCurtBtnSts2_UB : 503|1@0+ (1,0) [0|1] "" IHU
 SG_ SunRoofAndCurtBtnSts2Cntr : 499|2@0+ (1.0,0.0) [0.0|3.0] "Unitless" IHU
 SG_ SunRoofAndCurtBtnSts2Pos : 502|3@0+ (1,0) [0|7] "" IHU
 SG_ SunRoofImpctDetnSts2 : 490|3@0+ (1,0) [0|7] "" IHU
 SG_ SunRoofImpctDetnSts2_UB : 491|1@0+ (1,0) [0|1] "" IHU
 SG_ TCSDoorSts : 105|1@0+ (1,0) [0|1] "" Vector__XXX
 SG_ TCSDoorSts_UB : 104|1@0+ (1,0) [0|1] "" Vector__XXX
 SG_ WiprInPrkgPosnLoFromWMM : 151|1@0+ (1,0) [0|1] "" Vector__XXX
 SG_ WiprInPrkgPosnLoFromWMM_UB : 150|1@0+ (1,0) [0|1] "" Vector__XXX
 SG_ WiprInWipgArFromWMM : 149|1@0+ (1,0) [0|1] "" Vector__XXX
 SG_ WiprInWipgArFromWMM_UB : 148|1@0+ (1,0) [0|1] "" Vector__XXX
 SG_ WiprMotCrkAg : 143|8@0+ (1.0,0.0) [0.0|255.0] "Unitless" Vector__XXX
 SG_ WiprMotCrkAg_UB : 128|1@0+ (1,0) [0|1] "" Vector__XXX
 SG_ WiprMotDiagc_UB : 129|1@0+ (1,0) [0|1] "" Vector__XXX
 SG_ WiprMotDiagcWiprMotHiVoltDetd : 135|2@0+ (1,0) [0|3] "" Vector__XXX
 SG_ WiprMotDiagcWiprMotLoVoltDetd : 133|2@0+ (1,0) [0|3] "" Vector__XXX
 SG_ WiprMotDiagcWiprMotOvldDetd : 131|2@0+ (1,0) [0|3] "" Vector__XXX
 SG_ WiprMotErrSafe : 145|2@0+ (1,0) [0|3] "" Vector__XXX
 SG_ WiprMotErrSafe_UB : 159|1@0+ (1,0) [0|1] "" Vector__XXX
 SG_ WshngCycActvFromWMM : 147|1@0+ (1,0) [0|1] "" Vector__XXX
 SG_ WshngCycActvFromWMM_UB : 146|1@0+ (1,0) [0|1] "" Vector__XXX

BO_ 416 ZCUDZCUCANFD2Fr32 : 64 ZCUD
 SG_ AccPedlAna : 31|8@0+ (0.0196078431372549,0.0) [0.0|5.0] "Volt" IHU
 SG_ AccPedlAna_UB : 16|1@0+ (1,0) [0|1] "" IHU
 SG_ AccPedlPWM : 55|8@0+ (0.392156863,0.0) [0.0|100.00000006500001] "%" IHU
 SG_ AccPedlPWM_UB : 43|1@0+ (1,0) [0|1] "" IHU
 SG_ BattCoolgPwrPreTherm : 63|16@0- (1.0,0.0) [-32768.0|32767.0] "W" IHU
 SG_ BattCoolgPwrPreTherm_UB : 42|1@0+ (1,0) [0|1] "" IHU
 SG_ BattHeatgTargTempPreTherm : 79|8@0+ (1.0,-50.0) [-50.0|200.0] "degC" IHU
 SG_ BattHeatgTargTempPreTherm_UB : 41|1@0+ (1,0) [0|1] "" IHU
 SG_ BattVoltKL30 : 87|8@0+ (0.0784313725490196,0.0) [0.0|20.0] "Volt" IHU
 SG_ BattVoltKL30_UB : 40|1@0+ (1,0) [0|1] "" IHU
 SG_ ChillerOutCooltT : 39|11@0+ (0.1,-40.0) [-40.0|140.0] "degC" IHU
 SG_ ChillerOutCooltT_UB : 44|1@0+ (1,0) [0|1] "" IHU
 SG_ CnvnInhb : 127|1@0+ (1,0) [0|1] "" IHU
 SG_ CnvnInhb_UB : 126|1@0+ (1,0) [0|1] "" IHU
 SG_ CPSRClsReq : 125|1@0+ (1,0) [0|1] "" IHU
 SG_ CPSRClsReq_UB : 124|1@0+ (1,0) [0|1] "" IHU
 SG_ CPSRFbSt : 123|1@0+ (1,0) [0|1] "" IHU
 SG_ CPSRFbSt_UB : 122|1@0+ (1,0) [0|1] "" IHU
 SG_ EexvSts_UB : 17|1@0+ (1,0) [0|1] "" IHU
 SG_ EexvStsExvActrPosn : 7|10@0+ (0.2,0.0) [0.0|100.0] "%" IHU
 SG_ EexvStsExvBlkErr : 9|1@0+ (1,0) [0|1] "" IHU
 SG_ EexvStsExvCalibSts : 13|2@0+ (1,0) [0|3] "" IHU
 SG_ EexvStsExvElecStsErr : 23|3@0+ (1,0) [0|7] "" IHU
 SG_ EexvStsExvMovSts : 8|1@0+ (1,0) [0|1] "" IHU
 SG_ EexvStsExvOvrTempErr : 20|1@0+ (1,0) [0|1] "" IHU
 SG_ EexvStsExvOvrTrvlErr : 19|1@0+ (1,0) [0|1] "" IHU
 SG_ EexvStsExvPreHeatgSts : 18|1@0+ (1,0) [0|1] "" IHU
 SG_ EexvStsExvVoltgRangErr : 11|2@0+ (1,0) [0|3] "" IHU
 SG_ EtpActualSpeed_UB : 95|1@0+ (1,0) [0|1] "" IHU
 SG_ EtpActualSpeedBackup : 94|13@0+ (1.0,0.0) [0.0|8191.0] "Unitless" IHU
 SG_ EtpActualSpeedEtpActualSpeed : 111|13@0+ (1.0,0.0) [0.0|8191.0] "Unitless" IHU
 SG_ EtpActualSpeedSts : 97|2@0+ (1.0,0.0) [0.0|3.0] "Unitless" IHU
 SG_ EtpAngPosPlausSts : 121|1@0+ (1.0,0.0) [0.0|1.0] "Unitless" IHU
 SG_ EtpAngPosPlausSts_UB : 120|1@0+ (1,0) [0|1] "" IHU
 SG_ EtpASAStudyProcess : 141|1@0+ (1.0,0.0) [0.0|1.0] "Unitless" IHU
 SG_ EtpASAStudyProcess_UB : 140|1@0+ (1,0) [0|1] "" IHU
 SG_ EtpASAValueValid : 139|1@0+ (1.0,0.0) [0.0|1.0] "Unitless" IHU
 SG_ EtpASAValueValid_UB : 138|1@0+ (1,0) [0|1] "" IHU
 SG_ EtpBatteryVoltage : 135|9@0+ (0.1,0.0) [0.0|51.1] "Unitless" IHU
 SG_ EtpBatteryVoltage_UB : 142|1@0+ (1,0) [0|1] "" IHU
 SG_ EtpCanNodeLoss : 137|1@0+ (1.0,0.0) [0.0|1.0] "Unitless" IHU
 SG_ EtpCanNodeLoss_UB : 136|1@0+ (1,0) [0|1] "" IHU
 SG_ EtpCurrent_UB : 173|1@0+ (1,0) [0|1] "" IHU
 SG_ EtpCurrent_Backup : 145|10@0+ (0.1,0.0) [0.0|102.30000000000001] "Unitless" IHU
 SG_ EtpCurrentEtpCurrent : 167|10@0+ (0.1,0.0) [0.0|102.30000000000001] "Unitless" IHU
 SG_ EtpCurrentStsBackup : 147|2@0+ (1.0,0.0) [0.0|3.0] "Unitless" IHU
 SG_ EtpEnableOff : 151|1@0+ (1.0,0.0) [0.0|1.0] "Unitless" IHU
 SG_ EtpEnableOff_UB : 150|1@0+ (1,0) [0|1] "" IHU
 SG_ EtpEOPHydLeakSts : 149|1@0+ (1.0,0.0) [0.0|1.0] "Unitless" IHU
 SG_ EtpEOPHydLeakSts_UB : 148|1@0+ (1,0) [0|1] "" IHU
 SG_ EtpFaultSelfMos : 199|1@0+ (1.0,0.0) [0.0|1.0] "Unitless" IHU
 SG_ EtpFaultSelfMos_UB : 198|1@0+ (1,0) [0|1] "" IHU
 SG_ EtpGDUOverCurrent : 197|1@0+ (1.0,0.0) [0.0|1.0] "Unitless" IHU
 SG_ EtpGDUOverCurrent_UB : 196|1@0+ (1,0) [0|1] "" IHU
 SG_ EtpGmrSpiCommErr : 195|1@0+ (1.0,0.0) [0.0|1.0] "Unitless" IHU
 SG_ EtpGmrSpiCommErr_UB : 194|1@0+ (1,0) [0|1] "" IHU
 SG_ EtpHallSignal_UB : 180|1@0+ (1,0) [0|1] "" IHU
 SG_ EtpHallSignalError : 183|1@0+ (1.0,0.0) [0.0|1.0] "Unitless" IHU
 SG_ EtpHallSignalSt : 182|2@0+ (1.0,0.0) [0.0|3.0] "Unitless" IHU
 SG_ EtpIgnitionStatus : 193|1@0+ (1.0,0.0) [0.0|1.0] "Unitless" IHU
 SG_ EtpIgnitionStatus_UB : 192|1@0+ (1,0) [0|1] "" IHU
 SG_ EtpMcu_UB : 179|1@0+ (1,0) [0|1] "" IHU
 SG_ EtpMcuTemperature : 191|8@0+ (1.0,-50.0) [-50.0|205.0] "degC" IHU
 SG_ EtpMcuTOutRngHiSts : 178|1@0+ (1.0,0.0) [0.0|1.0] "Unitless" IHU
 SG_ EtpMcuTOutRngLoSts : 177|1@0+ (1.0,0.0) [0.0|1.0] "Unitless" IHU
 SG_ EtpMcuTStuckSts : 176|1@0+ (1.0,0.0) [0.0|1.0] "Unitless" IHU
 SG_ EtpMos_UB : 217|1@0+ (1,0) [0|1] "" IHU
 SG_ EtpMosTemperature : 207|8@0+ (1.0,-50.0) [-50.0|205.0] "degC" IHU
 SG_ EtpMosTemperatureBackup : 215|8@0+ (1.0,-50.0) [-50.0|205.0] "degC" IHU
 SG_ EtpMosTOpenSts : 223|1@0+ (1.0,0.0) [0.0|1.0] "Unitless" IHU
 SG_ EtpMosTOutRngHiSts : 222|1@0+ (1.0,0.0) [0.0|1.0] "Unitless" IHU
 SG_ EtpMosTOutRngLoSts : 221|1@0+ (1.0,0.0) [0.0|1.0] "Unitless" IHU
 SG_ EtpMosTShoBattSts : 220|1@0+ (1.0,0.0) [0.0|1.0] "Unitless" IHU
 SG_ EtpMosTShoGndSts : 219|1@0+ (1.0,0.0) [0.0|1.0] "Unitless" IHU
 SG_ EtpMosTStuckSts : 218|1@0+ (1.0,0.0) [0.0|1.0] "Unitless" IHU
 SG_ EtpOffseVoltageFailure : 261|1@0+ (1.0,0.0) [0.0|1.0] "Unitless" IHU
 SG_ EtpOffseVoltageFailure_UB : 260|1@0+ (1,0) [0|1] "" IHU
 SG_ EtpOverTemperature : 169|1@0+ (1.0,0.0) [0.0|1.0] "Unitless" IHU
 SG_ EtpOverTemperature_UB : 168|1@0+ (1,0) [0|1] "" IHU
 SG_ EtpOverTemperatureBackup : 171|2@0+ (1.0,0.0) [0.0|3.0] "Unitless" IHU
 SG_ EtpOverTemperatureBackup_UB : 172|1@0+ (1,0) [0|1] "" IHU
 SG_ EtpOverVoltage : 113|2@0+ (1.0,0.0) [0.0|3.0] "Unitless" IHU
 SG_ EtpOverVoltage_UB : 114|1@0+ (1,0) [0|1] "" IHU
 SG_ EtpPhase_UB : 262|1@0+ (1,0) [0|1] "" IHU
 SG_ EtpPhaseCurrent : 239|11@0+ (0.1,0.0) [0.0|204.70000000000002] "Unitless" IHU
 SG_ EtpPhaseCurrentBackup : 242|11@0+ (0.1,0.0) [0.0|204.70000000000002] "Unitless" IHU
 SG_ EtpPhaseCurrentStsBackup : 244|2@0+ (1.0,0.0) [0.0|3.0] "Unitless" IHU
 SG_ EtpPhaseOverCurrent : 263|1@0+ (1.0,0.0) [0.0|1.0] "Unitless" IHU
 SG_ EtpPumpReady : 287|1@0+ (1.0,0.0) [0.0|1.0] "Unitless" IHU
 SG_ EtpPumpReady_UB : 286|1@0+ (1,0) [0|1] "" IHU
 SG_ EtpResetReason : 258|3@0+ (1.0,0.0) [0.0|7.0] "Unitless" IHU
 SG_ EtpResetReason_UB : 259|1@0+ (1,0) [0|1] "" IHU
 SG_ EtpRunningStatus : 317|2@0+ (1.0,0.0) [0.0|3.0] "Unitless" IHU
 SG_ EtpRunningStatus_UB : 318|1@0+ (1,0) [0|1] "" IHU
 SG_ EtpSensorPowSupplyFau : 285|1@0+ (1.0,0.0) [0.0|1.0] "Unitless" IHU
 SG_ EtpSensorPowSupplyFau_UB : 284|1@0+ (1,0) [0|1] "" IHU
 SG_ EtpSpdBaseAngleValue : 283|1@0+ (1.0,0.0) [0.0|1.0] "Unitless" IHU
 SG_ EtpSpdBaseAngleValue_UB : 282|1@0+ (1,0) [0|1] "" IHU
 SG_ EtpSpdBaseAngleValueSts : 281|1@0+ (1.0,0.0) [0.0|1.0] "Unitless" IHU
 SG_ EtpSpdBaseAngleValueSts_UB : 280|1@0+ (1,0) [0|1] "" IHU
 SG_ EtpSpdBaseUVWIncPos : 271|13@0+ (1.0,0.0) [0.0|8191.0] "Unitless" IHU
 SG_ EtpSpdBaseUVWIncPos_UB : 274|1@0+ (1,0) [0|1] "" IHU
 SG_ EtpSpdBaseUVWIncPosSts : 273|1@0+ (1.0,0.0) [0.0|1.0] "Unitless" IHU
 SG_ EtpSpdBaseUVWIncPosSts_UB : 272|1@0+ (1,0) [0|1] "" IHU
 SG_ EtpStartFailure : 315|1@0+ (1.0,0.0) [0.0|1.0] "Unitless" IHU
 SG_ EtpStartFailure_UB : 314|1@0+ (1,0) [0|1] "" IHU
 SG_ EtpUnderSpeed : 295|2@0+ (1.0,0.0) [0.0|3.0] "Unitless" IHU
 SG_ EtpUnderSpeed_UB : 293|1@0+ (1,0) [0|1] "" IHU
 SG_ EtpUnderVoltage : 291|2@0+ (1.0,0.0) [0.0|3.0] "Unitless" IHU
 SG_ EtpUnderVoltage_UB : 292|1@0+ (1,0) [0|1] "" IHU
 SG_ EtpVHDVoltage_UB : 289|1@0+ (1,0) [0|1] "" IHU
 SG_ EtpVHDVoltageBackup : 288|9@0+ (0.1,0.0) [0.0|51.1] "Unitless" IHU
 SG_ EtpVHDVoltageEtpVHDVoltage : 311|9@0+ (0.1,0.0) [0.0|51.1] "Unitless" IHU
 SG_ EtpVoltagePlausSts : 313|1@0+ (1.0,0.0) [0.0|1.0] "Unitless" IHU
 SG_ EtpVoltagePlausSts_UB : 312|1@0+ (1,0) [0|1] "" IHU
 SG_ ExvSts_UB : 337|1@0+ (1,0) [0|1] "" IHU
 SG_ ExvStsExvActrPosn : 327|10@0+ (0.2,0.0) [0.0|100.0] "%" IHU
 SG_ ExvStsExvBlkErr : 329|1@0+ (1,0) [0|1] "" IHU
 SG_ ExvStsExvCalibSts : 333|2@0+ (1,0) [0|3] "" IHU
 SG_ ExvStsExvElecStsErr : 343|3@0+ (1,0) [0|7] "" IHU
 SG_ ExvStsExvMovSts : 328|1@0+ (1,0) [0|1] "" IHU
 SG_ ExvStsExvOvrTempErr : 340|1@0+ (1,0) [0|1] "" IHU
 SG_ ExvStsExvOvrTrvlErr : 339|1@0+ (1,0) [0|1] "" IHU
 SG_ ExvStsExvPreHeatgSts : 338|1@0+ (1,0) [0|1] "" IHU
 SG_ ExvStsExvVoltgRangErr : 331|2@0+ (1,0) [0|3] "" IHU
 SG_ FrntHeatPwrAllwd : 231|8@0+ (50.0,0.0) [0.0|12750.0] "W" IHU
 SG_ FrntHeatPwrAllwd_UB : 216|1@0+ (1,0) [0|1] "" IHU
 SG_ HvchOnForBattHeatg : 383|1@0+ (1,0) [0|1] "" IHU
 SG_ HvchOnForBattHeatg_UB : 382|1@0+ (1,0) [0|1] "" IHU
 SG_ HvClimaCoolgPwrCritDes : 391|16@0- (1.0,0.0) [-32768.0|32767.0] "W" IHU
 SG_ HvClimaCoolgPwrCritDes_UB : 381|1@0+ (1,0) [0|1] "" IHU
 SG_ HvClimaHeatgPwrCritDes : 407|16@0- (1.0,0.0) [-32768.0|32767.0] "W" IHU
 SG_ HvClimaHeatgPwrCritDes_UB : 380|1@0+ (1,0) [0|1] "" IHU
 SG_ HvCoolgPwrCritDes : 423|16@0- (1.0,0.0) [-32768.0|32767.0] "W" IHU
 SG_ HvCoolgPwrCritDes_UB : 379|1@0+ (1,0) [0|1] "" IHU
 SG_ HvCoolgPwrNormDes : 439|16@0- (1.0,0.0) [-32768.0|32767.0] "W" IHU
 SG_ HvCoolgPwrNormDes_UB : 378|1@0+ (1,0) [0|1] "" IHU
 SG_ HvHeatgPwrCritDes : 455|16@0- (1.0,0.0) [-32768.0|32767.0] "W" IHU
 SG_ HvHeatgPwrCritDes_UB : 377|1@0+ (1,0) [0|1] "" IHU
 SG_ HvHeatgPwrNormDes : 471|16@0- (1.0,0.0) [-32768.0|32767.0] "W" IHU
 SG_ HvHeatgPwrNormDes_UB : 376|1@0+ (1,0) [0|1] "" IHU
 SG_ IsgFlg20ForEOP : 505|1@0+ (1.0,0.0) [0.0|1.0] "Unitless" IHU
 SG_ IsgFlg20ForEOP_UB : 504|1@0+ (1,0) [0|1] "" IHU
 SG_ IsgForWRC_UB : 336|1@0+ (1,0) [0|1] "" IHU
 SG_ IsgForWRCIsgSpdForWRC : 351|16@0+ (1.0,-20000.0) [-20000.0|45535.0] "rpm" IHU
 SG_ IsgForWRCIsgTqEstForWRC : 367|16@0+ (1.0,-8000.0) [-8000.0|57535.0] "Unitless" IHU
 SG_ IsgOilPmpTargetSpeedForETP : 487|13@0+ (1.0,0.0) [0.0|8191.0] "Unitless" IHU
 SG_ IsgOilPmpTargetSpeedForETP_UB : 490|1@0+ (1,0) [0|1] "" IHU
 SG_ IsgOilPmpTemperatureForETP : 503|8@0+ (1.0,-50.0) [-50.0|205.0] "degC" IHU
 SG_ IsgOilPmpTemperatureForETP_UB : 511|1@0+ (1,0) [0|1] "" IHU
 SG_ IsgOPCStartOnForETP : 489|1@0+ (1.0,0.0) [0.0|1.0] "Unitless" IHU
 SG_ IsgOPCStartOnForETP_UB : 488|1@0+ (1,0) [0|1] "" IHU
 SG_ IsgTPlausStsForETP : 509|2@0+ (1.0,0.0) [0.0|3.0] "Unitless" IHU
 SG_ IsgTPlausStsForETP_UB : 510|1@0+ (1,0) [0|1] "" IHU
 SG_ LoTemEneStorage : 507|1@0+ (1,0) [0|1] "" IHU
 SG_ LoTemEneStorage_UB : 506|1@0+ (1,0) [0|1] "" IHU

BO_ 422 ZCUDZCUCANFD2Fr33 : 64 ZCUD
 SG_ EwpAflFlagCooling : 49|1@0+ (1,0) [0|1] "" IHU
 SG_ EwpAflFlagCooling_UB : 48|1@0+ (1,0) [0|1] "" IHU
 SG_ HvActvReq : 185|2@0+ (1,0) [0|3] "" IHU
 SG_ HvActvReq_UB : 186|1@0+ (1,0) [0|1] "" IHU
 SG_ IsgCoolgReqInvrCloud : 39|3@0+ (1,0) [0|7] "" IHU
 SG_ IsgCoolgReqInvrCloud_UB : 36|1@0+ (1,0) [0|1] "" IHU
 SG_ IsgCooltFlowMinReqCloud : 33|10@0+ (0.01,0.0) [0.0|10.23] "L / min" IHU
 SG_ IsgCooltFlowMinReqCloud_UB : 34|1@0+ (1,0) [0|1] "" IHU
 SG_ IsgCrashValueForETP : 55|2@0+ (1.0,0.0) [0.0|3.0] "Unitless" IHU
 SG_ IsgCrashValueForETP_UB : 53|1@0+ (1,0) [0|1] "" IHU
 SG_ IsgHeatFdBckCloud : 51|2@0+ (1,0) [0|3] "" IHU
 SG_ IsgHeatFdBckCloud_UB : 52|1@0+ (1,0) [0|1] "" IHU
 SG_ IvtrActId : 7|11@0+ (1.0,-1023.0) [-1023.0|1024.0] "Unitless" IHU
 SG_ IvtrActId_UB : 12|1@0+ (1,0) [0|1] "" IHU
 SG_ IvtrActIq : 10|11@0+ (1.0,-1023.0) [-1023.0|1024.0] "Unitless" IHU
 SG_ IvtrActIq_UB : 11|1@0+ (1,0) [0|1] "" IHU
 SG_ IvtrActvDchaSts : 31|8@0+ (1.0,0.0) [0.0|255.0] "Unitless" IHU
 SG_ IvtrActvDchaSts_UB : 35|1@0+ (1,0) [0|1] "" IHU
 SG_ IvtrDAxis_UB : 84|1@0+ (1,0) [0|1] "" IHU
 SG_ IvtrDAxisCurrtSp : 79|11@0+ (1.0,-1023.0) [-1023.0|1024.0] "Unitless" IHU
 SG_ IvtrDAxisU : 63|16@0+ (0.1,-1310.0) [-1310.0|5243.5] "Unitless" IHU
 SG_ IvtrDerating_UB : 81|1@0+ (1,0) [0|1] "" IHU
 SG_ IvtrDeratingReason : 95|8@0+ (1.0,0.0) [0.0|255.0] "Unitless" IHU
 SG_ IvtrDeratingSts : 80|1@0+ (1.0,0.0) [0.0|1.0] "Unitless" IHU
 SG_ IvtrGateSts : 103|8@0+ (1.0,0.0) [0.0|255.0] "Unitless" IHU
 SG_ IvtrGateSts_UB : 83|1@0+ (1,0) [0|1] "" IHU
 SG_ IvtrIgbtJunctionT : 111|8@0+ (1.0,-40.0) [-40.0|215.0] "degC" IHU
 SG_ IvtrIgbtJunctionT_UB : 82|1@0+ (1,0) [0|1] "" IHU
 SG_ IvtrModlnIdx : 119|8@0+ (1.0,0.0) [0.0|255.0] "Unitless" IHU
 SG_ IvtrModlnIdx_UB : 191|1@0+ (1,0) [0|1] "" IHU
 SG_ IvtrMotActModSts : 127|8@0+ (1.0,0.0) [0.0|255.0] "Unitless" IHU
 SG_ IvtrMotActModSts_UB : 190|1@0+ (1,0) [0|1] "" IHU
 SG_ IvtrOffsAg_UB : 189|1@0+ (1,0) [0|1] "" IHU
 SG_ IvtrOffsAgIvtrOffsAg : 135|32@0+ (0.000001,0.0) [0.0|4294.9672949999995] "Unitless" IHU
 SG_ IvtrOffsAgSts : 167|8@0+ (1.0,0.0) [0.0|255.0] "Unitless" IHU
 SG_ IvtrOilT : 175|8@0+ (1.0,-40.0) [-40.0|215.0] "degC" IHU
 SG_ IvtrOilT_UB : 188|1@0+ (1,0) [0|1] "" IHU
 SG_ IvtrOilTSnsrSplyV : 183|8@0+ (0.1,0.0) [0.0|25.5] "Unitless" IHU
 SG_ IvtrOilTSnsrSplyV_UB : 187|1@0+ (1,0) [0|1] "" IHU
 SG_ IvtrPhaPwmDuty_UB : 242|1@0+ (1,0) [0|1] "" IHU
 SG_ IvtrPhaPwmDutyIvtrPhaUPwmDuty : 271|8@0+ (1.0,0.0) [0.0|255.0] "Unitless" IHU
 SG_ IvtrPhaPwmDutyIvtrPhaVPwmDuty : 279|8@0+ (1.0,0.0) [0.0|255.0] "Unitless" IHU
 SG_ IvtrPhaPwmDutyIvtrPhaWPwmDuty : 287|8@0+ (1.0,0.0) [0.0|255.0] "Unitless" IHU
 SG_ IvtrQ_UB : 220|1@0+ (1,0) [0|1] "" IHU
 SG_ IvtrQAxisCurrtSp : 215|11@0+ (1.0,-1023.0) [-1023.0|1024.0] "Unitless" IHU
 SG_ IvtrQAxisU : 199|16@0+ (0.1,-1310.0) [-1310.0|5243.5] "Unitless" IHU
 SG_ IvtrReqIdWithLimn : 218|11@0+ (1.0,-1023.0) [-1023.0|1024.0] "Unitless" IHU
 SG_ IvtrReqIdWithLimn_UB : 219|1@0+ (1,0) [0|1] "" IHU
 SG_ IvtrReqIqWithLimn : 239|11@0+ (1.0,-1023.0) [-1023.0|1024.0] "Unitless" IHU
 SG_ IvtrReqIqWithLimn_UB : 244|1@0+ (1,0) [0|1] "" IHU
 SG_ IvtrResolverAg : 255|16@0+ (0.01,0.0) [0.0|655.35] "Unitless" IHU
 SG_ IvtrResolverAg_UB : 243|1@0+ (1,0) [0|1] "" IHU
 SG_ IvtrSfty_UB : 341|1@0+ (1,0) [0|1] "" IHU
 SG_ IvtrSftyFctMod : 303|8@0+ (1.0,0.0) [0.0|255.0] "Unitless" IHU
 SG_ IvtrSftySpd : 311|16@0+ (1.0,-20000.0) [-20000.0|45535.0] "rpm" IHU
 SG_ IvtrSftyTq : 327|16@0+ (1.0,-8000.0) [-8000.0|57535.0] "Unitless" IHU
 SG_ IvtrSftyTqQf : 343|2@0+ (1.0,0.0) [0.0|3.0] "Unitless" IHU
 SG_ IvtrTqDir : 295|8@0+ (1.0,0.0) [0.0|255.0] "Unitless" IHU
 SG_ IvtrTqDir_UB : 240|1@0+ (1,0) [0|1] "" IHU
 SG_ IvtrTraPhaCurrtAry_UB : 339|1@0+ (1,0) [0|1] "" IHU
 SG_ IvtrTraPhaCurrtAryU : 338|11@0+ (1.0,-1023.0) [-1023.0|1024.0] "Unitless" IHU
 SG_ IvtrTraPhaCurrtAryV : 359|11@0+ (1.0,-1023.0) [-1023.0|1024.0] "Unitless" IHU
 SG_ IvtrTraPhaCurrtAryW : 362|11@0+ (1.0,-1023.0) [-1023.0|1024.0] "Unitless" IHU
 SG_ MotorHeatrPwrCnsDes : 383|8@0+ (0.1,0.0) [0.0|25.5] "Unitless" IHU
 SG_ MotorHeatrPwrCnsDes_UB : 340|1@0+ (1,0) [0|1] "" IHU
 SG_ MotSpdForWRC : 391|16@0+ (1.0,-20000.0) [-20000.0|45535.0] "rpm" IHU
 SG_ MotSpdForWRC_UB : 423|1@0+ (1,0) [0|1] "" IHU
 SG_ MotTqEstForWRC : 407|16@0+ (1.0,-8000.0) [-8000.0|57535.0] "Unitless" IHU
 SG_ MotTqEstForWRC_UB : 422|1@0+ (1,0) [0|1] "" IHU
 SG_ OTAActvHVReq : 420|1@0+ (1,0) [0|1] "" IHU
 SG_ OTAActvHVReq_UB : 421|1@0+ (1,0) [0|1] "" IHU
 SG_ PredDrvPwrReq : 418|11@0+ (1.0,-1000.0) [-1000.0|1047.0] "kW" IHU
 SG_ PredDrvPwrReq_UB : 419|1@0+ (1,0) [0|1] "" IHU
 SG_ PredTarSoc : 497|10@0+ (0.1,0.0) [0.0|102.30000000000001] "%" IHU
 SG_ PredTarSoc_UB : 498|1@0+ (1,0) [0|1] "" IHU
 SG_ PrpsnAllwd : 502|1@0+ (1,0) [0|1] "" IHU
 SG_ PrpsnAllwd_UB : 501|1@0+ (1,0) [0|1] "" IHU
 SG_ PtTqMCU_UB : 503|1@0+ (1,0) [0|1] "" IHU
 SG_ PtTqMCUPtTqFrntMotMaxReq : 439|16@0+ (1.0,-8000.0) [-8000.0|57535.0] "Unitless" IHU
 SG_ PtTqMCUPtTqFrntMotMinReq : 455|16@0+ (1.0,-8000.0) [-8000.0|57535.0] "Unitless" IHU
 SG_ PtTqMCUPtTqReMotMaxReq : 471|16@0+ (1.0,-8000.0) [-8000.0|57535.0] "Unitless" IHU
 SG_ PtTqMCUPtTqReMotMinReq : 487|16@0+ (1.0,-8000.0) [-8000.0|57535.0] "Unitless" IHU
 SG_ RemStrt : 500|1@0+ (1,0) [0|1] "" IHU
 SG_ RemStrt_UB : 499|1@0+ (1,0) [0|1] "" IHU

CM_ SG_ 1161 DmcStsFrntToEscChks "Chks";
CM_ SG_ 1161 DmcStsFrntToEscCntr "Cntr
";
CM_ SG_ 1161 DmcStsFrntToEscDmcActAppTarTq "DMC actual appTarTq";
CM_ SG_ 1161 DmcStsFrntToEscDmcSts "DMC frint status
";
CM_ SG_ 1161 DmcStsFrntToEscDmcSWInfo "DmcSWinfo";
CM_ SG_ 1161 DrvrSteerActvChks "Confirmation of driver steer actively Checksum";
CM_ SG_ 1161 DrvrSteerActvCntr "Confirmation of driver steer actively Counter";
CM_ SG_ 1161 DrvrSteerActvDrvrSteerActv "Indicates if the driver steers actively";
CM_ SG_ 1161 ElecMot2IDc "DC current measured by the front inverter";
CM_ SG_ 1161 EngN2 "Engine Speed [rpm]";
CM_ SG_ 1161 EpbAvlSecChks "checksum";
CM_ SG_ 1161 EpbAvlSecCntr "counter";
CM_ SG_ 1161 EpbAvlSecCommunicationAvailable "Host and slave communication is avaliable";
CM_ SG_ 1161 EpbAvlSecHostAvailabilityFull "Host fully available";
CM_ SG_ 1161 EpbAvlSecHostAvailabilityRelOnly "Host Available - release only";
CM_ SG_ 1161 EpbAvlSecReserved1 "reserve";
CM_ SG_ 1161 EpbAvlSecReserved2 "reserve";
CM_ SG_ 1161 EpbAvlSecReserved3 "reserve";
CM_ SG_ 1161 EpbAvlSecReserved4 "reserve";
CM_ SG_ 1161 EpbAvlSecReserved5 "reserve";
CM_ SG_ 1161 EpbAvlSecReserved6 "reserve";
CM_ SG_ 1161 EpbAvlSecReserved7 "reserve";
CM_ SG_ 1161 IsgErrIndcnReq "MIL ilumination req from IGM";
CM_ SG_ 1161 IsgLimnIndcn "LOS signal";
CM_ SG_ 1161 IsgSpdActSgnSafeChks "checksum
";
CM_ SG_ 1161 IsgSpdActSgnSafeCntr "counter";
CM_ SG_ 1161 IsgSpdActSgnSafeIsgSpdWSgnTyp "Safe EM motor shaft speed.";
CM_ SG_ 1161 IsgSpdActSgnSafeQf "quality factor";
CM_ SG_ 1161 IsgTqAvlMax "Max available torque";
CM_ SG_ 1161 IsgTqAvlMin "Min available torque";
CM_ SG_ 1161 Mot1ReqSafeChks "Checksum";
CM_ SG_ 1161 Mot1ReqSafeCntr "Rolling Counter";
CM_ SG_ 1161 Mot1ReqSafemod "P1 mode request";
CM_ SG_ 1161 Mot1ReqSafeRsv "Reserved for FuSa";
CM_ SG_ 1161 Mot1ReqSafespd "P1 speed  request";
CM_ SG_ 1161 Mot1ReqSafetq "P1 torque  request";
CM_ SG_ 1161 Mot3ReqSafeChks "Checksum";
CM_ SG_ 1161 Mot3ReqSafeCntr "Rolling Counter";
CM_ SG_ 1161 Mot3ReqSafemod "P3 mode request";
CM_ SG_ 1161 Mot3ReqSafeRsv "Reserved for FuSa";
CM_ SG_ 1161 Mot3ReqSafespd "P3 speed  request";
CM_ SG_ 1161 Mot3ReqSafetq "P3 torque  request";
CM_ SG_ 1161 PtClu0TqReq "Clutch C0 torque request (Unit: Nm)";
CM_ SG_ 1161 PtCluTq2Req "Requset crank shaft torque";
CM_ SG_ 1161 PtCluTqDyn "Acual crank shaft torque. Crankshaft torque dynamic";
CM_ SG_ 1161 PtCluTqPtCluTq "Acual crank shaft torque. Crankshaft torque";
CM_ SG_ 1161 PtCluTqQly "Acual crank shaft torque. Crankshaft torque quality factor";
CM_ SG_ 1161 PtGearTarReq "DHT Gear target request";
CM_ SG_ 1161 PtParkReqToWhlsRe "Powertrain park request to rear axle to park/hold the vehicle";
CM_ SG_ 1161 SteerExtFctStsChks "Confirmation of steer external function status Checksum";
CM_ SG_ 1161 SteerExtFctStsCntr "Confirmation of steer external function status Counter";
CM_ SG_ 1161 SteerExtFctStsDrvrSteerOvrd "Steering request of asking driver to take over";
CM_ SG_ 1161 SteerExtFctStsExtFctLowerLimActive "Column  Torque Lower Limit ";
CM_ SG_ 1161 SteerExtFctStsExtFctRateLimActive "External function rate Limit ";
CM_ SG_ 1161 SteerExtFctStsExtFctUpperLimActive "Column Torque Upper Limit ";
CM_ SG_ 1161 SteerExtFctStsExtSafeLimActive "External function torque output vs defined safety limiters ";
CM_ SG_ 1161 SteerExtFctStsLatAgReqNotInRange "Pinion angle /current trajectory between primary and fall back ";
CM_ SG_ 1161 SteerExtFctStsLatCtrlReqNotInRange "Lateral Ctrl request and primary and fall back ";
CM_ SG_ 1161 SuspFailrStsChks "This DATA-Element is used by the air suspension to inform that a severe error is present in the system. Checksum";
CM_ SG_ 1161 SuspFailrStsCntr "This DATA-Element is used by the air suspension to inform that a severe error is present in the system. Counter";
CM_ SG_ 1161 SuspFailrStsSuspFailrSts "This DATA-Element is used by the air suspension to inform that a severe error is present in the system. Error type.";
CM_ SG_ 1161 SuspFailrStsTypQf "This DATA-Element is used by the air suspension to inform that a severe error is present in the system. Quality Factor";
CM_ SG_ 1161 TqAssAddl "Total torque at motor";
CM_ SG_ 1161 TrlrModVMMFltSts "trailer mode VMM usage mode transition fault status.
0: No fault;
1: Fault.";
CM_ SG_ 1161 TrsmActrPosnSafeAuxTrsmActrPosn "Transmission measured gear lever position";
CM_ SG_ 1161 TrsmActrPosnSafeAuxTrsmActrPosnChks "Transmission measured gear lever position";
CM_ SG_ 1161 TrsmActrPosnSafeAuxTrsmActrPosnCntr "Transmission measured gear lever position";
CM_ SG_ 1161 TrsmModNotAvlSts "TCM uses signal Transmissions Mode Not Available Status to inform ECM which modes are unavailable (Neutral, Reverse, Drive, LockUp stuck-Off or LockUp stuck-On). Default value - 0 (no modes unavailable). Bit 0-7";
CM_ SG_ 1161 TrsmNeutFailr "Transmission Neutral Failiure. Neutral not possible flag. 0 - Neutral possible, 1 - Neutral not possible. ";
CM_ SG_ 1161 TrsmOilT "Transmission oil temperature";
CM_ SG_ 1161 TrsmTqLossChks "Actual torque losses in the transmission";
CM_ SG_ 1161 TrsmTqLossCntr "Actual torque losses in the transmission";
CM_ SG_ 1161 TrsmTqLossTrsmTqEff "Actual torque losses in the transmission";
CM_ SG_ 1161 TrsmTqLossTrsmTqLoss "Actual torque losses in the transmission";
CM_ SG_ 1161 WrmUpCyc "Transition from 0 to 1 indicates a start of a warm up cycle";
CM_ SG_ 1173 BswRstAddress "Last reset address

";
CM_ SG_ 1173 BswRstReason "Last reset reason

";
CM_ SG_ 1173 CarLoctrToExtrLiVisReq "Request from Car Locator to Exterior light to flash exterior lights when vehicle search is active.";
CM_ SG_ 1173 DiagcSigSWM "internal ECU errors";
CM_ SG_ 1173 EnaOfflineMonitor "Rain monitoring if car is Off.";
CM_ SG_ 1173 EngLoadReqElec "Request to Dynamic load control to increase or decrease electrical loads";
CM_ SG_ 1173 EngNSafeEngN "Engine Speed [rpm] and Engine Speed derivative [rpm/s]";
CM_ SG_ 1173 EngNSafeEngNChks "Engine Speed [rpm] and Engine Speed derivative [rpm/s]";
CM_ SG_ 1173 EngNSafeEngNCntr "Engine Speed [rpm] and Engine Speed derivative [rpm/s]";
CM_ SG_ 1173 EngNSafeEngNGrdt "Engine Speed [rpm] and Engine Speed derivative [rpm/s]";
CM_ SG_ 1173 EngRunngReqByVehModMgrChassie "Chassie caused engine restart during start stop.";
CM_ SG_ 1173 EngRunngReqByVehModMgrClimate "Climate caused engine restart during start stop.";
CM_ SG_ 1173 EngRunngReqByVehModMgrElectricalSystem "ElectricalSystem Chassie caused engine restart during start stop.";
CM_ SG_ 1173 EngRunngReqByVehModMgrTrailerPrsnt "TrailerPrsnt caused engine restart during start stop.";
CM_ SG_ 1173 EngSt1WdSts1 "Signaling the state of the powerpack(without E2E)";
CM_ SG_ 1173 FltOfBeamHiDrv "Fault status of high beam of driver side";
CM_ SG_ 1173 FltOfBeamLoDrv "Fault status of low beam of driver side";
CM_ SG_ 1173 FltOfCenHiMntdStopLamp "Fault status of Central High Mounted Stop Lamp.";
CM_ SG_ 1173 FltOfCenHiMntdStopLamp1 "Fault status of Central High Mounted Stop Lamp for Lotus";
CM_ SG_ 1173 FltOfDaytiRunngLampDrv "Fault status of DRL Lamp of driver side";
CM_ SG_ 1173 FltOfFrntFogLampDrv "Fault status of front fog Lamp of driver side";
CM_ SG_ 1173 FltOfFrntPosnLampDrv "Fault status of front position Lamp of driver side";
CM_ SG_ 1173 FltOfRePosnLampDrv "Fault status of rear position Lamp of driver side";
CM_ SG_ 1173 FltOfStopLampDrv "Fault status of stop Lamp of driver side";
CM_ SG_ 1173 FltOfStopLampPass "Fault status of stop Lamp of passenger side";
CM_ SG_ 1173 FrLeReadLiReq "The Front Row Left side reading light request with intensity level.";
CM_ SG_ 1173 FrRiReadLiReq "The Front Row Right side reading light request with intensity level.";
CM_ SG_ 1173 HornSwitchSts "The status of the switch in the wheel that controls the horn";
CM_ SG_ 1173 HvActvForVehModReq "This signal is used to request activation of the HV system.";
CM_ SG_ 1173 HvActvSts "Indicate HV avtivation status.";
CM_ SG_ 1173 HvCoolgPwrAllwd "Power available for cooling in real time. From wall socket if plugged in, from propulsion or high voltage battery.";
CM_ SG_ 1173 HvHeatgPwrAllwd "Power available for heating in real time. From wall socket if plugged in, from propulsion or high voltage battery.";
CM_ SG_ 1173 HwRowFrstDrvrFrntHeiMotCtrl "Driver Seat Front Height Motor Control";
CM_ SG_ 1173 HwRowFrstDrvrHeiMotCtrl "Driver Seat Height Motor Control";
CM_ SG_ 1173 HwRowFrstDrvrInclMotCtrl "Driver Seat Inclination Motor Control";
CM_ SG_ 1173 HwRowFrstDrvrSldMotCtrl "Driver Seat Slide Motor Control";
CM_ SG_ 1173 IndicatorIntensityLvl "The Global Function indicator intensity level .
This is broadcast by ZCUD, and the receive ECU shall follow the signal value to adjust the function indicator intensity level.";
CM_ SG_ 1173 IntLightTreadPlateSupply "Interface for the TreadPlateIllmnSupply output. 
HW interface.";
CM_ SG_ 1173 IntrBriStsFromIf "interior Brightnes status from inteface.";
CM_ SG_ 1173 IntrLiRoofAUTOIndication "Interior lght auto swictch indication";
CM_ SG_ 1173 IntrMirrCmdDrvrSide "Command signals from CEM (master) to IRMM (slave). Left/Right side driver: 0 = Right side driver, 1 = Left side driver";
CM_ SG_ 1173 IntrMirrCmdIntrMirrAsyFanCmpMag "Command signals from CEM (master) to IRMM (slave). Magnetic compensation for the compass with respect to ASDM cooling fan: 0 = Off, 1 = On";
CM_ SG_ 1173 IntrMirrCmdIntrMirrDiagcRst "Command signals from CEM (master) to IRMM (slave). Diagnostic reset: 0 = Normal operation, 1 = Clear internal failure, perform diagnostic reset";
CM_ SG_ 1173 IntrMirrCmdIntrMirrDimSnvty "Command signals from CEM (master) to IRMM (slave). EC Sensitivity: 0 = Normal, 1 = Dark, 2 = Light, 3 = Inhibit";
CM_ SG_ 1173 IntrMirrCmdIntrMirrEna "Command signals from CEM (master) to IRMM (slave). Enable mode: 0 = Disable autodim and compass, 1 = Enable autodim and compass";
CM_ SG_ 1173 IntrMirrCmdIntrMirrInhbDim "Command signals from CEM (master) to IRMM (slave). EC Inhibit: 0 = Normal operation, 1 = Inhibit EC operation";
CM_ SG_ 1173 IntrMirrCmdIntrMirrWindHeatrCmpMag "Command signals from CEM (master) to IRMM (slave). Magnetic compensation for the compass with respect to window defroster: 0 = Off, 1 = On";
CM_ SG_ 1173 LatCtrlModCfmdChks "Confirmation of lateral control request Confirmed lateral mode";
CM_ SG_ 1173 LatCtrlModCfmdCntr "Confirmation of lateral control request Confirmed lateral mode";
CM_ SG_ 1173 LatCtrlModCfmdLatCtrlMod "Confirmation of lateral control request Confirmed lateral mode";
CM_ SG_ 1173 MirrDefrstAtDrvrCmd "Activation signal exterior rear view mirror electrical defroster driver side.";
CM_ SG_ 1173 MirrSeldIndcn "Tells the DDS which mirror function LED shall be activated/deactivated.";
CM_ SG_ 1173 PanicAlrmAcoustReq "Request from Panic Alarm to Sound Signaling to sound the vehicle horn when PA active.";
CM_ SG_ 1173 PanicAlrmToExtrLiVisReq "Request from Panic Alarm to Exterior light to flash exterior lights when PA active.";
CM_ SG_ 1173 PropsEnabfromAlcoLock "Propulsion enabled/disabled from Alcohol Lock";
CM_ SG_ 1173 PtActvnReq1WdPtActvnReq "Request to activate drivline sent to powertrain.";
CM_ SG_ 1173 PwrCnsVisy "Info about the total power consumed by the loads Mirror, Rear Window and Windscreen Defroster";
CM_ SG_ 1173 PwrCritDesVisy "The total amount of power that the loads (Front windscreen defroster, Rear window defroster, Rear view mirror defrosters) would consume to be active and identified.";
CM_ SG_ 1173 PwrEstimdAtStbForVisy "Power required by visibility at engine standby (applicable for start and stop)";
CM_ SG_ 1173 PwrNormDesVisy "The total amount of power that the loads requested to be activated would consume if turned on.";
CM_ SG_ 1173 RainSensActvn "Rain sensor function activation command to the rain sensor and the wiper motor.";
CM_ SG_ 1173 RainSnsrSnvtyForUsrSnvty0 "Signals used to map the different sensitivity settings that can be selected by the driver to an internal sensitivity setting in the rain sensor. This is used to trim the sensitivity of the different rain sensor settings that the driver can select using the thumbwheel.";
CM_ SG_ 1173 RainSnsrSnvtyForUsrSnvty1 "Signals used to map the different sensitivity settings that can be selected by the driver to an internal sensitivity setting in the rain sensor. This is used to trim the sensitivity of the different rain sensor settings that the driver can select using the thumbwheel.";
CM_ SG_ 1173 RainSnsrSnvtyForUsrSnvty2 "Signals used to map the different sensitivity settings that can be selected by the driver to an internal sensitivity setting in the rain sensor. This is used to trim the sensitivity of the different rain sensor settings that the driver can select using the thumbwheel.";
CM_ SG_ 1173 RainSnsrSnvtyForUsrSnvty3 "Signals used to map the different sensitivity settings that can be selected by the driver to an internal sensitivity setting in the rain sensor. This is used to trim the sensitivity of the different rain sensor settings that the driver can select using the thumbwheel.";
CM_ SG_ 1173 RainSnsrSnvtyForUsrSnvty4 "Signals used to map the different sensitivity settings that can be selected by the driver to an internal sensitivity setting in the rain sensor. This is used to trim the sensitivity of the different rain sensor settings that the driver can select using the thumbwheel.";
CM_ SG_ 1173 RainSnsrSnvtyForUsrSnvty5 "Signals used to map the different sensitivity settings that can be selected by the driver to an internal sensitivity setting in the rain sensor. This is used to trim the sensitivity of the different rain sensor settings that the driver can select using the thumbwheel.";
CM_ SG_ 1173 RainSnsrSnvtyForUsrSnvty6 "Signals used to map the different sensitivity settings that can be selected by the driver to an internal sensitivity setting in the rain sensor. This is used to trim the sensitivity of the different rain sensor settings that the driver can select using the thumbwheel.";
CM_ SG_ 1173 ReAdaptReq "Re-adaption request signal";
CM_ SG_ 1173 RelHumSnsrErr "compartment relative humidity sensor error information.";
CM_ SG_ 1173 RemStrtMsgToDrvrRemStrtBlkd1 "Messages from EngineRemoteStart to DIM.";
CM_ SG_ 1173 RemStrtMsgToDrvrRemStrtDev1 "Messages from EngineRemoteStart to DIM.";
CM_ SG_ 1173 RlyActvnForRoofCurtClsAut "Activation of Relay for Roof Curtain";
CM_ SG_ 1173 SecRowLeReadLiReq "The Second Row Left side reading light request include ON/OFF and intensity level.";
CM_ SG_ 1173 SecRowRiReadLiReq "The Second Row Right side reading light request with intensity level.";
CM_ SG_ 1173 SteerLockEnagOfPrpsn "CEM ECM message, information if propulsion shall be allowed or inhibited depending on steering column unlock or lock.";
CM_ SG_ 1173 SteerWhlTqAddl "Overlay torque from external requests";
CM_ SG_ 1173 StsOfLedHiBeamLe "Status of Led High Beam Left.";
CM_ SG_ 1173 StsOfLedHiBeamRi "Status of High Beam Led Right.";
CM_ SG_ 1173 StsOfLedLoBeamLe "Status of Led Low Beam Left.";
CM_ SG_ 1173 StsOfLedLoBeamRi "Status of Low Beam Led Right";
CM_ SG_ 1173 StsOfSwvlgLe "Status of Bending Light Left.";
CM_ SG_ 1173 StsOfSwvlgRi "Status of Bending Light Right.";
CM_ SG_ 1173 SunCurtEna "Authorization for the sun curtain to move";
CM_ SG_ 1173 SunRoofAndCurtExtCmd "Commands to move the curtain and panel, also used for initialization";
CM_ SG_ 1173 SwtBeamHi "The signal shall be distributed periodically.
0-Neutral(middle, neutral), 1-Flash(pull 1step, monostabile), 2-Hi Beam ON(push, monostabile), 3-Hi beam OFF(pull 2step, monostabile).";
CM_ SG_ 1173 SwtLiHzrdWarn "Hazard warning light switch signal.
0-not pressed, 1-pressed";
CM_ SG_ 1173 TankFlapReqFromSwtIntrFild "TankFlapReqFromSwtIntFild - Tank Flap Request From Interior Switch (Filtered)";
CM_ SG_ 1173 TrOpenerReqTrigSrc "TrOpenerReq - Tailgate or Bootlid Opener Request
Request signal to POT ECU. Signal contains type of request and trig source of request.";
CM_ SG_ 1173 TrOpenerReqTrOpenerReq "TrOpenerReq - Tailgate or Bootlid Opener Request
Request signal to POT ECU. Signal contains type of request and trig source of request";
CM_ SG_ 1173 TrsmParkLockSt "Transmission park lock state";
CM_ SG_ 1173 TrsmTqRat "Transmission Torque Ratio. Actual ratio between the input and the output torque of the transmission and torque converter This includes torque converter effects, clutch slip effects, and all gearing effects including final drive.";
CM_ SG_ 1173 WiprActv "Information regarding if the wiper is active or not.";
CM_ SG_ 1173 WiprInWipgAr "Information regarding wiper position on the windscreen.";
CM_ SG_ 1173 WiprMotFrntLvrCmdSafeLvrInHiSpdPosnSafe "Signals requesting different wiping modes depending on the positions of the wiper stalk.  Wiper lever in high speed position (2-bit coded)";
CM_ SG_ 1173 WiprMotFrntLvrCmdSafeLvrInIntlPosn "Signals requesting different wiping modes depending on the positions of the wiper stalk.  Wiper lever in interval position";
CM_ SG_ 1173 WiprMotFrntLvrCmdSafeLvrInLoSpdPosnSafe "Signals requesting different wiping modes depending on the positions of the wiper stalk.  Wiper lever in low speed position (2-bit coded)";
CM_ SG_ 1173 WiprMotFrntLvrCmdSafeLvrInSnglStrokePos "Signals requesting different wiping modes depending on the positions of the wiper stalk.  Wiper lever in single stroke position";
CM_ SG_ 81 ClsdDueToRain "Signal to telematics that the sunroof was successully closed due to rain";
CM_ SG_ 81 DKDataFromCEMAcknowledgment "Packet received acknowledgement";
CM_ SG_ 81 DKDataFromCEMDKDataByte1 "Byte number 1";
CM_ SG_ 81 DKDataFromCEMDKDataByte2 "Byte number 2";
CM_ SG_ 81 DKDataFromCEMDKDataByte3 "Byte number 3";
CM_ SG_ 81 DKDataFromCEMDKDataByte4 "Byte number 4";
CM_ SG_ 81 DKDataFromCEMDKDataByte5 "Byte number 5";
CM_ SG_ 81 DKDataFromCEMDKDataByte6 "Byte number 6";
CM_ SG_ 81 DKDataFromCEMHeader "Packet Header";
CM_ SG_ 659 AcCmprVlvICns "Ac variable displacement valve current consumption.";
CM_ SG_ 659 DiagFrameForECMByte0 "Sequence number.";
CM_ SG_ 659 DiagFrameForECMByte1 "ECM diagnostic message1.";
CM_ SG_ 659 DiagFrameForECMByte2 "ECM diagnostic message2.";
CM_ SG_ 659 DiagFrameForECMByte3 "ECM diagnostic message3.";
CM_ SG_ 659 DiagFrameForECMByte4 "ECM diagnostic message4.";
CM_ SG_ 659 DiagFrameForECMByte5 "ECM diagnostic message5.";
CM_ SG_ 659 DiagFrameForECMByte6 "ECM diagnostic message6.";
CM_ SG_ 659 DiagFrameForECMByte7 "ECM diagnostic message7.";
CM_ SG_ 659 DstEstimdToEmptyForDrvgElecPred "Predicted distance till empty in economic driving behavior (e.g. shut down AC)";
CM_ SG_ 659 EngAmbTCalcd "Ambient Temparature calculated by ECM using engine temperature sensors";
CM_ SG_ 659 HeatrPmpIAct "Heater pump actual current.";
CM_ SG_ 659 HeatrPmpPwrCns "Heater pump actual power consumption.";
CM_ SG_ 659 HeatrPmpUAct "Heater pump actual voltage.";
CM_ SG_ 659 HvBattPmpPwrCns "Coolant pump power consumption in battery cooling circuit.";
CM_ SG_ 659 HvBattThermInfoCorrInFuturePwrAtTime "Corrected battery power request at time in the future. ";
CM_ SG_ 659 HvBattThermInfoCorrInFutureSequenceNo "Sequence number";
CM_ SG_ 659 HvBattThermInfoCorrInFutureTempAtTime "Correct battery temperature at time in the future.";
CM_ SG_ 659 HvBattThermInfoCorrInFutureThermModAtTime "Corrected battery thermal mode at time in the future.";
CM_ SG_ 659 HvBattThermInfoCorrInFutureTime "Corrected time in the future";
CM_ SG_ 659 HvBattThermInfoCorrInFutureVersionNo "Version number";
CM_ SG_ 659 HvWtrHeatrWtrTDes "Water temperature desired from heating manager.";
CM_ SG_ 659 IsgCooltFlowMinReq2 "Minimum coolant flow required by EDS";
CM_ SG_ 659 IsgHeatPwrAct "The actual electrical energy consumption for active heating of front motor";
CM_ SG_ 659 IsgHeatPwrMax "The actual electrical energy consumption for active heating of rear motor";
CM_ SG_ 659 LiBattInPWLock "Li-ion battery power locking enable signal
When BMS2 sends BattFltStsPrim=15,set LiBattInPWLock=1, indicating that the Li-ion battery power is about to be locked, and LiBattInPWLock=0, indicating that the lithium battery power is not locked.

";
CM_ SG_ 659 PrpsnDataPrdACnt "Counter";
CM_ SG_ 659 PrpsnDataPrdAData1 "Data - Record data A for period gathering";
CM_ SG_ 659 PrpsnDataPrdAData2 "Data - Record data A for period gathering";
CM_ SG_ 659 PrpsnDataPrdAData3 "Data - Record data A for period gathering";
CM_ SG_ 659 PrpsnDataPrdAData4 "Data - Record data A for period gathering";
CM_ SG_ 659 PrpsnDataPrdAData5 "Data - Record data A for period gathering";
CM_ SG_ 659 PrpsnDataPrdAData6 "Data - Record data A for period gathering";
CM_ SG_ 659 PrpsnDataPrdAData7 "Data - Record data A for period gathering";
CM_ SG_ 659 PrpsnDataPrdBCnt "Counter";
CM_ SG_ 659 PrpsnDataPrdBData1 "Data - Record data B for period gathering";
CM_ SG_ 659 PrpsnDataPrdBData2 "Data - Record data B for period gathering";
CM_ SG_ 659 PrpsnDataPrdBData3 "Data - Record data B for period gathering";
CM_ SG_ 659 PrpsnDataPrdBData4 "Data - Record data B for period gathering";
CM_ SG_ 659 PrpsnDataPrdBData5 "Data - Record data B for period gathering";
CM_ SG_ 659 PrpsnDataPrdBData6 "Data - Record data B for period gathering";
CM_ SG_ 659 PrpsnDataPrdBData7 "Data - Record data B for period gathering";
CM_ SG_ 659 PtCoolgPostRunActv "Flag to request Usage Mode Inactive for powertrain cooling need.";
CM_ SG_ 659 PtTotBrkTqReqPtTotBrkTqEna "Enable signal indicating VDDM whether it needs to execute e-pedal torque request from ECM";
CM_ SG_ 659 PtTotBrkTqReqPtTotBrkTqReq "Total brake torque request for e-Pedal";
CM_ SG_ 659 RainSnsrActvnErrToHmi "Rain sensor function error is detected";
CM_ SG_ 659 ResrvdSigForCCM1 "Reserved signal 1 for CCM.";
CM_ SG_ 659 ResrvdSigForCCM2 "Reserved signal 2 for CCM.";
CM_ SG_ 659 ResrvdSigForCCM3 "Reserved signal 3 for CCM.";
CM_ SG_ 659 ResrvdSigForCCM4 "Reserved signal 4 for CCM.";
CM_ SG_ 659 StandStillReqForCmftToBrkgForEPedl "Standstill request indicating needing to stop the vehicle when vehicle speed is low during e-Pedal mode.";
CM_ SG_ 659 SteerLockMgrWarnIndcn "SCL warning message to be shown in DIM";
CM_ SG_ 659 StrtRemSts1WdStrtRemSts "Status signal for EngineRemoteStart send to climate for control of climatization.";
CM_ SG_ 659 VehPropSts "Vehicle propulsion status indicating vehicle is propulsive or not";
CM_ SG_ 659 WiprSysFailrDetdSafe "Cleaning (wiping and washing) system failure present.";
CM_ SG_ 659 WshrFldTankStsToHMI "Information regarding if the washer fluid level is low.";
CM_ SG_ 569 ConvPwrRelsForbRelsFrbn1 "Signal used to notify HMI if the Conventional Door Power Release has been forbidden after a request
Boolean 1 = [RelsMtnFrbn] 
Boolean 2 = [RelsFrbn1]";
CM_ SG_ 569 ConvPwrRelsForbRelsMtnFrbn "Signal used to notify HMI if the Conventional Door Power Release has been forbidden after a request
Boolean 1 = [RelsMtnFrbn] 
Boolean 2 = [RelsFrbn1]";
CM_ SG_ 569 HeatrPmpStatCooltPmpDryErr "water pump MT Dryrun error";
CM_ SG_ 569 HeatrPmpStatCooltPmpEmgyModSts "water pump MT, Status Emergency mode";
CM_ SG_ 569 HeatrPmpStatCooltPmpErrSts "water pump error status";
CM_ SG_ 569 HeatrPmpStatCooltPmpI "Actual current consumption";
CM_ SG_ 569 HeatrPmpStatCooltPmpIErr "water pump MT current error";
CM_ SG_ 569 HeatrPmpStatCooltPmpMonrSpd "water pump MT, RPM Monitoring";
CM_ SG_ 569 HeatrPmpStatCooltPmpPostRunSts "water pump post run status";
CM_ SG_ 569 HeatrPmpStatCooltPmpSetPostRunReq "water pump set post run speed request";
CM_ SG_ 569 HeatrPmpStatCooltPmpSetSpdReq "water pump MT Set speed";
CM_ SG_ 569 HeatrPmpStatCooltPmpSpd "Actual speed from coolant pump";
CM_ SG_ 569 HeatrPmpStatCooltPmpT "water pump MT Temperature";
CM_ SG_ 569 HeatrPmpStatCooltPmpTErr "water pump MT temperature error";
CM_ SG_ 569 HeatrPmpStatCooltPmpU "water pump MT Voltage";
CM_ SG_ 569 HeatrPmpStatCooltPmpUErr "water pump MT voltage error";
CM_ SG_ 569 HeatrPmpStatCooltPmpUnstallSts "water pump MT, Deblocking";
CM_ SG_ 82 NFCAndBLEKeyDiReqData1 "data";
CM_ SG_ 82 NFCAndBLEKeyDiReqData10 "data";
CM_ SG_ 82 NFCAndBLEKeyDiReqData11 "data";
CM_ SG_ 82 NFCAndBLEKeyDiReqData12 "data";
CM_ SG_ 82 NFCAndBLEKeyDiReqData13 "data";
CM_ SG_ 82 NFCAndBLEKeyDiReqData14 "data";
CM_ SG_ 82 NFCAndBLEKeyDiReqData15 "data";
CM_ SG_ 82 NFCAndBLEKeyDiReqData16 "data";
CM_ SG_ 82 NFCAndBLEKeyDiReqData2 "data";
CM_ SG_ 82 NFCAndBLEKeyDiReqData3 "data";
CM_ SG_ 82 NFCAndBLEKeyDiReqData4 "data";
CM_ SG_ 82 NFCAndBLEKeyDiReqData5 "data";
CM_ SG_ 82 NFCAndBLEKeyDiReqData6 "data";
CM_ SG_ 82 NFCAndBLEKeyDiReqData7 "data";
CM_ SG_ 82 NFCAndBLEKeyDiReqData8 "data";
CM_ SG_ 82 NFCAndBLEKeyDiReqData9 "data";
CM_ SG_ 82 NFCKeySearchReqKeyLocn "the zone of key search ";
CM_ SG_ 82 NFCKeySearchReqTirgger "which triggered key search";
CM_ SG_ 52 BodyDataTraceZCUDM1Functiondevpsignalgroup1 "ZCUDM internal signal group1.";
CM_ SG_ 52 BodyDataTraceZCUDM1Functiondevpsignalgroup2 "ZCUDM internal signal group2.";
CM_ SG_ 52 BodyDataTraceZCUDM1Functiondevpsignalgroup3 "ZCUDM internal signal group3.";
CM_ SG_ 52 BodyDataTraceZCUDM1Functiondevpsignalgroup4 "ZCUDM internal signal group4.";
CM_ SG_ 52 BodyDataTraceZCUDM1Functiondevpsignalgroup5 "ZCUDM internal signal group5.";
CM_ SG_ 52 BodyDataTraceZCUDM1Functiondevpsignalgroup6 "ZCUDM internal signal group6.";
CM_ SG_ 52 BodyDataTraceZCUDM1Functiondevpsignalgroup7 "ZCUDM internal signal group7.";
CM_ SG_ 52 BodyDataTraceZCUDM1Functiondevpsignalgroup8 "ZCUDM internal signal group8.";
CM_ SG_ 52 BodyDataTraceZCUDM2Functiondevpsignalgroup1 "ZCUDM internal signal group9.";
CM_ SG_ 52 BodyDataTraceZCUDM2Functiondevpsignalgroup2 "ZCUDM internal signal group10.";
CM_ SG_ 52 BodyDataTraceZCUDM2Functiondevpsignalgroup3 "ZCUDM internal signal group11.";
CM_ SG_ 52 BodyDataTraceZCUDM2Functiondevpsignalgroup4 "ZCUDM internal signal group12.";
CM_ SG_ 52 BodyDataTraceZCUDM2Functiondevpsignalgroup5 "ZCUDM internal signal group13.";
CM_ SG_ 52 BodyDataTraceZCUDM2Functiondevpsignalgroup6 "ZCUDM internal signal group14.";
CM_ SG_ 52 BodyDataTraceZCUDM2Functiondevpsignalgroup7 "ZCUDM internal signal group15.";
CM_ SG_ 52 BodyDataTraceZCUDM2Functiondevpsignalgroup8 "ZCUDM internal signal group16.";
CM_ SG_ 52 BodyDataTraceZCUDM3Functiondevpsignalgroup1 "ZCUDM internal signal group17.";
CM_ SG_ 52 BodyDataTraceZCUDM3Functiondevpsignalgroup2 "ZCUDM internal signal group18.";
CM_ SG_ 52 BodyDataTraceZCUDM3Functiondevpsignalgroup3 "ZCUDM internal signal group19.";
CM_ SG_ 52 BodyDataTraceZCUDM3Functiondevpsignalgroup4 "ZCUDM internal signal group20.";
CM_ SG_ 52 BodyDataTraceZCUDM3Functiondevpsignalgroup5 "ZCUDM internal signal group21.";
CM_ SG_ 52 BodyDataTraceZCUDM3Functiondevpsignalgroup6 "ZCUDM internal signal group22.";
CM_ SG_ 52 BodyDataTraceZCUDM3Functiondevpsignalgroup7 "ZCUDM internal signal group23.";
CM_ SG_ 52 BodyDataTraceZCUDM3Functiondevpsignalgroup8 "ZCUDM internal signal group24.";
CM_ SG_ 52 BodyDataTraceZCUDM4Functiondevpsignalgroup1 "ZCUDM internal signal group25.";
CM_ SG_ 52 BodyDataTraceZCUDM4Functiondevpsignalgroup2 "ZCUDM internal signal group26.";
CM_ SG_ 52 BodyDataTraceZCUDM4Functiondevpsignalgroup3 "ZCUDM internal signal group27.";
CM_ SG_ 52 BodyDataTraceZCUDM4Functiondevpsignalgroup4 "ZCUDM internal signal group28.";
CM_ SG_ 52 BodyDataTraceZCUDM4Functiondevpsignalgroup5 "ZCUDM internal signal group29";
CM_ SG_ 52 BodyDataTraceZCUDM4Functiondevpsignalgroup6 "ZCUDM internal signal group30.";
CM_ SG_ 52 BodyDataTraceZCUDM4Functiondevpsignalgroup7 "ZCUDM internal signal group31.";
CM_ SG_ 52 BodyDataTraceZCUDM4Functiondevpsignalgroup8 "ZCUDM internal signal group32.";
CM_ SG_ 52 BodyDataTraceZCUDM5Functiondevpsignalgroup1 "ZCUDM internal signal group33.";
CM_ SG_ 52 BodyDataTraceZCUDM5Functiondevpsignalgroup2 "ZCUDM internal signal group34.";
CM_ SG_ 52 BodyDataTraceZCUDM5Functiondevpsignalgroup3 "ZCUDM internal signal group35.";
CM_ SG_ 52 BodyDataTraceZCUDM5Functiondevpsignalgroup4 "ZCUDM internal signal group36.";
CM_ SG_ 52 BodyDataTraceZCUDM5Functiondevpsignalgroup5 "ZCUDM internal signal group37.";
CM_ SG_ 52 BodyDataTraceZCUDM5Functiondevpsignalgroup6 "ZCUDM internal signal group38.";
CM_ SG_ 52 BodyDataTraceZCUDM5Functiondevpsignalgroup7 "ZCUDM internal signal group39.";
CM_ SG_ 52 BodyDataTraceZCUDM5Functiondevpsignalgroup8 "ZCUDM internal signal group40.";
CM_ SG_ 52 BodyDataTraceZCUDM6Functiondevpsignalgroup1 "ZCUDM internal signal group41.";
CM_ SG_ 52 BodyDataTraceZCUDM6Functiondevpsignalgroup2 "ZCUDM internal signal group42.";
CM_ SG_ 52 BodyDataTraceZCUDM6Functiondevpsignalgroup3 "ZCUDM internal signal group43.";
CM_ SG_ 52 BodyDataTraceZCUDM6Functiondevpsignalgroup4 "ZCUDM internal signal group44.";
CM_ SG_ 52 BodyDataTraceZCUDM6Functiondevpsignalgroup5 "ZCUDM internal signal group45.";
CM_ SG_ 52 BodyDataTraceZCUDM6Functiondevpsignalgroup6 "ZCUDM internal signal group46.";
CM_ SG_ 52 BodyDataTraceZCUDM6Functiondevpsignalgroup7 "ZCUDM internal signal group47.";
CM_ SG_ 52 BodyDataTraceZCUDM6Functiondevpsignalgroup8 "ZCUDM internal signal group48.";
CM_ SG_ 52 BodyDataTraceZCUDM7Functiondevpsignalgroup1 "ZCUDM internal signal group49.";
CM_ SG_ 52 BodyDataTraceZCUDM7Functiondevpsignalgroup2 "ZCUDM internal signal group50.";
CM_ SG_ 52 BodyDataTraceZCUDM7Functiondevpsignalgroup3 "ZCUDM internal signal group51.";
CM_ SG_ 52 BodyDataTraceZCUDM7Functiondevpsignalgroup4 "ZCUDM internal signal group52.";
CM_ SG_ 52 BodyDataTraceZCUDM7Functiondevpsignalgroup5 "ZCUDM internal signal group53.";
CM_ SG_ 52 BodyDataTraceZCUDM7Functiondevpsignalgroup6 "ZCUDM internal signal group54.";
CM_ SG_ 52 BodyDataTraceZCUDM7Functiondevpsignalgroup7 "ZCUDM internal signal group55.";
CM_ SG_ 52 BodyDataTraceZCUDM7Functiondevpsignalgroup8 "ZCUDM internal signal group56.";
CM_ SG_ 920 AccPWMPerdTi "Accelerator pedal PWM duty cycle";
CM_ SG_ 920 ActnOfCenHiMntdStopLamp "Activate Central High Mounted Stop Lamp.";
CM_ SG_ 920 ActnOfCenHiMntdStopLamp1 "signal of activate center high mounted stop lamp for Louts";
CM_ SG_ 920 ActnOfDaytiRunngLampDrv "Activate DRL Lamp of driver side";
CM_ SG_ 920 ActnOfFrntFogLampDrv "Activate front fog Lamp of driver side";
CM_ SG_ 920 ActnOfFrntPosnLampDrv "Activate front position Lamp of driver side";
CM_ SG_ 920 ActnOfFrntSideMkrLampDrv "Activate front side mark Lamp of driver side";
CM_ SG_ 920 ActnOfFrntSideMkrLampPass "Activate front side mark Lamp of passenger side";
CM_ SG_ 920 ActnOfLedCornrgLampLe "Acitvation of Led Cornering Lamp Left";
CM_ SG_ 920 ActnOfLedCornrgLampRi "Activate LED Cornering Lamp Right.";
CM_ SG_ 920 ActnOfLedDaytiRunngLamp "Activate LED Daytime Running Lamp.";
CM_ SG_ 920 ActnOfLedFrntCrossLamp "Activate LED Front Middle Cross Lamp.";
CM_ SG_ 920 ActnOfLedFrntCrossLampDyn "Activation of Front Middle Cross Lamp as part of Position Lights with dynamic pattern";
CM_ SG_ 920 ActnOfLedFrntFogLamp "Activate LED Front Fog Lamp.";
CM_ SG_ 920 ActnOfLedGrilleLamp "Activate LED Front Grille Lamp.";
CM_ SG_ 920 ActnOfLedGrilleLampDyn "Activation of Grille Lamp as part of Position Lights with dynamic pattern";
CM_ SG_ 920 ActnOfLedLeLogoLamp "Activate LED Left Logo Light Lamp.";
CM_ SG_ 920 ActnOfLedLeLogoLampDyn "Activation of Left Logo Lamp as part of Position Lights with dynamic pattern";
CM_ SG_ 920 ActnOfLedPosnLampDyn "Activation of Led Position Lamp Dynamic mode";
CM_ SG_ 920 ActnOfLedReFogLamp "Activate LED Rear Fog Lamp.";
CM_ SG_ 920 ActnOfLedRePosnLamp "Activate LED Position Lamp.";
CM_ SG_ 920 ActnOfLedRiLogoLamp "Activate LED Right Logo Light Lamp.";
CM_ SG_ 920 ActnOfLedRiLogoLampDyn "Activation of Right Logo Lamp as part of Charging Lights with dynamic pattern";
CM_ SG_ 920 ActnOfLedRvsgLamp "Activate LED Revering Lamp.";
CM_ SG_ 920 ActnOfReFogLampPass "Activate rear fog Lamp of passenger side";
CM_ SG_ 920 ActnOfRePosnLampDrv "Activate rear position Lamp of driver side";
CM_ SG_ 920 ActnOfReSideMkrLampDrv "Activate rear side mark Lamp of driver side";
CM_ SG_ 920 ActnOfReSideMkrLampPass "Activate rear side mark Lamp of passenger side";
CM_ SG_ 920 ActnOfRvsgLampDrv "Activate reverse Lamp of driver side";
CM_ SG_ 920 ActvnOfAfs "Activation of Aaptive Frontlight System ";
CM_ SG_ 920 ActvnOfAhl "Activate Auto Headlamp Leveling";
CM_ SG_ 920 ActvnOfAlrmReqFromCmplxIf "Sent from BBS polling LC to AlrmMgr. Is high when the IS requests to trigger the alarm or if the BBS does not respond to polling.";
CM_ SG_ 920 ActvnOfBrkLi "Activation of Break Light";
CM_ SG_ 920 ActvnOfDbl "Activate Bending Light.";
CM_ SG_ 920 ActvnOfDefrstFrnt "Activation of front defroster relay.";
CM_ SG_ 920 ActvnOfDefrstRe "Activation of electrical defroster rear.";
CM_ SG_ 920 ActvnOfDoorSwtIllmn "Activates or deactivates the symbol illumination of the DDS. Dependent on VMM signals mostly";
CM_ SG_ 920 ActvnOfFootwellLamp "CEM internal signal. PWM signal to control Ambient Light in Footwell.
Front and Rear.";
CM_ SG_ 920 ActvnOfHndlDoorLiHndlDoorLiDrvr "driver side handle light activate signal";
CM_ SG_ 920 ActvnOfHndlDoorLiHndlDoorLiDrvrRe "rear of driver side handle light activate signal";
CM_ SG_ 920 ActvnOfHndlDoorLiHndlDoorLiPass "passage side handle light activate signal";
CM_ SG_ 920 ActvnOfHndlDoorLiHndlDoorLiPassRe "rear of passage side handle light activate signal";
CM_ SG_ 920 ActvnOfReLogoLamp1 "Activate rear logo lamp";
CM_ SG_ 920 ActvnOfRoofSwtIllmn "Activates or deactivates the switch illumination of the OHx.";
CM_ SG_ 920 ActvnOfSillPlateIllmn "CEM internal signal. PWM signal to control Tread plate illumination.";
CM_ SG_ 920 ActvnOfStrtIllmn "CEM internal signal.
PWM signal to control Start button symbol illumination.";
CM_ SG_ 920 ActvnOfTouristMod "Activate Tourist Mode.";
CM_ SG_ 920 ActvnOfWiprMech "Activate wiper.   0, no relay activated.   1, Low speed relay activated.   2, High speed relay activated.   3, Not used";
CM_ SG_ 920 ActvnOfWshrFrntNotSafe "Signal between the non-safe LC to the safe LC. Indicates when the front washer pump is turned on.";
CM_ SG_ 920 ActvnOfWshrRe "Activate rear washer";
CM_ SG_ 920 AlrmAcoustReq01 "Request sent to Sound Signaling to sound vehicle horn. Used when BBS reports internal fault or BBS disconncted or vehicle horn configured instead of BBS. ";
CM_ SG_ 920 AlrmToExtrLiFbVisReq "Request from Alarm to Exterior light to flash exterior lights when vehicle is armed by passive arming.";
CM_ SG_ 920 AlrmToExtrLiVisReq "Request from Alarm to Exterior light to flash exterior lights when alarm is active.";
CM_ SG_ 920 AutWinWipgCmd "Wiping speed command.";
CM_ SG_ 920 BswCha1NmState "Chassis CAN1 network management status

";
CM_ SG_ 920 BswChainNmState "Chassis CAN2 network management status

";
CM_ SG_ 920 BswCpu0LoadAvg "CPU0 average load

";
CM_ SG_ 920 BswCpu0LoadMax "CPU0 maximum load

";
CM_ SG_ 920 BswCpu1LoadAvg "CPU1 average load
";
CM_ SG_ 920 BswCpu1LoadMax "CPU1 maximum load

";
CM_ SG_ 920 BswCpu2LoadAvg "CPU2 average load";
CM_ SG_ 920 BswCpu2LoadMax "CPU2 maximum load";
CM_ SG_ 920 BswCpu3LoadAvg "CPU3 average load";
CM_ SG_ 920 BswCpu3LoadMax "CPU3 maximum load";
CM_ SG_ 920 BswCpu4LoadAvg "CPU4 average load";
CM_ SG_ 920 BswCpu4LoadMax "CPU4 maximum load";
CM_ SG_ 920 BswCpu5LoadAvg "CPU5 average load";
CM_ SG_ 920 BswCpu5LoadMax "CPU5 maximum load";
CM_ SG_ 920 BswIcState "Peripheral chip status

";
CM_ SG_ 920 BswKeepWakeUpReason "Maintain source monitoring

";
CM_ SG_ 920 BswOsTaskTime "OS task runtime

";
CM_ SG_ 920 BswPriNmState "Private CAN network management status

";
CM_ SG_ 920 BswPropNmState "PT CAN network management

";
CM_ SG_ 920 BswWakeupSourceState "Wake up source monitoring

";
CM_ SG_ 920 DwnLoadStsFbOfHdlampLe "Download of Dynamic light sequence Feedback signal.";
CM_ SG_ 920 DwnLoadStsFbOfHdlampRi "Download of Dynamic light sequence Feedback signal.";
CM_ SG_ 920 DwnLoadStsFbOfLogoLampLe "Download status feedback of Left Logo Light lamp.";
CM_ SG_ 920 DwnLoadStsFbOfLogoLampRi "Download status feedback of Right Logo Light lamp.";
CM_ SG_ 920 ExtrLiShowActvnFrntLeFb "Activation of Exterior Light Show Feedback Frong Left Head Lamp";
CM_ SG_ 920 ExtrLiShowActvnFrntRiFb "Activation of Exterior Light Show Feedback Frong Right Head Lamp";
CM_ SG_ 920 ExtrLiShowActvnLeLogoFb "Activation of Exterior Light Show Feedback from Left Logo Light Lamp";
CM_ SG_ 920 ExtrLiShowActvnRiLogoFb "Activation of Exterior Light Show Feedback from Right Logo Light Lamp";
CM_ SG_ 920 HdlampLeInpSts1 "Ext. Light relay input driver warning and fault tracing";
CM_ SG_ 920 HdlampLeInpSts2 "Ignition relay input driver warning and fault tracing";
CM_ SG_ 920 HdlampRiInpSts1 "Ext. Light relay input driver warning and fault tracing";
CM_ SG_ 920 HdlampRiInpSts2 "Ignition relay input driver warning and fault tracing";
CM_ SG_ 920 ShortDropWinDrvrSts "Short drop a status sent back to locking to secure window is down and door is ready to be released. ";
CM_ SG_ 920 ShortDropWinReLeSts "Short drop a status sent back to locking to secure window is down and door is ready to be released. ";
CM_ SG_ 920 SnsrSoundrBattBackedStsArmSts "Status signal sent by BBS including status of arm, sounding, internal fault, indicating IS existence and configuration status.";
CM_ SG_ 920 SnsrSoundrBattBackedStsCfgSts "Status signal sent by BBS including status of arm, sounding, internal fault, indicating IS existence and configuration status.";
CM_ SG_ 920 SnsrSoundrBattBackedStsSnsrInclnExist "Status signal sent by BBS including status of arm, sounding, internal fault, indicating IS existence and configuration status.";
CM_ SG_ 920 SnsrSoundrBattBackedStsSoundrBattBackedErrSts "Status signal sent by BBS including status of arm, sounding, internal fault, indicating IS existence and configuration status.";
CM_ SG_ 920 SnsrSoundrBattBackedStsSoundSts "Status signal sent by BBS including status of arm, sounding, internal fault, indicating IS existence and configuration status.";
CM_ SG_ 920 StsOfAfsLe "Status of AFS light distribution Left.";
CM_ SG_ 920 StsOfAfsRi "Status of AFS light distribution Right.";
CM_ SG_ 920 StsOfAhbcLe "Status of Auto High Beam Control Left.";
CM_ SG_ 920 StsOfAhbcRi "Status of Auto High Beam Control Right.";
CM_ SG_ 920 StsOfFrntSideMkrLampLe2 "Status of Front Side Marker Lamp Left 2.";
CM_ SG_ 920 StsOfFrntSideMkrLampRi2 "Status of Front Side Marker Lamp Right 2.";
CM_ SG_ 920 StsOfLedCornrgLampLe "Status of Led Cornering Lamp Left.";
CM_ SG_ 920 StsOfLedCornrgLampRi "Status of Led Cornering Lamp Right.";
CM_ SG_ 920 StsOfLedDaytiRunngLampLe "Status of Led Day Time Running Lamp Left.";
CM_ SG_ 920 StsOfLedDaytiRunngLampRi "Status of Led Day Time Running Lamp Right.";
CM_ SG_ 920 StsOfLedFrntFogLampLe "Status of Led Front Fog Light Left.";
CM_ SG_ 920 StsOfLedFrntFogLampRi "Status of Led Front Fog Lamp Right.";
CM_ SG_ 920 StsOfLedFrntPosnLampLe "Status of Led Front Position Lamp Left.";
CM_ SG_ 920 StsOfLedFrntPosnLampRi "Status of Led Front Position Lamp Right.";
CM_ SG_ 920 StsOfLedFrntTurnIndcrLe "Status of Led Front Turn Indicator Left.";
CM_ SG_ 920 StsOfLedFrntTurnIndcrRi "Status of Front Turn Right Indicator";
CM_ SG_ 920 StsOfLedLeLogoLamp "Status of Led Left Logo Light Lamp";
CM_ SG_ 920 StsOfLedRiLogoLamp "Status of Led Right Logo Light Lamp";
CM_ SG_ 920 StsOfLvlgLeChks "Status of Head Lamp Leveling Motor Check Sum";
CM_ SG_ 920 StsOfLvlgLeCntr "Status of Head Lamp Leveling Motor Counter";
CM_ SG_ 920 StsOfLvlgLeStsOfLvlgLe "Status of Head Lamp Leveling Motor";
CM_ SG_ 920 StsOfLvlgRiChks "Status of Head Lamp Leveling Motor Check Sum";
CM_ SG_ 920 StsOfLvlgRiCntr "Status of Head Lamp Leveling Motor Counter";
CM_ SG_ 920 StsOfLvlgRiStsOfLvlgRi "Status of Head Lamp Leveling Motor";
CM_ SG_ 920 StsOfTouristModLe "Status of Tourist Mode Left.";
CM_ SG_ 920 StsOfTouristModRi "Status of Tourist Mode Right.";
CM_ SG_ 920 StsOfWelGbyFrntLe "status of welcome and goodbye light from HCML";
CM_ SG_ 920 StsOfWelGbyFrntRi "status of welcome and goodbye light from HCMR";
CM_ SG_ 920 SunRoofAndCurtBtnSts2Cntr "Counter";
CM_ SG_ 920 SunRoofAndCurtBtnSts2Pos "position";
CM_ SG_ 920 SunRoofImpctDetnSts2 "Sun Roof impact detection status.";
CM_ SG_ 920 TCSDoorSts "TCSDoorSts";
CM_ SG_ 920 WiprInPrkgPosnLoFromWMM "Information regarding wiper position on the windscreen";
CM_ SG_ 920 WiprInWipgArFromWMM "Information regarding wiper position on the windscreen.";
CM_ SG_ 920 WiprMotCrkAg "Wiper motor crank angle";
CM_ SG_ 920 WiprMotDiagcWiprMotHiVoltDetd "Information regarding overload, high voltage and low voltage on the wiper motor module.  High Voltage Detected (2-bit coded)";
CM_ SG_ 920 WiprMotDiagcWiprMotLoVoltDetd "Information regarding overload, high voltage and low voltage on the wiper motor module.  Low Voltage Detected (2-bit coded)";
CM_ SG_ 920 WiprMotDiagcWiprMotOvldDetd "Information regarding overload, high voltage and low voltage on the wiper motor module.  Overload detected (2-bit coded)";
CM_ SG_ 920 WiprMotErrSafe "Wiper Motor Error (2-bit coded, system safety relevant)";
CM_ SG_ 920 WshngCycActvFromWMM "Information regarding front washing cycle active or not.";
CM_ SG_ 416 AccPedlAna "Accelerator pedal ADC voltage signal";
CM_ SG_ 416 AccPedlPWM "Accelerator pedal PWM signal";
CM_ SG_ 416 BattCoolgPwrPreTherm "Cooling power";
CM_ SG_ 416 BattHeatgTargTempPreTherm "Predicted target temperature";
CM_ SG_ 416 BattVoltKL30 "Controller 30 terminal power supply";
CM_ SG_ 416 ChillerOutCooltT "Coolant temperature measured by sensors installed in chiller out.";
CM_ SG_ 416 CnvnInhb "Intelligent power supply suppression flag

";
CM_ SG_ 416 CPSRClsReq "CPSR relay control";
CM_ SG_ 416 CPSRFbSt "CPSR relay feedback";
CM_ SG_ 416 EexvStsExvActrPosn "Eexv actual position.";
CM_ SG_ 416 EexvStsExvBlkErr "Eexv blocked error";
CM_ SG_ 416 EexvStsExvCalibSts "Eexv calibration status.";
CM_ SG_ 416 EexvStsExvElecStsErr "Eexv electrical  error";
CM_ SG_ 416 EexvStsExvMovSts "Eexv move status.";
CM_ SG_ 416 EexvStsExvOvrTempErr "Eexv over-temp error";
CM_ SG_ 416 EexvStsExvOvrTrvlErr "Eexv over-travel error";
CM_ SG_ 416 EexvStsExvPreHeatgSts "Eexv pre-heating status.";
CM_ SG_ 416 EexvStsExvVoltgRangErr "Eexv voltage range error.";
CM_ SG_ 416 EtpActualSpeedBackup "speed calculation based on UVW signals or angle but Speed priority based on UVW";
CM_ SG_ 416 EtpActualSpeedEtpActualSpeed "speed calculation based on UVW signals or angle but Speed priority based on UVW";
CM_ SG_ 416 EtpActualSpeedSts "Actual speed status
3:the signal is accurate
2:a fault has been detected and affect the performance or durability of exceptional subscribers
1:the signal is set to its initial value becaus
0:there is a serious fault";
CM_ SG_ 416 EtpAngPosPlausSts "EOP shall detect the plausibility of Angle and UVW speed 
0:normal";
CM_ SG_ 416 EtpASAStudyProcess "0 No study
1 Studing";
CM_ SG_ 416 EtpASAValueValid "When Zero value has two same value,their checksum are the same.";
CM_ SG_ 416 EtpBatteryVoltage "Supply Voltage";
CM_ SG_ 416 EtpCanNodeLoss "1:CanNodeLoss";
CM_ SG_ 416 EtpCurrent_Backup "Bus current";
CM_ SG_ 416 EtpCurrentEtpCurrent "Bus current";
CM_ SG_ 416 EtpCurrentStsBackup "ETP_Current status Detection 
0 - Init
1 - Precise
2 - Not precise
3 - ILLEGAL";
CM_ SG_ 416 EtpEnableOff "0: Motor run(opcstart = 1 and oilpmptargetspeed > 0)
1: Motor stop(opcstart = 0 or oilmptargetspeed = 0, or
TCU message is lost)";
CM_ SG_ 416 EtpEOPHydLeakSts "EOP shall detect if hydraulic leakage happened
1:hydraulic leakage happened";
CM_ SG_ 416 EtpFaultSelfMos "0:selfMos is successful;1:selfMos is fail";
CM_ SG_ 416 EtpGDUOverCurrent "1:GDUOverCurrent";
CM_ SG_ 416 EtpGmrSpiCommErr "The EOP shall feedback GMR SPI bus communication error 
1:GMR SPI bus communication error ";
CM_ SG_ 416 EtpHallSignalError "error";
CM_ SG_ 416 EtpHallSignalSt "0:all hall signals have no fault
1:one of all hall signals are high or all low
2:two of all hall signals are high or all low
3:all hall signals are high or all low";
CM_ SG_ 416 EtpIgnitionStatus "ingition signal IgnitionStatus from Hardware pin
0:Enable signal is off,
1:Enable signal is on.";
CM_ SG_ 416 EtpMcuTemperature "ETPMcuTemperature ";
CM_ SG_ 416 EtpMcuTOutRngHiSts "Mcu emperature sensor signals out of range high";
CM_ SG_ 416 EtpMcuTOutRngLoSts "Mcu temperature sensor signals out of range low fault";
CM_ SG_ 416 EtpMcuTStuckSts "MCU Temperature remain unchanged for 1000ms";
CM_ SG_ 416 EtpMosTemperature "Mos Temperature";
CM_ SG_ 416 EtpMosTemperatureBackup "Mos Temperature";
CM_ SG_ 416 EtpMosTOpenSts "Mos temperature sensor signals circuit fault to short to open
1:short to open";
CM_ SG_ 416 EtpMosTOutRngHiSts "Mos emperature sensor signals out of range high";
CM_ SG_ 416 EtpMosTOutRngLoSts "Mos temperature sensor signals out of range low fault";
CM_ SG_ 416 EtpMosTShoBattSts "Mos temperature sensor signals circuit fault to short to battery
1:short to battery";
CM_ SG_ 416 EtpMosTShoGndSts "Mos temperature sensor signals circuit fault to short to ground
1:short to ground";
CM_ SG_ 416 EtpMosTStuckSts "Mos Temperature remain unchanged for 1000ms";
CM_ SG_ 416 EtpOffseVoltageFailure "Current sampling offset current voltage
0:false
1:true";
CM_ SG_ 416 EtpOverTemperature "over temperature";
CM_ SG_ 416 EtpOverTemperatureBackup "0 Normal temperature,1 High temperature,any of mos and mcu temperature is within
range,2 Over temperature, any of mos and mcu temperature is higher
than 135,3 Illegal";
CM_ SG_ 416 EtpOverVoltage "over GDU and Battery voltage ";
CM_ SG_ 416 EtpPhaseCurrent "Phase Current";
CM_ SG_ 416 EtpPhaseCurrentBackup "Phase Current";
CM_ SG_ 416 EtpPhaseCurrentStsBackup "Phase Current status Detection 
0 - Init
1 - Precise
2 - Not precise
3 - ILLEGAL";
CM_ SG_ 416 EtpPhaseOverCurrent "1:over phase current";
CM_ SG_ 416 EtpPumpReady "0:The system self-check failed
1: The system self-check is successful (the voltage is stable above 8V,
MOS self-check is passed, and the system is ready to be OK).";
CM_ SG_ 416 EtpResetReason "0:Power-On Reset
1:Low Voltage Reset
2:External pin RESET
3:PLL clock monitor reset
4:Oscillator Clock monitor reset
5:COP watchdog reset";
CM_ SG_ 416 EtpRunningStatus "0:0 speed mode
1: Motor operation mode
2: Derating operation mode
3: Failure mode";
CM_ SG_ 416 EtpSensorPowSupplyFau "Mcu Temperature Sensor Voltage plausibility Detection 
0:mormal";
CM_ SG_ 416 EtpSpdBaseAngleValue "speed calculation based on angle value signal ";
CM_ SG_ 416 EtpSpdBaseAngleValueSts "EOP shall detect the plausibility of Angle speed 
0:normal
1:error";
CM_ SG_ 416 EtpSpdBaseUVWIncPos "Actaul Speed";
CM_ SG_ 416 EtpSpdBaseUVWIncPosSts "EOP shall detect the plausibility of UVW speed 
0:normal";
CM_ SG_ 416 EtpStartFailure "0:No Motor block
1: Motor block";
CM_ SG_ 416 EtpUnderSpeed "Judgment of maximum power speed";
CM_ SG_ 416 EtpUnderVoltage "under GDU and Battery voltage ";
CM_ SG_ 416 EtpVHDVoltageBackup "Mos Voltage";
CM_ SG_ 416 EtpVHDVoltageEtpVHDVoltage "Mos Voltage";
CM_ SG_ 416 EtpVoltagePlausSts "ETP_BatteryVoltage and VHD Voltage Status Detection ";
CM_ SG_ 416 ExvStsExvActrPosn "Exv position status";
CM_ SG_ 416 ExvStsExvBlkErr "Exv blocked err.";
CM_ SG_ 416 ExvStsExvCalibSts "Exv calibration status";
CM_ SG_ 416 ExvStsExvElecStsErr "Exv electrical err.";
CM_ SG_ 416 ExvStsExvMovSts "Exv move status.";
CM_ SG_ 416 ExvStsExvOvrTempErr "Exv over-temp err.";
CM_ SG_ 416 ExvStsExvOvrTrvlErr "Exv over-travel err.";
CM_ SG_ 416 ExvStsExvPreHeatgSts "Exv preheating status.";
CM_ SG_ 416 ExvStsExvVoltgRangErr "Exv voltage err.";
CM_ SG_ 416 FrntHeatPwrAllwd "The allowed electrial energy for active heating of the front motor";
CM_ SG_ 416 HvchOnForBattHeatg "Transmission time of charging current";
CM_ SG_ 416 HvClimaCoolgPwrCritDes "Estimated power need critical use for climate cooling.";
CM_ SG_ 416 HvClimaHeatgPwrCritDes "Critical high voltage power need for climate heating.";
CM_ SG_ 416 HvCoolgPwrCritDes "Estimated power need critical use for battery cooling.";
CM_ SG_ 416 HvCoolgPwrNormDes "Estimated power need normal use for Cooling system.";
CM_ SG_ 416 HvHeatgPwrCritDes "Critical high voltage power need for battery heating.";
CM_ SG_ 416 HvHeatgPwrNormDes "Actual power desire from heating subsystem.";
CM_ SG_ 416 IsgFlg20ForEOP "Enable Of ID 20 ";
CM_ SG_ 416 IsgForWRCIsgSpdForWRC "Isg Speed for WRC";
CM_ SG_ 416 IsgForWRCIsgTqEstForWRC "Isg Tq Est for WRC";
CM_ SG_ 416 IsgOilPmpTargetSpeedForETP "Target Speed";
CM_ SG_ 416 IsgOilPmpTemperatureForETP "oil temperature";
CM_ SG_ 416 IsgOPCStartOnForETP "IsgOPCStartOnForETP";
CM_ SG_ 416 IsgTPlausStsForETP "0:Normal
1:Mos temperature sensor plausibility fault
2:Mcu temperature sensor plausibility fault
3:McuMos fault";
CM_ SG_ 416 LoTemEneStorage "flag of low temperature energy storage activation";
CM_ SG_ 422 EwpAflFlagCooling "ELDT afterrun cooling flag.";
CM_ SG_ 422 HvActvReq "Request for CPSR and power up high voltage system. During climatization and charging.";
CM_ SG_ 422 IsgCoolgReqInvrCloud "Request for increased cooling flow to Inverter for Cloud";
CM_ SG_ 422 IsgCooltFlowMinReqCloud "IsgCooltFlowMinReqCloud";
CM_ SG_ 422 IsgCrashValueForETP "EOP shall deactivate pump motor within 100 ms after crash is detected CrashValue
1:Crash";
CM_ SG_ 422 IsgHeatFdBckCloud "IsgHeatFdBckCloud";
CM_ SG_ 422 IvtrActId "Inverter actual Id";
CM_ SG_ 422 IvtrActIq "Inverter actual Iq";
CM_ SG_ 422 IvtrActvDchaSts "Active discharge status";
CM_ SG_ 422 IvtrDAxisCurrtSp "d axis current setpoint";
CM_ SG_ 422 IvtrDAxisU "d axis voltage";
CM_ SG_ 422 IvtrDeratingReason "Motor Derating reason of IEM/MGM";
CM_ SG_ 422 IvtrDeratingSts "IEM/MGM Derating Status";
CM_ SG_ 422 IvtrGateSts "Gate Status";
CM_ SG_ 422 IvtrIgbtJunctionT "Inverter IGBT Junction Temp";
CM_ SG_ 422 IvtrModlnIdx "Modulation index";
CM_ SG_ 422 IvtrMotActModSts "Inverter motor actual mode status";
CM_ SG_ 422 IvtrOffsAgIvtrOffsAg "IEM/MGM rotor offset angle";
CM_ SG_ 422 IvtrOffsAgSts "Offset angle status";
CM_ SG_ 422 IvtrOilT "Oil temperature sensor temperature value";
CM_ SG_ 422 IvtrOilTSnsrSplyV "Oil_TempSensor_SupplyVolt";
CM_ SG_ 422 IvtrPhaPwmDutyIvtrPhaUPwmDuty "Phase U PWM duty";
CM_ SG_ 422 IvtrPhaPwmDutyIvtrPhaVPwmDuty "Phase V PWM duty";
CM_ SG_ 422 IvtrPhaPwmDutyIvtrPhaWPwmDuty "Phase W PWM duty";
CM_ SG_ 422 IvtrQAxisCurrtSp "q axis current setpoint";
CM_ SG_ 422 IvtrQAxisU "q axis voltage";
CM_ SG_ 422 IvtrReqIdWithLimn "Inverter request Id with limitation";
CM_ SG_ 422 IvtrReqIqWithLimn "Inverter request Iq with limitation";
CM_ SG_ 422 IvtrResolverAg "Resolve angle";
CM_ SG_ 422 IvtrSftyFctMod "Safety Function Mode";
CM_ SG_ 422 IvtrSftySpd "Safety Speed";
CM_ SG_ 422 IvtrSftyTq "Safety Torque";
CM_ SG_ 422 IvtrSftyTqQf "Safety Torque Quality factor";
CM_ SG_ 422 IvtrTqDir "Torque Direction";
CM_ SG_ 422 IvtrTraPhaCurrtAryU "Transient Phase_Current_Array_U";
CM_ SG_ 422 IvtrTraPhaCurrtAryV "Transient Phase_Current_Array_V";
CM_ SG_ 422 IvtrTraPhaCurrtAryW "Transient Phase_Current_Array_W";
CM_ SG_ 422 MotorHeatrPwrCnsDes "he motor actively heats the required power";
CM_ SG_ 422 MotSpdForWRC "Motor Speed for WRC";
CM_ SG_ 422 MotTqEstForWRC "Motor Tq Est for WRC";
CM_ SG_ 422 OTAActvHVReq "OTA request to activate high voltage flag bit";
CM_ SG_ 422 PredDrvPwrReq "Predict drive power requests";
CM_ SG_ 422 PredTarSoc "Predict the SOC arrival at destination";
CM_ SG_ 422 PrpsnAllwd "Driver allowed";
CM_ SG_ 422 PtTqMCUPtTqFrntMotMaxReq "PtTqFrntMotMaxReq";
CM_ SG_ 422 PtTqMCUPtTqFrntMotMinReq "PtTqFrntMotMinReq";
CM_ SG_ 422 PtTqMCUPtTqReMotMaxReq "PtTqReMotMaxReq";
CM_ SG_ 422 PtTqMCUPtTqReMotMinReq "PtTqReMotMinReq";
CM_ SG_ 422 RemStrt "Remote start status

";
BA_DEF_ BO_ "CANFD_BRS" ENUM "0","1";
BA_DEF_ BO_ "GenMsgCycleTime" INT 0 65536;
BA_DEF_ BO_ "GenMsgDelayTime" INT 0 65536;
BA_DEF_ BO_ "GenMsgSendType" ENUM "cyclic", "spontaneous", "not-used", "not-used", "not-used", "cyclicAndSpontaneous", "not-used", "cyclicIfActive", "NoMsgSendType";
BA_DEF_ BO_ "GenMsgStartDelayTime" INT 0 65536;
BA_DEF_ BO_ "VFrameFormat" ENUM "StandardCAN","ExtendedCAN","reserved","J1939PG","reserved","reserved","reserved","reserved","reserved","reserved","reserved","reserved","reserved","reserved","StandardCAN_FD","ExtendedCAN_FD";
BA_DEF_ SG_ "GenSigSendType" ENUM "Cyclic","OnWrite","OnWriteWithRepetition","OnChange","OnChangeWithRepetition","IfActive","IfActiveWithRepetition","NoSigSendType";
BA_DEF_ SG_ "GenSigStartValue" HEX 0 80000000;
BA_DEF_ BO_ "GenMsgILSupport" ENUM "No","Yes";
BA_DEF_ BO_ "NmAsrMessage" ENUM "No","Yes";
BA_DEF_ SG_ "GenSigFuncType" ENUM "NoFunction","n/a","n/a","n/a","n/a","n/a","n/a","n/a","n/a","n/a","n/a","n/a","n/a","n/a","n/a","CHK","CNTR","n/a","n/a","n/a","CNTR_AR_01","CRC_AR_01_BOTH","CRC_AR_01_ALT","CRC_AR_01_LOW","CRC_AR_01_NIBBLE","CNTR_AR_04","CRC_AR_04A","CNTR_AR_05","CRC_AR_05";
BA_DEF_ SG_ "GenSigDataID" STRING;
BA_DEF_DEF_ "CANFD_BRS" "1";
BA_DEF_DEF_ "GenSigStartValue" 0;
BA_DEF_DEF_ "VFrameFormat" "J1939PG";
BA_DEF_DEF_ "GenSigSendType" "NoSigSendType";
BA_DEF_DEF_ "GenMsgCycleTime" 0;
BA_DEF_DEF_ "GenMsgDelayTime" 0;
BA_DEF_DEF_ "GenMsgStartDelayTime" 0;
BA_DEF_DEF_ "GenMsgSendType" "NoMsgSendType";
BA_DEF_DEF_ "GenMsgILSupport" "Yes";
BA_DEF_DEF_ "NmAsrMessage" "No";
BA_DEF_DEF_ "GenSigFuncType" "NoFunction";
BA_DEF_DEF_ "GenSigDataID" "";

BA_ "GenMsgCycleTime" BO_ 1161 900.000;
BA_ "GenMsgSendType" BO_ 1161 0;
BA_ "VFrameFormat" BO_ 1161 14;

BA_ "GenMsgCycleTime" BO_ 1173 1000.000;
BA_ "GenMsgSendType" BO_ 1173 0;
BA_ "VFrameFormat" BO_ 1173 14;

BA_ "GenMsgDelayTime" BO_ 81 10.000;
BA_ "GenMsgSendType" BO_ 81 1;
BA_ "VFrameFormat" BO_ 81 14;

BA_ "GenMsgCycleTime" BO_ 659 400.000;
BA_ "GenMsgSendType" BO_ 659 0;
BA_ "VFrameFormat" BO_ 659 14;

BA_ "GenMsgCycleTime" BO_ 569 300.000;
BA_ "GenMsgSendType" BO_ 569 0;
BA_ "VFrameFormat" BO_ 569 14;

BA_ "GenMsgDelayTime" BO_ 82 10.000;
BA_ "GenMsgSendType" BO_ 82 1;
BA_ "VFrameFormat" BO_ 82 14;

BA_ "GenMsgDelayTime" BO_ 52 10.000;
BA_ "GenMsgSendType" BO_ 52 1;
BA_ "VFrameFormat" BO_ 52 14;

BA_ "GenMsgCycleTime" BO_ 920 800.000;
BA_ "GenMsgSendType" BO_ 920 0;
BA_ "VFrameFormat" BO_ 920 14;

BA_ "GenMsgCycleTime" BO_ 416 100.000;
BA_ "GenMsgSendType" BO_ 416 0;
BA_ "VFrameFormat" BO_ 416 14;

BA_ "GenMsgCycleTime" BO_ 422 100.000;
BA_ "GenMsgSendType" BO_ 422 0;
BA_ "VFrameFormat" BO_ 422 14;
BA_ "GenSigSendType" SG_ 920 AccPWMPerdTi 0;
BA_ "GenSigSendType" SG_ 416 AccPedlAna 0;
BA_ "GenSigSendType" SG_ 416 AccPedlPWM 0;
BA_ "GenSigSendType" SG_ 920 ActnOfCenHiMntdStopLamp 0;
BA_ "GenSigSendType" SG_ 920 ActnOfCenHiMntdStopLamp1 0;
BA_ "GenSigSendType" SG_ 920 ActnOfDaytiRunngLampDrv 0;
BA_ "GenSigSendType" SG_ 920 ActnOfFrntFogLampDrv 0;
BA_ "GenSigSendType" SG_ 920 ActnOfFrntPosnLampDrv 0;
BA_ "GenSigSendType" SG_ 920 ActnOfFrntSideMkrLampDrv 0;
BA_ "GenSigSendType" SG_ 920 ActnOfFrntSideMkrLampPass 0;
BA_ "GenSigSendType" SG_ 920 ActnOfLedCornrgLampLe 0;
BA_ "GenSigSendType" SG_ 920 ActnOfLedCornrgLampRi 0;
BA_ "GenSigSendType" SG_ 920 ActnOfLedDaytiRunngLamp 0;
BA_ "GenSigSendType" SG_ 920 ActnOfLedFrntCrossLamp 0;
BA_ "GenSigSendType" SG_ 920 ActnOfLedFrntCrossLampDyn 0;
BA_ "GenSigSendType" SG_ 920 ActnOfLedFrntFogLamp 0;
BA_ "GenSigSendType" SG_ 920 ActnOfLedGrilleLamp 0;
BA_ "GenSigSendType" SG_ 920 ActnOfLedGrilleLampDyn 0;
BA_ "GenSigSendType" SG_ 920 ActnOfLedLeLogoLamp 0;
BA_ "GenSigSendType" SG_ 920 ActnOfLedLeLogoLampDyn 0;
BA_ "GenSigSendType" SG_ 920 ActnOfLedPosnLampDyn 0;
BA_ "GenSigSendType" SG_ 920 ActnOfLedReFogLamp 0;
BA_ "GenSigSendType" SG_ 920 ActnOfLedRePosnLamp 0;
BA_ "GenSigSendType" SG_ 920 ActnOfLedRiLogoLamp 0;
BA_ "GenSigSendType" SG_ 920 ActnOfLedRiLogoLampDyn 0;
BA_ "GenSigSendType" SG_ 920 ActnOfLedRvsgLamp 0;
BA_ "GenSigSendType" SG_ 920 ActnOfReFogLampPass 0;
BA_ "GenSigSendType" SG_ 920 ActnOfRePosnLampDrv 0;
BA_ "GenSigSendType" SG_ 920 ActnOfReSideMkrLampDrv 0;
BA_ "GenSigSendType" SG_ 920 ActnOfReSideMkrLampPass 0;
BA_ "GenSigSendType" SG_ 920 ActnOfRvsgLampDrv 0;
BA_ "GenSigSendType" SG_ 920 ActvnOfAfs 0;
BA_ "GenSigSendType" SG_ 920 ActvnOfAhl 0;
BA_ "GenSigSendType" SG_ 920 ActvnOfAlrmReqFromCmplxIf 0;
BA_ "GenSigSendType" SG_ 920 ActvnOfBrkLi 0;
BA_ "GenSigSendType" SG_ 920 ActvnOfDbl 0;
BA_ "GenSigSendType" SG_ 920 ActvnOfDefrstFrnt 0;
BA_ "GenSigSendType" SG_ 920 ActvnOfDefrstRe 0;
BA_ "GenSigSendType" SG_ 920 ActvnOfDoorSwtIllmn 0;
BA_ "GenSigSendType" SG_ 920 ActvnOfFootwellLamp 0;
BA_ "GenSigSendType" SG_ 920 ActvnOfHndlDoorLiHndlDoorLiDrvr 0;
BA_ "GenSigSendType" SG_ 920 ActvnOfHndlDoorLiHndlDoorLiDrvrRe 0;
BA_ "GenSigSendType" SG_ 920 ActvnOfHndlDoorLiHndlDoorLiPass 0;
BA_ "GenSigSendType" SG_ 920 ActvnOfHndlDoorLiHndlDoorLiPassRe 0;
BA_ "GenSigSendType" SG_ 920 ActvnOfReLogoLamp1 0;
BA_ "GenSigSendType" SG_ 920 ActvnOfRoofSwtIllmn 0;
BA_ "GenSigSendType" SG_ 920 ActvnOfSillPlateIllmn 0;
BA_ "GenSigSendType" SG_ 920 ActvnOfStrtIllmn 0;
BA_ "GenSigSendType" SG_ 920 ActvnOfTouristMod 0;
BA_ "GenSigSendType" SG_ 920 ActvnOfWiprMech 0;
BA_ "GenSigSendType" SG_ 920 ActvnOfWshrFrntNotSafe 0;
BA_ "GenSigSendType" SG_ 920 ActvnOfWshrRe 0;
BA_ "GenSigSendType" SG_ 920 AlrmAcoustReq01 0;
BA_ "GenSigSendType" SG_ 920 AlrmToExtrLiFbVisReq 0;
BA_ "GenSigSendType" SG_ 920 AlrmToExtrLiVisReq 0;
BA_ "GenSigSendType" SG_ 920 AutWinWipgCmd 0;
BA_ "GenSigSendType" SG_ 416 BattCoolgPwrPreTherm 0;
BA_ "GenSigSendType" SG_ 416 BattHeatgTargTempPreTherm 0;
BA_ "GenSigStartValue" SG_ 416 BattHeatgTargTempPreTherm 50;
BA_ "GenSigSendType" SG_ 416 BattVoltKL30 0;
BA_ "GenSigSendType" SG_ 52 BodyDataTraceZCUDM1Functiondevpsignalgroup1 1;
BA_ "GenSigSendType" SG_ 52 BodyDataTraceZCUDM1Functiondevpsignalgroup2 1;
BA_ "GenSigSendType" SG_ 52 BodyDataTraceZCUDM1Functiondevpsignalgroup3 1;
BA_ "GenSigSendType" SG_ 52 BodyDataTraceZCUDM1Functiondevpsignalgroup4 1;
BA_ "GenSigSendType" SG_ 52 BodyDataTraceZCUDM1Functiondevpsignalgroup5 1;
BA_ "GenSigSendType" SG_ 52 BodyDataTraceZCUDM1Functiondevpsignalgroup6 1;
BA_ "GenSigSendType" SG_ 52 BodyDataTraceZCUDM1Functiondevpsignalgroup7 1;
BA_ "GenSigSendType" SG_ 52 BodyDataTraceZCUDM1Functiondevpsignalgroup8 1;
BA_ "GenSigSendType" SG_ 52 BodyDataTraceZCUDM2Functiondevpsignalgroup1 1;
BA_ "GenSigSendType" SG_ 52 BodyDataTraceZCUDM2Functiondevpsignalgroup2 1;
BA_ "GenSigSendType" SG_ 52 BodyDataTraceZCUDM2Functiondevpsignalgroup3 1;
BA_ "GenSigSendType" SG_ 52 BodyDataTraceZCUDM2Functiondevpsignalgroup4 1;
BA_ "GenSigSendType" SG_ 52 BodyDataTraceZCUDM2Functiondevpsignalgroup5 1;
BA_ "GenSigSendType" SG_ 52 BodyDataTraceZCUDM2Functiondevpsignalgroup6 1;
BA_ "GenSigSendType" SG_ 52 BodyDataTraceZCUDM2Functiondevpsignalgroup7 1;
BA_ "GenSigSendType" SG_ 52 BodyDataTraceZCUDM2Functiondevpsignalgroup8 1;
BA_ "GenSigSendType" SG_ 52 BodyDataTraceZCUDM3Functiondevpsignalgroup1 1;
BA_ "GenSigSendType" SG_ 52 BodyDataTraceZCUDM3Functiondevpsignalgroup2 1;
BA_ "GenSigSendType" SG_ 52 BodyDataTraceZCUDM3Functiondevpsignalgroup3 1;
BA_ "GenSigSendType" SG_ 52 BodyDataTraceZCUDM3Functiondevpsignalgroup4 1;
BA_ "GenSigSendType" SG_ 52 BodyDataTraceZCUDM3Functiondevpsignalgroup5 1;
BA_ "GenSigSendType" SG_ 52 BodyDataTraceZCUDM3Functiondevpsignalgroup6 1;
BA_ "GenSigSendType" SG_ 52 BodyDataTraceZCUDM3Functiondevpsignalgroup7 1;
BA_ "GenSigSendType" SG_ 52 BodyDataTraceZCUDM3Functiondevpsignalgroup8 1;
BA_ "GenSigSendType" SG_ 52 BodyDataTraceZCUDM4Functiondevpsignalgroup1 1;
BA_ "GenSigSendType" SG_ 52 BodyDataTraceZCUDM4Functiondevpsignalgroup2 1;
BA_ "GenSigSendType" SG_ 52 BodyDataTraceZCUDM4Functiondevpsignalgroup3 1;
BA_ "GenSigSendType" SG_ 52 BodyDataTraceZCUDM4Functiondevpsignalgroup4 1;
BA_ "GenSigSendType" SG_ 52 BodyDataTraceZCUDM4Functiondevpsignalgroup5 1;
BA_ "GenSigSendType" SG_ 52 BodyDataTraceZCUDM4Functiondevpsignalgroup6 1;
BA_ "GenSigSendType" SG_ 52 BodyDataTraceZCUDM4Functiondevpsignalgroup7 1;
BA_ "GenSigSendType" SG_ 52 BodyDataTraceZCUDM4Functiondevpsignalgroup8 1;
BA_ "GenSigSendType" SG_ 52 BodyDataTraceZCUDM5Functiondevpsignalgroup1 1;
BA_ "GenSigSendType" SG_ 52 BodyDataTraceZCUDM5Functiondevpsignalgroup2 1;
BA_ "GenSigSendType" SG_ 52 BodyDataTraceZCUDM5Functiondevpsignalgroup3 1;
BA_ "GenSigSendType" SG_ 52 BodyDataTraceZCUDM5Functiondevpsignalgroup4 1;
BA_ "GenSigSendType" SG_ 52 BodyDataTraceZCUDM5Functiondevpsignalgroup5 1;
BA_ "GenSigSendType" SG_ 52 BodyDataTraceZCUDM5Functiondevpsignalgroup6 1;
BA_ "GenSigSendType" SG_ 52 BodyDataTraceZCUDM5Functiondevpsignalgroup7 1;
BA_ "GenSigSendType" SG_ 52 BodyDataTraceZCUDM5Functiondevpsignalgroup8 1;
BA_ "GenSigSendType" SG_ 52 BodyDataTraceZCUDM6Functiondevpsignalgroup1 1;
BA_ "GenSigSendType" SG_ 52 BodyDataTraceZCUDM6Functiondevpsignalgroup2 1;
BA_ "GenSigSendType" SG_ 52 BodyDataTraceZCUDM6Functiondevpsignalgroup3 1;
BA_ "GenSigSendType" SG_ 52 BodyDataTraceZCUDM6Functiondevpsignalgroup4 1;
BA_ "GenSigSendType" SG_ 52 BodyDataTraceZCUDM6Functiondevpsignalgroup5 1;
BA_ "GenSigSendType" SG_ 52 BodyDataTraceZCUDM6Functiondevpsignalgroup6 1;
BA_ "GenSigSendType" SG_ 52 BodyDataTraceZCUDM6Functiondevpsignalgroup7 1;
BA_ "GenSigSendType" SG_ 52 BodyDataTraceZCUDM6Functiondevpsignalgroup8 1;
BA_ "GenSigSendType" SG_ 52 BodyDataTraceZCUDM7Functiondevpsignalgroup1 1;
BA_ "GenSigSendType" SG_ 52 BodyDataTraceZCUDM7Functiondevpsignalgroup2 1;
BA_ "GenSigSendType" SG_ 52 BodyDataTraceZCUDM7Functiondevpsignalgroup3 1;
BA_ "GenSigSendType" SG_ 52 BodyDataTraceZCUDM7Functiondevpsignalgroup4 1;
BA_ "GenSigSendType" SG_ 52 BodyDataTraceZCUDM7Functiondevpsignalgroup5 1;
BA_ "GenSigSendType" SG_ 52 BodyDataTraceZCUDM7Functiondevpsignalgroup6 1;
BA_ "GenSigSendType" SG_ 52 BodyDataTraceZCUDM7Functiondevpsignalgroup7 1;
BA_ "GenSigSendType" SG_ 52 BodyDataTraceZCUDM7Functiondevpsignalgroup8 1;
BA_ "GenSigSendType" SG_ 920 BswCha1NmState 0;
BA_ "GenSigSendType" SG_ 920 BswChainNmState 0;
BA_ "GenSigSendType" SG_ 920 BswCpu0LoadAvg 0;
BA_ "GenSigSendType" SG_ 920 BswCpu0LoadMax 0;
BA_ "GenSigSendType" SG_ 920 BswCpu1LoadAvg 0;
BA_ "GenSigSendType" SG_ 920 BswCpu1LoadMax 0;
BA_ "GenSigSendType" SG_ 920 BswCpu2LoadAvg 0;
BA_ "GenSigSendType" SG_ 920 BswCpu2LoadMax 0;
BA_ "GenSigSendType" SG_ 920 BswCpu3LoadAvg 0;
BA_ "GenSigSendType" SG_ 920 BswCpu3LoadMax 0;
BA_ "GenSigSendType" SG_ 920 BswCpu4LoadAvg 0;
BA_ "GenSigSendType" SG_ 920 BswCpu4LoadMax 0;
BA_ "GenSigSendType" SG_ 920 BswCpu5LoadAvg 0;
BA_ "GenSigSendType" SG_ 920 BswCpu5LoadMax 0;
BA_ "GenSigSendType" SG_ 920 BswIcState 0;
BA_ "GenSigSendType" SG_ 920 BswKeepWakeUpReason 0;
BA_ "GenSigSendType" SG_ 920 BswOsTaskTime 0;
BA_ "GenSigSendType" SG_ 920 BswPriNmState 0;
BA_ "GenSigSendType" SG_ 920 BswPropNmState 0;
BA_ "GenSigSendType" SG_ 1173 BswRstAddress 0;
BA_ "GenSigSendType" SG_ 1173 BswRstReason 0;
BA_ "GenSigSendType" SG_ 920 BswWakeupSourceState 0;
BA_ "GenSigSendType" SG_ 416 CPSRClsReq 0;
BA_ "GenSigSendType" SG_ 416 CPSRFbSt 0;
BA_ "GenSigSendType" SG_ 1173 CarLoctrToExtrLiVisReq 0;
BA_ "GenSigSendType" SG_ 416 ChillerOutCooltT 0;
BA_ "GenSigStartValue" SG_ 416 ChillerOutCooltT 400;
BA_ "GenSigSendType" SG_ 81 ClsdDueToRain 1;
BA_ "GenSigSendType" SG_ 416 CnvnInhb 0;
BA_ "GenSigSendType" SG_ 569 ConvPwrRelsForbRelsFrbn1 0;
BA_ "GenSigSendType" SG_ 569 ConvPwrRelsForbRelsMtnFrbn 0;
BA_ "GenSigSendType" SG_ 81 DKDataFromCEMAcknowledgment 1;
BA_ "GenSigSendType" SG_ 81 DKDataFromCEMDKDataByte1 1;
BA_ "GenSigSendType" SG_ 81 DKDataFromCEMDKDataByte2 1;
BA_ "GenSigSendType" SG_ 81 DKDataFromCEMDKDataByte3 1;
BA_ "GenSigSendType" SG_ 81 DKDataFromCEMDKDataByte4 1;
BA_ "GenSigSendType" SG_ 81 DKDataFromCEMDKDataByte5 1;
BA_ "GenSigSendType" SG_ 81 DKDataFromCEMDKDataByte6 1;
BA_ "GenSigSendType" SG_ 81 DKDataFromCEMHeader 1;
BA_ "GenSigSendType" SG_ 659 DiagFrameForECMByte0 0;
BA_ "GenSigSendType" SG_ 659 DiagFrameForECMByte1 0;
BA_ "GenSigSendType" SG_ 659 DiagFrameForECMByte2 0;
BA_ "GenSigSendType" SG_ 659 DiagFrameForECMByte3 0;
BA_ "GenSigSendType" SG_ 659 DiagFrameForECMByte4 0;
BA_ "GenSigSendType" SG_ 659 DiagFrameForECMByte5 0;
BA_ "GenSigSendType" SG_ 659 DiagFrameForECMByte6 0;
BA_ "GenSigSendType" SG_ 659 DiagFrameForECMByte7 0;
BA_ "GenSigSendType" SG_ 1173 DiagcSigSWM 0;
BA_ "GenSigDataID" SG_ 1161 DmcStsFrntToEscChks "0x177E";
BA_ "GenSigFuncType" SG_ 1161 DmcStsFrntToEscChks 15;
BA_ "GenSigSendType" SG_ 1161 DmcStsFrntToEscChks 0;
BA_ "GenSigFuncType" SG_ 1161 DmcStsFrntToEscCntr 16;
BA_ "GenSigSendType" SG_ 1161 DmcStsFrntToEscCntr 0;
BA_ "GenSigSendType" SG_ 1161 DmcStsFrntToEscDmcActAppTarTq 0;
BA_ "GenSigSendType" SG_ 1161 DmcStsFrntToEscDmcSWInfo 0;
BA_ "GenSigSendType" SG_ 1161 DmcStsFrntToEscDmcSts 0;
BA_ "GenSigDataID" SG_ 1161 DrvrSteerActvChks "0xBC";
BA_ "GenSigFuncType" SG_ 1161 DrvrSteerActvChks 15;
BA_ "GenSigSendType" SG_ 1161 DrvrSteerActvChks 0;
BA_ "GenSigFuncType" SG_ 1161 DrvrSteerActvCntr 16;
BA_ "GenSigSendType" SG_ 1161 DrvrSteerActvCntr 0;
BA_ "GenSigSendType" SG_ 1161 DrvrSteerActvDrvrSteerActv 0;
BA_ "GenSigSendType" SG_ 659 DstEstimdToEmptyForDrvgElecPred 0;
BA_ "GenSigSendType" SG_ 416 EexvStsExvActrPosn 0;
BA_ "GenSigSendType" SG_ 416 EexvStsExvBlkErr 0;
BA_ "GenSigSendType" SG_ 416 EexvStsExvCalibSts 0;
BA_ "GenSigSendType" SG_ 416 EexvStsExvElecStsErr 0;
BA_ "GenSigSendType" SG_ 416 EexvStsExvMovSts 0;
BA_ "GenSigSendType" SG_ 416 EexvStsExvOvrTempErr 0;
BA_ "GenSigSendType" SG_ 416 EexvStsExvOvrTrvlErr 0;
BA_ "GenSigSendType" SG_ 416 EexvStsExvPreHeatgSts 0;
BA_ "GenSigSendType" SG_ 416 EexvStsExvVoltgRangErr 0;
BA_ "GenSigStartValue" SG_ 1161 ElecMot2IDc 8188;
BA_ "GenSigSendType" SG_ 1173 EnaOfflineMonitor 0;
BA_ "GenSigStartValue" SG_ 659 EngAmbTCalcd 120;
BA_ "GenSigSendType" SG_ 1173 EngLoadReqElec 0;
BA_ "GenSigSendType" SG_ 1173 EngRunngReqByVehModMgrChassie 0;
BA_ "GenSigSendType" SG_ 1173 EngRunngReqByVehModMgrClimate 0;
BA_ "GenSigSendType" SG_ 1173 EngRunngReqByVehModMgrElectricalSystem 0;
BA_ "GenSigSendType" SG_ 1173 EngRunngReqByVehModMgrTrailerPrsnt 0;
BA_ "GenSigSendType" SG_ 1173 EngSt1WdSts1 0;
BA_ "GenSigDataID" SG_ 1161 EpbAvlSecChks "0x464";
BA_ "GenSigFuncType" SG_ 1161 EpbAvlSecChks 15;
BA_ "GenSigSendType" SG_ 1161 EpbAvlSecChks 0;
BA_ "GenSigFuncType" SG_ 1161 EpbAvlSecCntr 16;
BA_ "GenSigSendType" SG_ 1161 EpbAvlSecCntr 0;
BA_ "GenSigSendType" SG_ 1161 EpbAvlSecCommunicationAvailable 0;
BA_ "GenSigSendType" SG_ 1161 EpbAvlSecHostAvailabilityFull 0;
BA_ "GenSigSendType" SG_ 1161 EpbAvlSecHostAvailabilityRelOnly 0;
BA_ "GenSigSendType" SG_ 1161 EpbAvlSecReserved1 0;
BA_ "GenSigSendType" SG_ 1161 EpbAvlSecReserved2 0;
BA_ "GenSigSendType" SG_ 1161 EpbAvlSecReserved3 0;
BA_ "GenSigSendType" SG_ 1161 EpbAvlSecReserved4 0;
BA_ "GenSigSendType" SG_ 1161 EpbAvlSecReserved5 0;
BA_ "GenSigSendType" SG_ 1161 EpbAvlSecReserved6 0;
BA_ "GenSigSendType" SG_ 1161 EpbAvlSecReserved7 0;
BA_ "GenSigSendType" SG_ 416 EtpASAStudyProcess 0;
BA_ "GenSigSendType" SG_ 416 EtpASAValueValid 0;
BA_ "GenSigSendType" SG_ 416 EtpActualSpeedBackup 0;
BA_ "GenSigSendType" SG_ 416 EtpActualSpeedEtpActualSpeed 0;
BA_ "GenSigSendType" SG_ 416 EtpActualSpeedSts 0;
BA_ "GenSigSendType" SG_ 416 EtpAngPosPlausSts 0;
BA_ "GenSigSendType" SG_ 416 EtpBatteryVoltage 0;
BA_ "GenSigSendType" SG_ 416 EtpCanNodeLoss 0;
BA_ "GenSigSendType" SG_ 416 EtpCurrentEtpCurrent 0;
BA_ "GenSigSendType" SG_ 416 EtpCurrentStsBackup 0;
BA_ "GenSigSendType" SG_ 416 EtpCurrent_Backup 0;
BA_ "GenSigSendType" SG_ 416 EtpEOPHydLeakSts 0;
BA_ "GenSigSendType" SG_ 416 EtpEnableOff 0;
BA_ "GenSigSendType" SG_ 416 EtpFaultSelfMos 0;
BA_ "GenSigSendType" SG_ 416 EtpGDUOverCurrent 0;
BA_ "GenSigSendType" SG_ 416 EtpGmrSpiCommErr 0;
BA_ "GenSigSendType" SG_ 416 EtpHallSignalError 0;
BA_ "GenSigSendType" SG_ 416 EtpHallSignalSt 0;
BA_ "GenSigSendType" SG_ 416 EtpIgnitionStatus 0;
BA_ "GenSigSendType" SG_ 416 EtpMcuTOutRngHiSts 0;
BA_ "GenSigSendType" SG_ 416 EtpMcuTOutRngLoSts 0;
BA_ "GenSigSendType" SG_ 416 EtpMcuTStuckSts 0;
BA_ "GenSigSendType" SG_ 416 EtpMcuTemperature 0;
BA_ "GenSigStartValue" SG_ 416 EtpMcuTemperature 50;
BA_ "GenSigSendType" SG_ 416 EtpMosTOpenSts 0;
BA_ "GenSigSendType" SG_ 416 EtpMosTOutRngHiSts 0;
BA_ "GenSigSendType" SG_ 416 EtpMosTOutRngLoSts 0;
BA_ "GenSigSendType" SG_ 416 EtpMosTShoBattSts 0;
BA_ "GenSigSendType" SG_ 416 EtpMosTShoGndSts 0;
BA_ "GenSigSendType" SG_ 416 EtpMosTStuckSts 0;
BA_ "GenSigSendType" SG_ 416 EtpMosTemperature 0;
BA_ "GenSigStartValue" SG_ 416 EtpMosTemperature 50;
BA_ "GenSigSendType" SG_ 416 EtpMosTemperatureBackup 0;
BA_ "GenSigStartValue" SG_ 416 EtpMosTemperatureBackup 50;
BA_ "GenSigSendType" SG_ 416 EtpOffseVoltageFailure 0;
BA_ "GenSigSendType" SG_ 416 EtpOverTemperature 0;
BA_ "GenSigSendType" SG_ 416 EtpOverTemperatureBackup 0;
BA_ "GenSigSendType" SG_ 416 EtpOverVoltage 0;
BA_ "GenSigSendType" SG_ 416 EtpPhaseCurrent 0;
BA_ "GenSigSendType" SG_ 416 EtpPhaseCurrentBackup 0;
BA_ "GenSigSendType" SG_ 416 EtpPhaseCurrentStsBackup 0;
BA_ "GenSigSendType" SG_ 416 EtpPhaseOverCurrent 0;
BA_ "GenSigSendType" SG_ 416 EtpPumpReady 0;
BA_ "GenSigSendType" SG_ 416 EtpResetReason 0;
BA_ "GenSigSendType" SG_ 416 EtpRunningStatus 0;
BA_ "GenSigSendType" SG_ 416 EtpSensorPowSupplyFau 0;
BA_ "GenSigSendType" SG_ 416 EtpSpdBaseAngleValue 0;
BA_ "GenSigSendType" SG_ 416 EtpSpdBaseAngleValueSts 0;
BA_ "GenSigSendType" SG_ 416 EtpSpdBaseUVWIncPos 0;
BA_ "GenSigSendType" SG_ 416 EtpSpdBaseUVWIncPosSts 0;
BA_ "GenSigSendType" SG_ 416 EtpStartFailure 0;
BA_ "GenSigSendType" SG_ 416 EtpUnderSpeed 0;
BA_ "GenSigSendType" SG_ 416 EtpUnderVoltage 0;
BA_ "GenSigSendType" SG_ 416 EtpVHDVoltageBackup 0;
BA_ "GenSigSendType" SG_ 416 EtpVHDVoltageEtpVHDVoltage 0;
BA_ "GenSigSendType" SG_ 416 EtpVoltagePlausSts 0;
BA_ "GenSigSendType" SG_ 422 EwpAflFlagCooling 0;
BA_ "GenSigSendType" SG_ 416 ExvStsExvActrPosn 0;
BA_ "GenSigSendType" SG_ 416 ExvStsExvBlkErr 0;
BA_ "GenSigSendType" SG_ 416 ExvStsExvCalibSts 0;
BA_ "GenSigSendType" SG_ 416 ExvStsExvElecStsErr 0;
BA_ "GenSigSendType" SG_ 416 ExvStsExvMovSts 0;
BA_ "GenSigSendType" SG_ 416 ExvStsExvOvrTempErr 0;
BA_ "GenSigSendType" SG_ 416 ExvStsExvOvrTrvlErr 0;
BA_ "GenSigSendType" SG_ 416 ExvStsExvPreHeatgSts 0;
BA_ "GenSigSendType" SG_ 416 ExvStsExvVoltgRangErr 0;
BA_ "GenSigSendType" SG_ 1173 FltOfBeamHiDrv 0;
BA_ "GenSigSendType" SG_ 1173 FltOfBeamLoDrv 0;
BA_ "GenSigSendType" SG_ 1173 FltOfCenHiMntdStopLamp 0;
BA_ "GenSigSendType" SG_ 1173 FltOfCenHiMntdStopLamp1 0;
BA_ "GenSigSendType" SG_ 1173 FltOfDaytiRunngLampDrv 0;
BA_ "GenSigSendType" SG_ 1173 FltOfFrntFogLampDrv 0;
BA_ "GenSigSendType" SG_ 1173 FltOfFrntPosnLampDrv 0;
BA_ "GenSigSendType" SG_ 1173 FltOfRePosnLampDrv 0;
BA_ "GenSigSendType" SG_ 1173 FltOfStopLampDrv 0;
BA_ "GenSigSendType" SG_ 1173 FltOfStopLampPass 0;
BA_ "GenSigSendType" SG_ 1173 FrLeReadLiReq 0;
BA_ "GenSigSendType" SG_ 1173 FrRiReadLiReq 0;
BA_ "GenSigSendType" SG_ 416 FrntHeatPwrAllwd 0;
BA_ "GenSigSendType" SG_ 659 HeatrPmpIAct 0;
BA_ "GenSigSendType" SG_ 659 HeatrPmpPwrCns 0;
BA_ "GenSigSendType" SG_ 569 HeatrPmpStatCooltPmpDryErr 0;
BA_ "GenSigSendType" SG_ 569 HeatrPmpStatCooltPmpEmgyModSts 0;
BA_ "GenSigSendType" SG_ 569 HeatrPmpStatCooltPmpErrSts 0;
BA_ "GenSigSendType" SG_ 569 HeatrPmpStatCooltPmpI 0;
BA_ "GenSigSendType" SG_ 569 HeatrPmpStatCooltPmpIErr 0;
BA_ "GenSigSendType" SG_ 569 HeatrPmpStatCooltPmpMonrSpd 0;
BA_ "GenSigSendType" SG_ 569 HeatrPmpStatCooltPmpPostRunSts 0;
BA_ "GenSigSendType" SG_ 569 HeatrPmpStatCooltPmpSetPostRunReq 0;
BA_ "GenSigSendType" SG_ 569 HeatrPmpStatCooltPmpSetSpdReq 0;
BA_ "GenSigSendType" SG_ 569 HeatrPmpStatCooltPmpSpd 0;
BA_ "GenSigSendType" SG_ 569 HeatrPmpStatCooltPmpT 0;
BA_ "GenSigStartValue" SG_ 569 HeatrPmpStatCooltPmpT 100;
BA_ "GenSigSendType" SG_ 569 HeatrPmpStatCooltPmpTErr 0;
BA_ "GenSigSendType" SG_ 569 HeatrPmpStatCooltPmpU 0;
BA_ "GenSigSendType" SG_ 569 HeatrPmpStatCooltPmpUErr 0;
BA_ "GenSigSendType" SG_ 569 HeatrPmpStatCooltPmpUnstallSts 0;
BA_ "GenSigSendType" SG_ 659 HeatrPmpUAct 0;
BA_ "GenSigSendType" SG_ 1173 HornSwitchSts 0;
BA_ "GenSigSendType" SG_ 1173 HvActvForVehModReq 0;
BA_ "GenSigSendType" SG_ 422 HvActvReq 0;
BA_ "GenSigSendType" SG_ 1173 HvActvSts 0;
BA_ "GenSigSendType" SG_ 659 HvBattPmpPwrCns 0;
BA_ "GenSigSendType" SG_ 659 HvBattThermInfoCorrInFuturePwrAtTime 0;
BA_ "GenSigStartValue" SG_ 659 HvBattThermInfoCorrInFuturePwrAtTime 500;
BA_ "GenSigSendType" SG_ 659 HvBattThermInfoCorrInFutureSequenceNo 0;
BA_ "GenSigSendType" SG_ 659 HvBattThermInfoCorrInFutureTempAtTime 0;
BA_ "GenSigStartValue" SG_ 659 HvBattThermInfoCorrInFutureTempAtTime 50;
BA_ "GenSigSendType" SG_ 659 HvBattThermInfoCorrInFutureThermModAtTime 0;
BA_ "GenSigSendType" SG_ 659 HvBattThermInfoCorrInFutureTime 0;
BA_ "GenSigSendType" SG_ 659 HvBattThermInfoCorrInFutureVersionNo 0;
BA_ "GenSigSendType" SG_ 416 HvClimaCoolgPwrCritDes 0;
BA_ "GenSigSendType" SG_ 416 HvClimaHeatgPwrCritDes 0;
BA_ "GenSigSendType" SG_ 1173 HvCoolgPwrAllwd 0;
BA_ "GenSigSendType" SG_ 416 HvCoolgPwrCritDes 0;
BA_ "GenSigSendType" SG_ 416 HvCoolgPwrNormDes 0;
BA_ "GenSigSendType" SG_ 1173 HvHeatgPwrAllwd 0;
BA_ "GenSigSendType" SG_ 416 HvHeatgPwrCritDes 0;
BA_ "GenSigSendType" SG_ 416 HvHeatgPwrNormDes 0;
BA_ "GenSigSendType" SG_ 659 HvWtrHeatrWtrTDes 0;
BA_ "GenSigStartValue" SG_ 659 HvWtrHeatrWtrTDes 40;
BA_ "GenSigSendType" SG_ 416 HvchOnForBattHeatg 0;
BA_ "GenSigSendType" SG_ 1173 HwRowFrstDrvrFrntHeiMotCtrl 0;
BA_ "GenSigSendType" SG_ 1173 HwRowFrstDrvrHeiMotCtrl 0;
BA_ "GenSigSendType" SG_ 1173 HwRowFrstDrvrInclMotCtrl 0;
BA_ "GenSigSendType" SG_ 1173 HwRowFrstDrvrSldMotCtrl 0;
BA_ "GenSigSendType" SG_ 1173 IndicatorIntensityLvl 0;
BA_ "GenSigStartValue" SG_ 1173 IndicatorIntensityLvl 100;
BA_ "GenSigSendType" SG_ 1173 IntLightTreadPlateSupply 0;
BA_ "GenSigSendType" SG_ 1173 IntrBriStsFromIf 0;
BA_ "GenSigSendType" SG_ 1173 IntrLiRoofAUTOIndication 0;
BA_ "GenSigSendType" SG_ 1173 IntrMirrCmdDrvrSide 0;
BA_ "GenSigSendType" SG_ 1173 IntrMirrCmdIntrMirrAsyFanCmpMag 0;
BA_ "GenSigSendType" SG_ 1173 IntrMirrCmdIntrMirrDiagcRst 0;
BA_ "GenSigStartValue" SG_ 1173 IntrMirrCmdIntrMirrDiagcRst 1;
BA_ "GenSigSendType" SG_ 1173 IntrMirrCmdIntrMirrDimSnvty 0;
BA_ "GenSigSendType" SG_ 1173 IntrMirrCmdIntrMirrEna 0;
BA_ "GenSigSendType" SG_ 1173 IntrMirrCmdIntrMirrInhbDim 0;
BA_ "GenSigSendType" SG_ 1173 IntrMirrCmdIntrMirrWindHeatrCmpMag 0;
BA_ "GenSigSendType" SG_ 422 IsgCoolgReqInvrCloud 0;
BA_ "GenSigSendType" SG_ 422 IsgCooltFlowMinReqCloud 0;
BA_ "GenSigSendType" SG_ 422 IsgCrashValueForETP 0;
BA_ "GenSigSendType" SG_ 1161 IsgErrIndcnReq 0;
BA_ "GenSigSendType" SG_ 416 IsgFlg20ForEOP 0;
BA_ "GenSigSendType" SG_ 416 IsgForWRCIsgSpdForWRC 0;
BA_ "GenSigStartValue" SG_ 416 IsgForWRCIsgSpdForWRC 20000;
BA_ "GenSigSendType" SG_ 416 IsgForWRCIsgTqEstForWRC 0;
BA_ "GenSigStartValue" SG_ 416 IsgForWRCIsgTqEstForWRC 8000;
BA_ "GenSigSendType" SG_ 422 IsgHeatFdBckCloud 0;
BA_ "GenSigSendType" SG_ 659 IsgHeatPwrAct 0;
BA_ "GenSigSendType" SG_ 659 IsgHeatPwrMax 0;
BA_ "GenSigSendType" SG_ 1161 IsgLimnIndcn 0;
BA_ "GenSigSendType" SG_ 416 IsgOPCStartOnForETP 0;
BA_ "GenSigSendType" SG_ 416 IsgOilPmpTargetSpeedForETP 0;
BA_ "GenSigSendType" SG_ 416 IsgOilPmpTemperatureForETP 0;
BA_ "GenSigStartValue" SG_ 416 IsgOilPmpTemperatureForETP 50;
BA_ "GenSigDataID" SG_ 1161 IsgSpdActSgnSafeChks "0x1B5B";
BA_ "GenSigFuncType" SG_ 1161 IsgSpdActSgnSafeChks 15;
BA_ "GenSigSendType" SG_ 1161 IsgSpdActSgnSafeChks 0;
BA_ "GenSigFuncType" SG_ 1161 IsgSpdActSgnSafeCntr 16;
BA_ "GenSigSendType" SG_ 1161 IsgSpdActSgnSafeCntr 0;
BA_ "GenSigSendType" SG_ 1161 IsgSpdActSgnSafeIsgSpdWSgnTyp 0;
BA_ "GenSigSendType" SG_ 1161 IsgSpdActSgnSafeQf 0;
BA_ "GenSigStartValue" SG_ 1161 IsgSpdActSgnSafeQf 1;
BA_ "GenSigSendType" SG_ 416 IsgTPlausStsForETP 0;
BA_ "GenSigSendType" SG_ 1161 IsgTqAvlMax 0;
BA_ "GenSigStartValue" SG_ 1161 IsgTqAvlMax 8188;
BA_ "GenSigSendType" SG_ 1161 IsgTqAvlMin 0;
BA_ "GenSigStartValue" SG_ 1161 IsgTqAvlMin 8188;
BA_ "GenSigSendType" SG_ 422 IvtrActId 0;
BA_ "GenSigStartValue" SG_ 422 IvtrActId 1023;
BA_ "GenSigSendType" SG_ 422 IvtrActIq 0;
BA_ "GenSigStartValue" SG_ 422 IvtrActIq 1023;
BA_ "GenSigSendType" SG_ 422 IvtrActvDchaSts 0;
BA_ "GenSigSendType" SG_ 422 IvtrDAxisCurrtSp 0;
BA_ "GenSigStartValue" SG_ 422 IvtrDAxisCurrtSp 1023;
BA_ "GenSigSendType" SG_ 422 IvtrDAxisU 0;
BA_ "GenSigStartValue" SG_ 422 IvtrDAxisU 13100;
BA_ "GenSigSendType" SG_ 422 IvtrDeratingReason 0;
BA_ "GenSigSendType" SG_ 422 IvtrDeratingSts 0;
BA_ "GenSigSendType" SG_ 422 IvtrGateSts 0;
BA_ "GenSigSendType" SG_ 422 IvtrIgbtJunctionT 0;
BA_ "GenSigStartValue" SG_ 422 IvtrIgbtJunctionT 40;
BA_ "GenSigSendType" SG_ 422 IvtrModlnIdx 0;
BA_ "GenSigSendType" SG_ 422 IvtrMotActModSts 0;
BA_ "GenSigSendType" SG_ 422 IvtrOffsAgIvtrOffsAg 0;
BA_ "GenSigSendType" SG_ 422 IvtrOffsAgSts 0;
BA_ "GenSigSendType" SG_ 422 IvtrOilT 0;
BA_ "GenSigStartValue" SG_ 422 IvtrOilT 40;
BA_ "GenSigSendType" SG_ 422 IvtrOilTSnsrSplyV 0;
BA_ "GenSigSendType" SG_ 422 IvtrPhaPwmDutyIvtrPhaUPwmDuty 0;
BA_ "GenSigSendType" SG_ 422 IvtrPhaPwmDutyIvtrPhaVPwmDuty 0;
BA_ "GenSigSendType" SG_ 422 IvtrPhaPwmDutyIvtrPhaWPwmDuty 0;
BA_ "GenSigSendType" SG_ 422 IvtrQAxisCurrtSp 0;
BA_ "GenSigStartValue" SG_ 422 IvtrQAxisCurrtSp 1023;
BA_ "GenSigSendType" SG_ 422 IvtrQAxisU 0;
BA_ "GenSigStartValue" SG_ 422 IvtrQAxisU 13100;
BA_ "GenSigSendType" SG_ 422 IvtrReqIdWithLimn 0;
BA_ "GenSigStartValue" SG_ 422 IvtrReqIdWithLimn 1023;
BA_ "GenSigSendType" SG_ 422 IvtrReqIqWithLimn 0;
BA_ "GenSigStartValue" SG_ 422 IvtrReqIqWithLimn 1023;
BA_ "GenSigSendType" SG_ 422 IvtrResolverAg 0;
BA_ "GenSigSendType" SG_ 422 IvtrSftyFctMod 0;
BA_ "GenSigSendType" SG_ 422 IvtrSftySpd 0;
BA_ "GenSigStartValue" SG_ 422 IvtrSftySpd 20000;
BA_ "GenSigSendType" SG_ 422 IvtrSftyTq 0;
BA_ "GenSigStartValue" SG_ 422 IvtrSftyTq 8000;
BA_ "GenSigSendType" SG_ 422 IvtrSftyTqQf 0;
BA_ "GenSigSendType" SG_ 422 IvtrTqDir 0;
BA_ "GenSigSendType" SG_ 422 IvtrTraPhaCurrtAryU 0;
BA_ "GenSigStartValue" SG_ 422 IvtrTraPhaCurrtAryU 1023;
BA_ "GenSigSendType" SG_ 422 IvtrTraPhaCurrtAryV 0;
BA_ "GenSigStartValue" SG_ 422 IvtrTraPhaCurrtAryV 1023;
BA_ "GenSigSendType" SG_ 422 IvtrTraPhaCurrtAryW 0;
BA_ "GenSigStartValue" SG_ 422 IvtrTraPhaCurrtAryW 1023;
BA_ "GenSigDataID" SG_ 1173 LatCtrlModCfmdChks "0x3A";
BA_ "GenSigFuncType" SG_ 1173 LatCtrlModCfmdChks 15;
BA_ "GenSigSendType" SG_ 1173 LatCtrlModCfmdChks 0;
BA_ "GenSigFuncType" SG_ 1173 LatCtrlModCfmdCntr 16;
BA_ "GenSigSendType" SG_ 1173 LatCtrlModCfmdCntr 0;
BA_ "GenSigSendType" SG_ 1173 LatCtrlModCfmdLatCtrlMod 0;
BA_ "GenSigSendType" SG_ 659 LiBattInPWLock 0;
BA_ "GenSigSendType" SG_ 416 LoTemEneStorage 0;
BA_ "GenSigSendType" SG_ 1173 MirrDefrstAtDrvrCmd 0;
BA_ "GenSigSendType" SG_ 1173 MirrSeldIndcn 0;
BA_ "GenSigStartValue" SG_ 1161 Mot1ReqSafetq 8188;
BA_ "GenSigStartValue" SG_ 1161 Mot3ReqSafetq 8188;
BA_ "GenSigSendType" SG_ 422 MotSpdForWRC 0;
BA_ "GenSigStartValue" SG_ 422 MotSpdForWRC 20000;
BA_ "GenSigSendType" SG_ 422 MotTqEstForWRC 0;
BA_ "GenSigStartValue" SG_ 422 MotTqEstForWRC 8000;
BA_ "GenSigSendType" SG_ 422 MotorHeatrPwrCnsDes 0;
BA_ "GenSigSendType" SG_ 82 NFCAndBLEKeyDiReqData1 1;
BA_ "GenSigSendType" SG_ 82 NFCAndBLEKeyDiReqData10 1;
BA_ "GenSigSendType" SG_ 82 NFCAndBLEKeyDiReqData11 1;
BA_ "GenSigSendType" SG_ 82 NFCAndBLEKeyDiReqData12 1;
BA_ "GenSigSendType" SG_ 82 NFCAndBLEKeyDiReqData13 1;
BA_ "GenSigSendType" SG_ 82 NFCAndBLEKeyDiReqData14 1;
BA_ "GenSigSendType" SG_ 82 NFCAndBLEKeyDiReqData15 1;
BA_ "GenSigSendType" SG_ 82 NFCAndBLEKeyDiReqData16 1;
BA_ "GenSigSendType" SG_ 82 NFCAndBLEKeyDiReqData2 1;
BA_ "GenSigSendType" SG_ 82 NFCAndBLEKeyDiReqData3 1;
BA_ "GenSigSendType" SG_ 82 NFCAndBLEKeyDiReqData4 1;
BA_ "GenSigSendType" SG_ 82 NFCAndBLEKeyDiReqData5 1;
BA_ "GenSigSendType" SG_ 82 NFCAndBLEKeyDiReqData6 1;
BA_ "GenSigSendType" SG_ 82 NFCAndBLEKeyDiReqData7 1;
BA_ "GenSigSendType" SG_ 82 NFCAndBLEKeyDiReqData8 1;
BA_ "GenSigSendType" SG_ 82 NFCAndBLEKeyDiReqData9 1;
BA_ "GenSigSendType" SG_ 82 NFCKeySearchReqKeyLocn 1;
BA_ "GenSigSendType" SG_ 82 NFCKeySearchReqTirgger 1;
BA_ "GenSigSendType" SG_ 422 OTAActvHVReq 0;
BA_ "GenSigSendType" SG_ 1173 PanicAlrmAcoustReq 0;
BA_ "GenSigSendType" SG_ 1173 PanicAlrmToExtrLiVisReq 0;
BA_ "GenSigSendType" SG_ 422 PredDrvPwrReq 0;
BA_ "GenSigStartValue" SG_ 422 PredDrvPwrReq 1000;
BA_ "GenSigSendType" SG_ 422 PredTarSoc 0;
BA_ "GenSigSendType" SG_ 1173 PropsEnabfromAlcoLock 0;
BA_ "GenSigSendType" SG_ 422 PrpsnAllwd 0;
BA_ "GenSigSendType" SG_ 1173 PtActvnReq1WdPtActvnReq 0;
BA_ "GenSigStartValue" SG_ 1161 PtCluTq2Req 1024;
BA_ "GenSigStartValue" SG_ 1161 PtCluTqDyn 1024;
BA_ "GenSigStartValue" SG_ 1161 PtCluTqPtCluTq 1024;
BA_ "GenSigSendType" SG_ 659 PtCoolgPostRunActv 0;
BA_ "GenSigSendType" SG_ 1161 PtParkReqToWhlsRe 0;
BA_ "GenSigSendType" SG_ 659 PtTotBrkTqReqPtTotBrkTqEna 0;
BA_ "GenSigSendType" SG_ 659 PtTotBrkTqReqPtTotBrkTqReq 0;
BA_ "GenSigSendType" SG_ 422 PtTqMCUPtTqFrntMotMaxReq 0;
BA_ "GenSigStartValue" SG_ 422 PtTqMCUPtTqFrntMotMaxReq 8000;
BA_ "GenSigSendType" SG_ 422 PtTqMCUPtTqFrntMotMinReq 0;
BA_ "GenSigStartValue" SG_ 422 PtTqMCUPtTqFrntMotMinReq 8000;
BA_ "GenSigSendType" SG_ 422 PtTqMCUPtTqReMotMaxReq 0;
BA_ "GenSigStartValue" SG_ 422 PtTqMCUPtTqReMotMaxReq 8000;
BA_ "GenSigSendType" SG_ 422 PtTqMCUPtTqReMotMinReq 0;
BA_ "GenSigStartValue" SG_ 422 PtTqMCUPtTqReMotMinReq 8000;
BA_ "GenSigSendType" SG_ 1173 PwrCnsVisy 0;
BA_ "GenSigSendType" SG_ 1173 PwrCritDesVisy 0;
BA_ "GenSigSendType" SG_ 1173 PwrEstimdAtStbForVisy 0;
BA_ "GenSigSendType" SG_ 1173 PwrNormDesVisy 0;
BA_ "GenSigSendType" SG_ 1173 RainSensActvn 0;
BA_ "GenSigSendType" SG_ 659 RainSnsrActvnErrToHmi 0;
BA_ "GenSigSendType" SG_ 1173 RainSnsrSnvtyForUsrSnvty0 0;
BA_ "GenSigSendType" SG_ 1173 RainSnsrSnvtyForUsrSnvty1 0;
BA_ "GenSigSendType" SG_ 1173 RainSnsrSnvtyForUsrSnvty2 0;
BA_ "GenSigSendType" SG_ 1173 RainSnsrSnvtyForUsrSnvty3 0;
BA_ "GenSigSendType" SG_ 1173 RainSnsrSnvtyForUsrSnvty4 0;
BA_ "GenSigSendType" SG_ 1173 RainSnsrSnvtyForUsrSnvty5 0;
BA_ "GenSigSendType" SG_ 1173 RainSnsrSnvtyForUsrSnvty6 0;
BA_ "GenSigSendType" SG_ 1173 ReAdaptReq 0;
BA_ "GenSigSendType" SG_ 1173 RelHumSnsrErr 0;
BA_ "GenSigSendType" SG_ 422 RemStrt 0;
BA_ "GenSigSendType" SG_ 1173 RemStrtMsgToDrvrRemStrtBlkd1 0;
BA_ "GenSigSendType" SG_ 1173 RemStrtMsgToDrvrRemStrtDev1 0;
BA_ "GenSigSendType" SG_ 659 ResrvdSigForCCM1 0;
BA_ "GenSigSendType" SG_ 659 ResrvdSigForCCM2 0;
BA_ "GenSigSendType" SG_ 659 ResrvdSigForCCM3 0;
BA_ "GenSigSendType" SG_ 659 ResrvdSigForCCM4 0;
BA_ "GenSigSendType" SG_ 1173 RlyActvnForRoofCurtClsAut 0;
BA_ "GenSigSendType" SG_ 1173 SecRowLeReadLiReq 0;
BA_ "GenSigSendType" SG_ 1173 SecRowRiReadLiReq 0;
BA_ "GenSigSendType" SG_ 920 ShortDropWinDrvrSts 0;
BA_ "GenSigSendType" SG_ 920 ShortDropWinReLeSts 0;
BA_ "GenSigSendType" SG_ 659 StandStillReqForCmftToBrkgForEPedl 0;
BA_ "GenSigSendType" SG_ 1161 SteerExtFctStsChks 0;
BA_ "GenSigSendType" SG_ 1161 SteerExtFctStsCntr 0;
BA_ "GenSigSendType" SG_ 1161 SteerExtFctStsDrvrSteerOvrd 0;
BA_ "GenSigSendType" SG_ 1161 SteerExtFctStsExtFctLowerLimActive 0;
BA_ "GenSigSendType" SG_ 1161 SteerExtFctStsExtFctRateLimActive 0;
BA_ "GenSigSendType" SG_ 1161 SteerExtFctStsExtFctUpperLimActive 0;
BA_ "GenSigSendType" SG_ 1161 SteerExtFctStsExtSafeLimActive 0;
BA_ "GenSigSendType" SG_ 1161 SteerExtFctStsLatAgReqNotInRange 0;
BA_ "GenSigSendType" SG_ 1161 SteerExtFctStsLatCtrlReqNotInRange 0;
BA_ "GenSigSendType" SG_ 1173 SteerLockEnagOfPrpsn 0;
BA_ "GenSigSendType" SG_ 659 SteerLockMgrWarnIndcn 0;
BA_ "GenSigSendType" SG_ 1173 SteerWhlTqAddl 0;
BA_ "GenSigSendType" SG_ 659 StrtRemSts1WdStrtRemSts 0;
BA_ "GenSigSendType" SG_ 1173 SunCurtEna 0;
BA_ "GenSigSendType" SG_ 920 SunRoofAndCurtBtnSts2Cntr 0;
BA_ "GenSigSendType" SG_ 920 SunRoofAndCurtBtnSts2Pos 0;
BA_ "GenSigSendType" SG_ 1173 SunRoofAndCurtExtCmd 0;
BA_ "GenSigSendType" SG_ 920 SunRoofImpctDetnSts2 0;
BA_ "GenSigStartValue" SG_ 1161 SuspFailrStsTypQf 1;
BA_ "GenSigSendType" SG_ 1173 SwtBeamHi 0;
BA_ "GenSigSendType" SG_ 1173 SwtLiHzrdWarn 0;
BA_ "GenSigSendType" SG_ 1173 TankFlapReqFromSwtIntrFild 0;
BA_ "GenSigSendType" SG_ 1161 TqAssAddl 0;
BA_ "GenSigSendType" SG_ 1173 TrOpenerReqTrOpenerReq 0;
BA_ "GenSigSendType" SG_ 1173 TrOpenerReqTrigSrc 0;
BA_ "GenSigSendType" SG_ 1161 TrlrModVMMFltSts 0;
BA_ "GenSigStartValue" SG_ 1161 TrsmActrPosnSafeAuxTrsmActrPosn 7;
BA_ "GenSigStartValue" SG_ 1161 TrsmOilT 60;
BA_ "GenSigSendType" SG_ 659 VehPropSts 0;
BA_ "GenSigSendType" SG_ 1173 WiprActv 0;
BA_ "GenSigSendType" SG_ 1173 WiprInWipgAr 0;
BA_ "GenSigStartValue" SG_ 920 WiprMotDiagcWiprMotHiVoltDetd 1;
BA_ "GenSigStartValue" SG_ 920 WiprMotDiagcWiprMotLoVoltDetd 1;
BA_ "GenSigStartValue" SG_ 920 WiprMotDiagcWiprMotOvldDetd 1;
BA_ "GenSigStartValue" SG_ 920 WiprMotErrSafe 1;
BA_ "GenSigSendType" SG_ 1173 WiprMotFrntLvrCmdSafeLvrInHiSpdPosnSafe 0;
BA_ "GenSigStartValue" SG_ 1173 WiprMotFrntLvrCmdSafeLvrInHiSpdPosnSafe 1;
BA_ "GenSigSendType" SG_ 1173 WiprMotFrntLvrCmdSafeLvrInIntlPosn 0;
BA_ "GenSigSendType" SG_ 1173 WiprMotFrntLvrCmdSafeLvrInLoSpdPosnSafe 0;
BA_ "GenSigStartValue" SG_ 1173 WiprMotFrntLvrCmdSafeLvrInLoSpdPosnSafe 1;
BA_ "GenSigSendType" SG_ 1173 WiprMotFrntLvrCmdSafeLvrInSnglStrokePos 0;
BA_ "GenSigSendType" SG_ 659 WiprSysFailrDetdSafe 0;
BA_ "GenSigStartValue" SG_ 659 WiprSysFailrDetdSafe 1;
BA_ "GenSigSendType" SG_ 659 WshrFldTankStsToHMI 0;
VAL_ 1161 DmcStsFrntToEscDmcSts 0 "DMC_Init" 1 "DMC_On" 2 "DMC_Off" 3 "DMC_Fault";
VAL_ 1161 DrvrSteerActvDrvrSteerActv 0 "OnOff1_Off" 1 "OnOff1_On";
VAL_ 1161 EpbAvlSecCommunicationAvailable 0 "MsgSts_Inactive" 1 "MsgSts_Active";
VAL_ 1161 EpbAvlSecHostAvailabilityFull 0 "MsgSts_Inactive" 1 "MsgSts_Active";
VAL_ 1161 EpbAvlSecHostAvailabilityRelOnly 0 "MsgSts_Inactive" 1 "MsgSts_Active";
VAL_ 1161 EpbAvlSecReserved1 0 "MsgSts_Inactive" 1 "MsgSts_Active";
VAL_ 1161 EpbAvlSecReserved2 0 "MsgSts_Inactive" 1 "MsgSts_Active";
VAL_ 1161 EpbAvlSecReserved3 0 "MsgSts_Inactive" 1 "MsgSts_Active";
VAL_ 1161 EpbAvlSecReserved4 0 "MsgSts_Inactive" 1 "MsgSts_Active";
VAL_ 1161 EpbAvlSecReserved5 0 "MsgSts_Inactive" 1 "MsgSts_Active";
VAL_ 1161 EpbAvlSecReserved6 0 "MsgSts_Inactive" 1 "MsgSts_Active";
VAL_ 1161 EpbAvlSecReserved7 0 "MsgSts_Inactive" 1 "MsgSts_Active";
VAL_ 1161 IsgErrIndcnReq 0 "OnOff1_Off" 1 "OnOff1_On";
VAL_ 1161 IsgSpdActSgnSafeQf 0 "GenQf1_UndefindDataAccur" 1 "GenQf1_TmpUndefdData" 2 "GenQf1_DataAccurNotWithinSpcn" 3 "GenQf1_AccurData";
VAL_ 1161 Mot1ReqSafemod 0 "IsgModTyp1_Inin" 1 "IsgModTyp1_Stb" 2 "IsgModTyp1_TqCtrl" 3 "IsgModTyp1_SpdCtrl" 4 "IsgModTyp1_UDcCtrl" 5 "IsgModTyp1_PreChrg" 6 "IsgModTyp1_PwrDwn" 7 "IsgModTyp1_Flt" 8 "IsgModTyp1_TcsCtrl" 9 "IsgModTyp1_Reserved1" 10 "IsgModTyp1_Reserved2" 11 "IsgModTyp1_Reserved3" 12 "IsgModTyp1_Reserved4" 13 "IsgModTyp1_Reserved5" 14 "IsgModTyp1_Reserved6" 15 "IsgModTyp1_Reserved7";
VAL_ 1161 Mot3ReqSafemod 0 "IsgModTyp1_Inin" 1 "IsgModTyp1_Stb" 2 "IsgModTyp1_TqCtrl" 3 "IsgModTyp1_SpdCtrl" 4 "IsgModTyp1_UDcCtrl" 5 "IsgModTyp1_PreChrg" 6 "IsgModTyp1_PwrDwn" 7 "IsgModTyp1_Flt" 8 "IsgModTyp1_TcsCtrl" 9 "IsgModTyp1_Reserved1" 10 "IsgModTyp1_Reserved2" 11 "IsgModTyp1_Reserved3" 12 "IsgModTyp1_Reserved4" 13 "IsgModTyp1_Reserved5" 14 "IsgModTyp1_Reserved6" 15 "IsgModTyp1_Reserved7";
VAL_ 1161 PtCluTqQly 0 "Qly3_De0" 1 "Qly3_De1" 2 "Qly3_De2" 3 "Qly3_De3" 4 "Qly3_De4" 5 "Qly3_De5" 6 "Qly3_De6" 7 "Qly3_De7";
VAL_ 1161 PtGearTarReq 0 "GearIndcnTyp3_Neut" 1 "GearIndcnTyp3_Gear1" 2 "GearIndcnTyp3_Gear2" 3 "GearIndcnTyp3_Gear3" 4 "GearIndcnTyp3_N1" 5 "GearIndcnTyp3_N12" 6 "GearIndcnTyp3_N23" 7 "GearIndcnTyp3_N3";
VAL_ 1161 PtParkReqToWhlsRe 0 "ReqSts1_NotReqd" 1 "ReqSts1_Reqd";
VAL_ 1161 SteerExtFctStsDrvrSteerOvrd 0 "Boolean_FALSE" 1 "Boolean_TRUE";
VAL_ 1161 SteerExtFctStsExtFctLowerLimActive 0 "Boolean_FALSE" 1 "Boolean_TRUE";
VAL_ 1161 SteerExtFctStsExtFctRateLimActive 0 "Boolean_FALSE" 1 "Boolean_TRUE";
VAL_ 1161 SteerExtFctStsExtFctUpperLimActive 0 "Boolean_FALSE" 1 "Boolean_TRUE";
VAL_ 1161 SteerExtFctStsExtSafeLimActive 0 "Boolean_FALSE" 1 "Boolean_TRUE";
VAL_ 1161 SteerExtFctStsLatAgReqNotInRange 0 "Boolean_FALSE" 1 "Boolean_TRUE";
VAL_ 1161 SteerExtFctStsLatCtrlReqNotInRange 0 "Boolean_FALSE" 1 "Boolean_TRUE";
VAL_ 1161 SuspFailrStsSuspFailrSts 0 "SuspFailrStsTyp2_NoErr" 1 "SuspFailrStsTyp2_TrSwtConUsg" 2 "SuspFailrStsTyp2_CmprOvrheatd" 3 "SuspFailrStsTyp2_SrvRqrdErr" 4 "SuspFailrStsTyp2_StopCritErr" 5 "SuspFailrStsTyp2_LoAirM" 6 "SuspFailrStsTyp2_HiAirM" 7 "SuspFailrStsTyp2_VehLvlHiOrLoErr";
VAL_ 1161 SuspFailrStsTypQf 0 "GenQf1_UndefindDataAccur" 1 "GenQf1_TmpUndefdData" 2 "GenQf1_DataAccurNotWithinSpcn" 3 "GenQf1_AccurData";
VAL_ 1161 TrlrModVMMFltSts 0 "Boolean_FALSE" 1 "Boolean_TRUE";
VAL_ 1161 TrsmActrPosnSafeAuxTrsmActrPosn 0 "TrsmActrPosn1_Park" 1 "TrsmActrPosn1_ParkRvs" 2 "TrsmActrPosn1_Rvs" 3 "TrsmActrPosn1_RvsNeut" 4 "TrsmActrPosn1_Neut" 5 "TrsmActrPosn1_NeutDrv" 6 "TrsmActrPosn1_Drv" 7 "TrsmActrPosn1_Undefd";
VAL_ 1161 TrsmNeutFailr 0 "TrsmNeutFailr1_NeutPsbl" 1 "TrsmNeutFailr1_NeutNotPsbl";
VAL_ 1161 WrmUpCyc 0 "OnOff1_Off" 1 "OnOff1_On";
VAL_ 1173 BswRstReason 0 "BswRstReason_NotKnown" 1 "BswRstReason_PowerOnReset" 2 "BswRstReason_ExternalReset" 3 "BswRstReason_SWReset" 4 "BswRstReason_Reserved1" 5 "BswRstReason_Reserved2" 6 "BswRstReason_Reserved3" 7 "BswRstReason_Reserved4";
VAL_ 1173 CarLoctrToExtrLiVisReq 0 "ExtrLiVisReq_ExtrLiVisReqAlrmOff" 1 "ExtrLiVisReq_ExtrLiVisReqAlrm1" 2 "ExtrLiVisReq_ExtrLiVisReqAlrm2";
VAL_ 1173 DiagcSigSWM 0 "Nofault" 1 "Commonfailure" 2 "KL30overvoltage" 3 "HSSovercurInSWSorhartoSWS";
VAL_ 1173 EnaOfflineMonitor 0 "Boolean_FALSE" 1 "Boolean_TRUE";
VAL_ 1173 EngRunngReqByVehModMgrChassie 0 "Boolean_FALSE" 1 "Boolean_TRUE";
VAL_ 1173 EngRunngReqByVehModMgrClimate 0 "Boolean_FALSE" 1 "Boolean_TRUE";
VAL_ 1173 EngRunngReqByVehModMgrElectricalSystem 0 "Boolean_FALSE" 1 "Boolean_TRUE";
VAL_ 1173 EngRunngReqByVehModMgrTrailerPrsnt 0 "Boolean_FALSE" 1 "Boolean_TRUE";
VAL_ 1173 EngSt1WdSts1 0 "EngSt1_Ini" 1 "EngSt1_Awake" 2 "EngSt1_Rdy" 3 "EngSt1_PreStrtg" 4 "EngSt1_StrtgInProgs" 5 "EngSt1_RunngRunng" 6 "EngSt1_RunngStb" 7 "EngSt1_RunngStrtgInProgs" 8 "EngSt1_RunngRemStrtd" 9 "EngSt1_AftRun";
VAL_ 1173 FltOfBeamHiDrv 0 "DevErrSts2_NoFlt" 1 "DevErrSts2_Flt";
VAL_ 1173 FltOfBeamLoDrv 0 "DevErrSts2_NoFlt" 1 "DevErrSts2_Flt";
VAL_ 1173 FltOfCenHiMntdStopLamp 0 "DevErrSts2_NoFlt" 1 "DevErrSts2_Flt";
VAL_ 1173 FltOfCenHiMntdStopLamp1 0 "OnOff1_Off" 1 "OnOff1_On";
VAL_ 1173 FltOfDaytiRunngLampDrv 0 "DevErrSts2_NoFlt" 1 "DevErrSts2_Flt";
VAL_ 1173 FltOfFrntFogLampDrv 0 "DevErrSts2_NoFlt" 1 "DevErrSts2_Flt";
VAL_ 1173 FltOfFrntPosnLampDrv 0 "DevErrSts2_NoFlt" 1 "DevErrSts2_Flt";
VAL_ 1173 FltOfRePosnLampDrv 0 "DevErrSts2_NoFlt" 1 "DevErrSts2_Flt";
VAL_ 1173 FltOfStopLampDrv 0 "DevErrSts2_NoFlt" 1 "DevErrSts2_Flt";
VAL_ 1173 FltOfStopLampPass 0 "DevErrSts2_NoFlt" 1 "DevErrSts2_Flt";
VAL_ 1173 HornSwitchSts 0 "OnOff1_Off" 1 "OnOff1_On";
VAL_ 1173 HvActvForVehModReq 0 "OnOff1_Off" 1 "OnOff1_On";
VAL_ 1173 HvActvSts 0 "HvActvSts_Default" 1 "HvActvSts_CPSRIsActivated" 2 "HvActvSts_CPSRPlusContactorsIsActivated" 3 "HvActvSts_Error";
VAL_ 1173 HwRowFrstDrvrFrntHeiMotCtrl 0 "SwtVertSts1_Idle" 1 "SwtVertSts1_Up" 2 "SwtVertSts1_Dwn";
VAL_ 1173 HwRowFrstDrvrHeiMotCtrl 0 "SwtVertSts1_Idle" 1 "SwtVertSts1_Up" 2 "SwtVertSts1_Dwn";
VAL_ 1173 HwRowFrstDrvrInclMotCtrl 0 "SwtHozlSts1_Idle" 1 "SwtHozlSts1_Fwd" 2 "SwtHozlSts1_Backw";
VAL_ 1173 HwRowFrstDrvrSldMotCtrl 0 "SwtHozlSts1_Idle" 1 "SwtHozlSts1_Fwd" 2 "SwtHozlSts1_Backw";
VAL_ 1173 IntrLiRoofAUTOIndication 0 "Boolean_FALSE" 1 "Boolean_TRUE";
VAL_ 1173 IntrMirrCmdDrvrSide 0 "RiLeTyp_Right" 1 "RiLeTyp_Left";
VAL_ 1173 IntrMirrCmdIntrMirrAsyFanCmpMag 0 "OnOff1_Off" 1 "OnOff1_On";
VAL_ 1173 IntrMirrCmdIntrMirrDiagcRst 0 "Flg1_Rst" 1 "Flg1_Set";
VAL_ 1173 IntrMirrCmdIntrMirrDimSnvty 0 "IntrMirrDimSnvtyTyp_Normal" 1 "IntrMirrDimSnvtyTyp_Dark" 2 "IntrMirrDimSnvtyTyp_Light" 3 "IntrMirrDimSnvtyTyp_Inhibit";
VAL_ 1173 IntrMirrCmdIntrMirrEna 0 "OnOff1_Off" 1 "OnOff1_On";
VAL_ 1173 IntrMirrCmdIntrMirrInhbDim 0 "OnOff1_Off" 1 "OnOff1_On";
VAL_ 1173 IntrMirrCmdIntrMirrWindHeatrCmpMag 0 "OnOff1_Off" 1 "OnOff1_On";
VAL_ 1173 LatCtrlModCfmdLatCtrlMod 0 "LatCtrlMod1_NoReq" 1 "LatCtrlMod1_HighWayAssist" 2 "LatCtrlMod1_EmgyLaneKeepAidForObjRe" 3 "LatCtrlMod1_EmgyLaneKeepAidForStat" 4 "LatCtrlMod1_SftyLaneKeepAid" 5 "LatCtrlMod1_SteerAssc" 6 "LatCtrlMod1_DsrOversteer" 7 "LatCtrlMod1_DsrMueSplit" 8 "LatCtrlMod1_DsrTrlrStaby" 9 "LatCtrlMod1_EmgyManvAssi" 10 "LatCtrlMod1_Reserved1" 11 "LatCtrlMod1_Reserved2" 12 "LatCtrlMod1_SHWA" 13 "LatCtrlMod1_APA" 14 "LatCtrlMod1_RPA" 15 "LatCtrlMod1_HPA";
VAL_ 1173 MirrDefrstAtDrvrCmd 0 "OnOff1_Off" 1 "OnOff1_On";
VAL_ 1173 MirrSeldIndcn 0 "MirrSeldIndcnTyp_LedOff" 1 "MirrSeldIndcnTyp_LedOnLe" 2 "MirrSeldIndcnTyp_LedOnRi" 3 "MirrSeldIndcnTyp_LedOnLeAndRi";
VAL_ 1173 PanicAlrmAcoustReq 0 "AlrmAcoustReq_AlrmAcoustReqOff" 1 "AlrmAcoustReq_AlrmAcoustReq1";
VAL_ 1173 PanicAlrmToExtrLiVisReq 0 "ExtrLiVisReq_ExtrLiVisReqAlrmOff" 1 "ExtrLiVisReq_ExtrLiVisReqAlrm1" 2 "ExtrLiVisReq_ExtrLiVisReqAlrm2";
VAL_ 1173 PropsEnabfromAlcoLock 0 "OnOff1_Off" 1 "OnOff1_On";
VAL_ 1173 PtActvnReq1WdPtActvnReq 0 "PtActvnReq1_NoPtActvnReq" 1 "PtActvnReq1_PtActvnReq" 2 "PtActvnReq1_PtActvnReqRem" 3 "PtActvnReq1_PtActvnNotDriving";
VAL_ 1173 RainSensActvn 0 "OnOff1_Off" 1 "OnOff1_On";
VAL_ 1173 ReAdaptReq 0 "OnOff1_Off" 1 "OnOff1_On";
VAL_ 1173 RelHumSnsrErr 0 "Err1_NoErr" 1 "Err1_Err";
VAL_ 1173 RemStrtMsgToDrvrRemStrtBlkd1 0 "RemStrtMsgBlkd1_NoFailr" 1 "RemStrtMsgBlkd1_LoBatt" 2 "RemStrtMsgBlkd1_GearLvrNotInP" 3 "RemStrtMsgBlkd1_LoFuLvl" 4 "RemStrtMsgBlkd1_KeyInVeh" 5 "RemStrtMsgBlkd1_NrOfClimaLim" 6 "RemStrtMsgBlkd1_BrkPedlPsd" 7 "RemStrtMsgBlkd1_EngFlt" 8 "RemStrtMsgBlkd1_HoodOpend" 9 "RemStrtMsgBlkd1_ImobActvd";
VAL_ 1173 RemStrtMsgToDrvrRemStrtDev1 0 "RemStrtDev1_NotRqstd" 1 "RemStrtDev1_RqstdByKey" 2 "RemStrtDev1_RqstdByTelm" 3 "RemStrtDev1_Resd";
VAL_ 1173 RlyActvnForRoofCurtClsAut 0 "Boolean_FALSE" 1 "Boolean_TRUE";
VAL_ 1173 SteerLockEnagOfPrpsn 0 "SteerLockEnagOfPrpsn_SteerLockEnagResd1" 1 "SteerLockEnagOfPrpsn_PrpsnInhbFromSteerLock" 2 "SteerLockEnagOfPrpsn_PrpsnAllwdFromSteerLock" 3 "SteerLockEnagOfPrpsn_SteerLockEnagResd2";
VAL_ 1173 StsOfLedHiBeamLe 0 "DevSts4_Off" 1 "DevSts4_On" 2 "DevSts4_Err" 3 "DevSts4_Resd";
VAL_ 1173 StsOfLedHiBeamRi 0 "DevSts4_Off" 1 "DevSts4_On" 2 "DevSts4_Err" 3 "DevSts4_Resd";
VAL_ 1173 StsOfLedLoBeamLe 0 "DevSts4_Off" 1 "DevSts4_On" 2 "DevSts4_Err" 3 "DevSts4_Resd";
VAL_ 1173 StsOfLedLoBeamRi 0 "DevSts4_Off" 1 "DevSts4_On" 2 "DevSts4_Err" 3 "DevSts4_Resd";
VAL_ 1173 StsOfSwvlgLe 0 "DevSts4_Off" 1 "DevSts4_On" 2 "DevSts4_Err" 3 "DevSts4_Resd";
VAL_ 1173 StsOfSwvlgRi 0 "DevSts4_Off" 1 "DevSts4_On" 2 "DevSts4_Err" 3 "DevSts4_Resd";
VAL_ 1173 SunCurtEna 0 "SunRoofAndCurtEnaTyp_Di" 1 "SunRoofAndCurtEnaTyp_LimdEna" 2 "SunRoofAndCurtEnaTyp_FullEna" 3 "SunRoofAndCurtEnaTyp_Resd";
VAL_ 1173 SunRoofAndCurtExtCmd 0 "SunRoofAndCurtExtCmdTyp_Idle" 1 "SunRoofAndCurtExtCmdTyp_PanAndCurtStop" 2 "SunRoofAndCurtExtCmdTyp_CurtClsFull" 3 "SunRoofAndCurtExtCmdTyp_CurtOpenFull" 4 "SunRoofAndCurtExtCmdTyp_PanClsFull" 5 "SunRoofAndCurtExtCmdTyp_PanOpenFull" 6 "SunRoofAndCurtExtCmdTyp_PanTilt" 7 "SunRoofAndCurtExtCmdTyp_AutClsFast" 8 "SunRoofAndCurtExtCmdTyp_AutOpenFast" 9 "SunRoofAndCurtExtCmdTyp_CurtClsShort" 10 "SunRoofAndCurtExtCmdTyp_CurtOpnShort" 11 "SunRoofAndCurtExtCmdTyp_PanClsShort" 12 "SunRoofAndCurtExtCmdTyp_PanOpnShort" 13 "SunRoofAndCurtExtCmdTyp_CurtHalfOpn" 14 "SunRoofAndCurtExtCmdTyp_PanHalfOpn" 15 "SunRoofAndCurtExtCmdTyp_CurtAndPanInin";
VAL_ 1173 SwtBeamHi 0 "BeamHiFctReq1_Neut" 1 "BeamHiFctReq1_Flash" 2 "BeamHiFctReq1_HiBeam" 3 "BeamHiFctReq1_LoBeam";
VAL_ 1173 SwtLiHzrdWarn 0 "PsdNotPsd_NotPsd" 1 "PsdNotPsd_Psd";
VAL_ 1173 TankFlapReqFromSwtIntrFild 0 "PsdNotPsd1_NotPsd" 1 "PsdNotPsd1_Psd";
VAL_ 1173 TrOpenerReqTrigSrc 0 "TrOpenerTrigSrc1_TrNoTrigSrc" 1 "TrOpenerTrigSrc1_TrKeyRem" 2 "TrOpenerTrigSrc1_TrSwtIntr" 3 "TrOpenerTrigSrc1_TrByFootOper" 4 "TrOpenerTrigSrc1_TrHndlOutd" 5 "TrOpenerTrigSrc1_TrShutFace" 6 "TrOpenerTrigSrc1_TrHMI" 7 "TrOpenerTrigSrc1_TrByAppch";
VAL_ 1173 TrOpenerReqTrOpenerReq 0 "TrOpenerReq1_TrOpenerIdle" 1 "TrOpenerReq1_TrOpenerOpen" 2 "TrOpenerReq1_TrOpenerCls" 3 "TrOpenerReq1_TrOpenerStop" 4 "TrOpenerReq1_TrOpenerClsDly";
VAL_ 1173 TrsmParkLockSt 0 "LockSt4_Engaged" 1 "LockSt4_Disengaged" 2 "LockSt4_In_Progs" 3 "LockSt4_Undefined";
VAL_ 1173 WiprActv 0 "OnOff1_Off" 1 "OnOff1_On";
VAL_ 1173 WiprInWipgAr 0 "OnOff1_Off" 1 "OnOff1_On";
VAL_ 1173 WiprMotFrntLvrCmdSafeLvrInHiSpdPosnSafe 0 "OnOffCrit1_NotVld1" 1 "OnOffCrit1_Off" 2 "OnOffCrit1_On" 3 "OnOffCrit1_NotVld2";
VAL_ 1173 WiprMotFrntLvrCmdSafeLvrInIntlPosn 0 "OnOff1_Off" 1 "OnOff1_On";
VAL_ 1173 WiprMotFrntLvrCmdSafeLvrInLoSpdPosnSafe 0 "OnOffCrit1_NotVld1" 1 "OnOffCrit1_Off" 2 "OnOffCrit1_On" 3 "OnOffCrit1_NotVld2";
VAL_ 1173 WiprMotFrntLvrCmdSafeLvrInSnglStrokePos 0 "OnOff1_Off" 1 "OnOff1_On";
VAL_ 81 ClsdDueToRain 0 "Boolean_FALSE" 1 "Boolean_TRUE";
VAL_ 659 HvBattThermInfoCorrInFutureThermModAtTime 0 "Idle" 1 "ThermalBalancing" 2 "PassiveHeating" 3 "ActiveHeating" 4 "PassiveCooling" 5 "ActiveCooling" 6 "CombinedCooling" 7 "Reserved";
VAL_ 659 LiBattInPWLock 0 "OnOff1_Off" 1 "OnOff1_On";
VAL_ 659 PtCoolgPostRunActv 0 "Boolean_FALSE" 1 "Boolean_TRUE";
VAL_ 659 PtTotBrkTqReqPtTotBrkTqEna 0 "OnOff1_Off" 1 "OnOff1_On";
VAL_ 659 RainSnsrActvnErrToHmi 0 "OnOff1_Off" 1 "OnOff1_On";
VAL_ 659 StandStillReqForCmftToBrkgForEPedl 0 "Boolean_FALSE" 1 "Boolean_TRUE";
VAL_ 659 SteerLockMgrWarnIndcn 0 "SteerLockMgrWarnIndcn_SteerLockMgrNoMsg" 1 "SteerLockMgrWarnIndcn_SteerLockTiOutMsgMgr" 2 "SteerLockMgrWarnIndcn_SteerLockMsgNotProgdMgr" 3 "SteerLockMgrWarnIndcn_FltSteerLockMsgMgr" 4 "SteerLockMgrWarnIndcn_SteerLockTqMsgMgr" 5 "SteerLockMgrWarnIndcn_CryptoSteerLockMsgMgr" 6 "SteerLockMgrWarnIndcn_SftySteerLockMsgMgr" 7 "SteerLockMgrWarnIndcn_SteerLockMsgInVldMgr";
VAL_ 659 StrtRemSts1WdStrtRemSts 0 "StrtRemSts1_Idle" 1 "StrtRemSts1_Strtg" 2 "StrtRemSts1_Actv";
VAL_ 659 VehPropSts 0 "Boolean_FALSE" 1 "Boolean_TRUE";
VAL_ 659 WiprSysFailrDetdSafe 0 "OnOffCrit1_NotVld1" 1 "OnOffCrit1_Off" 2 "OnOffCrit1_On" 3 "OnOffCrit1_NotVld2";
VAL_ 659 WshrFldTankStsToHMI 0 "OnOff1_Off" 1 "OnOff1_On";
VAL_ 569 ConvPwrRelsForbRelsFrbn1 0 "Boolean_FALSE" 1 "Boolean_TRUE";
VAL_ 569 ConvPwrRelsForbRelsMtnFrbn 0 "Boolean_FALSE" 1 "Boolean_TRUE";
VAL_ 569 HeatrPmpStatCooltPmpDryErr 0 "CooltPmpDryErr_RunDryNotDetd" 1 "CooltPmpDryErr_RunDryDetd" 2 "CooltPmpDryErr_Resd1" 3 "CooltPmpDryErr_Resd2";
VAL_ 569 HeatrPmpStatCooltPmpEmgyModSts 0 "CooltPmpEmgyModSts_EmgyRunNotActv" 1 "CooltPmpEmgyModSts_EmgyRunActv" 2 "CooltPmpEmgyModSts_Resd1" 3 "CooltPmpEmgyModSts_Resd2";
VAL_ 569 HeatrPmpStatCooltPmpErrSts 0 "CooltPmpErrSts_StNoErr" 1 "CooltPmpErrSts_StErr" 2 "CooltPmpErrSts_StNewErr" 3 "CooltPmpErrSts_Resd";
VAL_ 569 HeatrPmpStatCooltPmpIErr 0 "CooltPmpIErr_INoErr" 1 "CooltPmpIErr_IErr" 2 "CooltPmpIErr_Resd1" 3 "CooltPmpIErr_Resd2";
VAL_ 569 HeatrPmpStatCooltPmpMonrSpd 0 "CooltPmpMonrSpd_MonrSpdActv" 1 "CooltPmpMonrSpd_MonrSpdNoActv" 2 "CooltPmpMonrSpd_Resd1" 3 "CooltPmpMonrSpd_Resd2";
VAL_ 569 HeatrPmpStatCooltPmpPostRunSts 0 "CooltPmpPostRunSts_CooltPmpPostRunFinshd" 1 "CooltPmpPostRunSts_CooltPmpPostRunCncld" 2 "CooltPmpPostRunSts_Resd1" 3 "CooltPmpPostRunSts_Resd2";
VAL_ 569 HeatrPmpStatCooltPmpSetPostRunReq 0 "CooltPmpSetPostRunReq_CooltPmpSetNoPostRun" 1 "CooltPmpSetPostRunReq_CooltPmpSetPostRun1" 2 "CooltPmpSetPostRunReq_CooltPmpSetPostRun2" 3 "CooltPmpSetPostRunReq_CooltPmpSetPostRun3" 4 "CooltPmpSetPostRunReq_CooltPmpSetPostRun4" 5 "CooltPmpSetPostRunReq_CooltPmpSetPostRun5" 6 "CooltPmpSetPostRunReq_Resd1" 7 "CooltPmpSetPostRunReq_Resd2";
VAL_ 569 HeatrPmpStatCooltPmpTErr 0 "CooltPmpTErr_CooltPmpNoTErr" 1 "CooltPmpTErr_CooltPmpTErr" 2 "CooltPmpTErr_Resd1" 3 "CooltPmpTErr_Resd2";
VAL_ 569 HeatrPmpStatCooltPmpUErr 0 "CooltPmpUErr_CooltPmpNoUErr" 1 "CooltPmpUErr_CooltPmpUErr" 2 "CooltPmpUErr_Resd1" 3 "CooltPmpUErr_Resd2";
VAL_ 569 HeatrPmpStatCooltPmpUnstallSts 0 "CooltPmpUnstallSts_CooltPmpUnstallNotActv" 1 "CooltPmpUnstallSts_CooltPmpUnstallActv" 2 "CooltPmpUnstallSts_Resd1" 3 "CooltPmpUnstallSts_Resd2";
VAL_ 82 NFCKeySearchReqKeyLocn 0 "KeyLocn1_KeyLocnIdle" 1 "KeyLocn1_KeyLocnAll" 2 "KeyLocn1_KeyLocnAllExt" 3 "KeyLocn1_KeyLocnDrvrExt" 4 "KeyLocn1_KeyLocnPassExt" 5 "KeyLocn1_KeyLocnTrExt" 6 "KeyLocn1_KeyLocnAllInt" 7 "KeyLocn1_KeyLocnDrvrInt" 8 "KeyLocn1_KeyLocnPassInt" 9 "KeyLocn1_KeyLocnResvInt" 10 "KeyLocn1_KeyLocnResvIntSimple";
VAL_ 82 NFCKeySearchReqTirgger 0 "Tirgger_Idle" 1 "Tirgger_VMM" 2 "Tirgger_Locking" 3 "Tirgger_KeyRmn" 4 "Tirgger_KeyWrn" 5 "Tirgger_ProfiMgr";
VAL_ 920 ActnOfCenHiMntdStopLamp 0 "OnOff1_Off" 1 "OnOff1_On";
VAL_ 920 ActnOfCenHiMntdStopLamp1 0 "OnOff1_Off" 1 "OnOff1_On";
VAL_ 920 ActnOfDaytiRunngLampDrv 0 "OnOff1_Off" 1 "OnOff1_On";
VAL_ 920 ActnOfFrntFogLampDrv 0 "OnOff1_Off" 1 "OnOff1_On";
VAL_ 920 ActnOfFrntPosnLampDrv 0 "OnOff1_Off" 1 "OnOff1_On";
VAL_ 920 ActnOfFrntSideMkrLampDrv 0 "OnOff1_Off" 1 "OnOff1_On";
VAL_ 920 ActnOfFrntSideMkrLampPass 0 "OnOff1_Off" 1 "OnOff1_On";
VAL_ 920 ActnOfLedCornrgLampLe 0 "OnOff1_Off" 1 "OnOff1_On";
VAL_ 920 ActnOfLedCornrgLampRi 0 "OnOff1_Off" 1 "OnOff1_On";
VAL_ 920 ActnOfLedDaytiRunngLamp 0 "OnOff1_Off" 1 "OnOff1_On";
VAL_ 920 ActnOfLedFrntCrossLamp 0 "OnOff1_Off" 1 "OnOff1_On";
VAL_ 920 ActnOfLedFrntCrossLampDyn 0 "OnOff1_Off" 1 "OnOff1_On";
VAL_ 920 ActnOfLedFrntFogLamp 0 "OnOff1_Off" 1 "OnOff1_On";
VAL_ 920 ActnOfLedGrilleLamp 0 "OnOff1_Off" 1 "OnOff1_On";
VAL_ 920 ActnOfLedGrilleLampDyn 0 "OnOff1_Off" 1 "OnOff1_On";
VAL_ 920 ActnOfLedLeLogoLamp 0 "OnOff1_Off" 1 "OnOff1_On";
VAL_ 920 ActnOfLedLeLogoLampDyn 0 "OnOff1_Off" 1 "OnOff1_On";
VAL_ 920 ActnOfLedPosnLampDyn 0 "OnOff1_Off" 1 "OnOff1_On";
VAL_ 920 ActnOfLedReFogLamp 0 "OnOff1_Off" 1 "OnOff1_On";
VAL_ 920 ActnOfLedRePosnLamp 0 "OnOff1_Off" 1 "OnOff1_On";
VAL_ 920 ActnOfLedRiLogoLamp 0 "OnOff1_Off" 1 "OnOff1_On";
VAL_ 920 ActnOfLedRiLogoLampDyn 0 "OnOff1_Off" 1 "OnOff1_On";
VAL_ 920 ActnOfLedRvsgLamp 0 "OnOff1_Off" 1 "OnOff1_On";
VAL_ 920 ActnOfReFogLampPass 0 "OnOff1_Off" 1 "OnOff1_On";
VAL_ 920 ActnOfRePosnLampDrv 0 "OnOff1_Off" 1 "OnOff1_On";
VAL_ 920 ActnOfReSideMkrLampDrv 0 "OnOff1_Off" 1 "OnOff1_On";
VAL_ 920 ActnOfReSideMkrLampPass 0 "OnOff1_Off" 1 "OnOff1_On";
VAL_ 920 ActnOfRvsgLampDrv 0 "OnOff1_Off" 1 "OnOff1_On";
VAL_ 920 ActvnOfAfs 0 "OnOff1_Off" 1 "OnOff1_On";
VAL_ 920 ActvnOfAhl 0 "OnOff1_Off" 1 "OnOff1_On";
VAL_ 920 ActvnOfAlrmReqFromCmplxIf 0 "OnOff1_Off" 1 "OnOff1_On";
VAL_ 920 ActvnOfBrkLi 0 "OnOff1_Off" 1 "OnOff1_On";
VAL_ 920 ActvnOfDbl 0 "OnOff1_Off" 1 "OnOff1_On";
VAL_ 920 ActvnOfDefrstFrnt 0 "OnOff1_Off" 1 "OnOff1_On";
VAL_ 920 ActvnOfDefrstRe 0 "OnOff1_Off" 1 "OnOff1_On";
VAL_ 920 ActvnOfDoorSwtIllmn 0 "Boolean_FALSE" 1 "Boolean_TRUE";
VAL_ 920 ActvnOfHndlDoorLiHndlDoorLiDrvr 0 "OnOff1_Off" 1 "OnOff1_On";
VAL_ 920 ActvnOfHndlDoorLiHndlDoorLiDrvrRe 0 "OnOff1_Off" 1 "OnOff1_On";
VAL_ 920 ActvnOfHndlDoorLiHndlDoorLiPass 0 "OnOff1_Off" 1 "OnOff1_On";
VAL_ 920 ActvnOfHndlDoorLiHndlDoorLiPassRe 0 "OnOff1_Off" 1 "OnOff1_On";
VAL_ 920 ActvnOfReLogoLamp1 0 "OnOff1_Off" 1 "OnOff1_On";
VAL_ 920 ActvnOfRoofSwtIllmn 0 "Boolean_FALSE" 1 "Boolean_TRUE";
VAL_ 920 ActvnOfTouristMod 0 "OnOff1_Off" 1 "OnOff1_On";
VAL_ 920 ActvnOfWshrFrntNotSafe 0 "OnOff1_Off" 1 "OnOff1_On";
VAL_ 920 ActvnOfWshrRe 0 "OnOff1_Off" 1 "OnOff1_On";
VAL_ 920 AlrmAcoustReq01 0 "AlrmAcoustReq_AlrmAcoustReqOff" 1 "AlrmAcoustReq_AlrmAcoustReq1";
VAL_ 920 AlrmToExtrLiFbVisReq 0 "LockActvn2_LockActvnOff" 1 "LockActvn2_LockActvnUnlck" 2 "LockActvn2_LockActvnLock" 3 "LockActvn2_LockActvnSafe" 4 "LockActvn2_LockActvnUnlckByCrash";
VAL_ 920 AlrmToExtrLiVisReq 0 "ExtrLiVisReq_ExtrLiVisReqAlrmOff" 1 "ExtrLiVisReq_ExtrLiVisReqAlrm1" 2 "ExtrLiVisReq_ExtrLiVisReqAlrm2";
VAL_ 920 AutWinWipgCmd 0 "WipgSpd2_WipgSpd0Rpm" 1 "WipgSpd2_WipgSpd40Rpm" 2 "WipgSpd2_WipgSpd43Rpm" 3 "WipgSpd2_WipgSpd46Rpm" 4 "WipgSpd2_WipgSpd50Rpm" 5 "WipgSpd2_WipgSpd54Rpm" 6 "WipgSpd2_WipgSpd57Rpm" 7 "WipgSpd2_WipgSpd60Rpm";
VAL_ 920 BswCha1NmState 0 "BswCANNmState_NotKnown" 1 "BswCANNmState_BusSleep" 2 "BswCANNmState_PrepareBusSleep" 3 "BswCANNmState_ReadySleep" 4 "BswCANNmState_NormalOperation" 5 "BswCANNmState_RepeatMessage" 6 "BswCANNmState_Reserved1" 7 "BswCANNmState_Reserved2";
VAL_ 920 BswChainNmState 0 "BswCANNmState_NotKnown" 1 "BswCANNmState_BusSleep" 2 "BswCANNmState_PrepareBusSleep" 3 "BswCANNmState_ReadySleep" 4 "BswCANNmState_NormalOperation" 5 "BswCANNmState_RepeatMessage" 6 "BswCANNmState_Reserved1" 7 "BswCANNmState_Reserved2";
VAL_ 920 BswPriNmState 0 "BswCANNmState_NotKnown" 1 "BswCANNmState_BusSleep" 2 "BswCANNmState_PrepareBusSleep" 3 "BswCANNmState_ReadySleep" 4 "BswCANNmState_NormalOperation" 5 "BswCANNmState_RepeatMessage" 6 "BswCANNmState_Reserved1" 7 "BswCANNmState_Reserved2";
VAL_ 920 BswPropNmState 0 "BswCANNmState_NotKnown" 1 "BswCANNmState_BusSleep" 2 "BswCANNmState_PrepareBusSleep" 3 "BswCANNmState_ReadySleep" 4 "BswCANNmState_NormalOperation" 5 "BswCANNmState_RepeatMessage" 6 "BswCANNmState_Reserved1" 7 "BswCANNmState_Reserved2";
VAL_ 920 BswWakeupSourceState 0 "BswWakeupSourceState_NoWakeup" 1 "BswWakeupSourceState_KL15" 2 "BswWakeupSourceState_PublicCAN" 3 "BswWakeupSourceState_RTC" 4 "BswWakeupSourceState_CEMHardware" 5 "BswWakeupSourceState_PrivateCAN" 6 "BswWakeupSourceState_Aplus" 7 "BswWakeupSourceState_Reserved";
VAL_ 920 DwnLoadStsFbOfHdlampLe 0 "Sts_Resd" 1 "Sts_Err" 2 "Sts_CmplOk" 3 "Sts_InProgs";
VAL_ 920 DwnLoadStsFbOfHdlampRi 0 "Sts_Resd" 1 "Sts_Err" 2 "Sts_CmplOk" 3 "Sts_InProgs";
VAL_ 920 DwnLoadStsFbOfLogoLampLe 0 "Sts_Resd" 1 "Sts_Err" 2 "Sts_CmplOk" 3 "Sts_InProgs";
VAL_ 920 DwnLoadStsFbOfLogoLampRi 0 "Sts_Resd" 1 "Sts_Err" 2 "Sts_CmplOk" 3 "Sts_InProgs";
VAL_ 920 ExtrLiShowActvnFrntLeFb 0 "Sts_Resd" 1 "Sts_Err" 2 "Sts_CmplOk" 3 "Sts_InProgs";
VAL_ 920 ExtrLiShowActvnFrntRiFb 0 "Sts_Resd" 1 "Sts_Err" 2 "Sts_CmplOk" 3 "Sts_InProgs";
VAL_ 920 ExtrLiShowActvnLeLogoFb 0 "Sts_Resd" 1 "Sts_Err" 2 "Sts_CmplOk" 3 "Sts_InProgs";
VAL_ 920 ExtrLiShowActvnRiLogoFb 0 "Sts_Resd" 1 "Sts_Err" 2 "Sts_CmplOk" 3 "Sts_InProgs";
VAL_ 920 HdlampLeInpSts1 0 "Boolean_FALSE" 1 "Boolean_TRUE";
VAL_ 920 HdlampLeInpSts2 0 "Boolean_FALSE" 1 "Boolean_TRUE";
VAL_ 920 HdlampRiInpSts1 0 "Boolean_FALSE" 1 "Boolean_TRUE";
VAL_ 920 HdlampRiInpSts2 0 "Boolean_FALSE" 1 "Boolean_TRUE";
VAL_ 920 ShortDropWinDrvrSts 0 "ShortDropSts_Idle" 1 "ShortDropSts_WindowDown" 2 "ShortDropSts_WindowClosed" 3 "ShortDropSts_NotUsed";
VAL_ 920 ShortDropWinReLeSts 0 "ShortDropSts_Idle" 1 "ShortDropSts_WindowDown" 2 "ShortDropSts_WindowClosed" 3 "ShortDropSts_NotUsed";
VAL_ 920 SnsrSoundrBattBackedStsArmSts 0 "ArmingTyp1_Disarmd" 1 "ArmingTyp1_Armd";
VAL_ 920 SnsrSoundrBattBackedStsCfgSts 0 "CfgSts_NotCfgd" 1 "CfgSts_InProgs" 2 "CfgSts_Rx" 3 "CfgSts_Cfgd";
VAL_ 920 SnsrSoundrBattBackedStsSnsrInclnExist 0 "Boolean_FALSE" 1 "Boolean_TRUE";
VAL_ 920 SnsrSoundrBattBackedStsSoundrBattBackedErrSts 0 "SnsrAlrmErrSts_NotTest" 1 "SnsrAlrmErrSts_Passd" 2 "SnsrAlrmErrSts_Faild";
VAL_ 920 SnsrSoundrBattBackedStsSoundSts 0 "OnOff1_Off" 1 "OnOff1_On";
VAL_ 920 StsOfAfsLe 0 "DevSts4_Off" 1 "DevSts4_On" 2 "DevSts4_Err" 3 "DevSts4_Resd";
VAL_ 920 StsOfAfsRi 0 "DevSts4_Off" 1 "DevSts4_On" 2 "DevSts4_Err" 3 "DevSts4_Resd";
VAL_ 920 StsOfAhbcLe 0 "DevSts4_Off" 1 "DevSts4_On" 2 "DevSts4_Err" 3 "DevSts4_Resd";
VAL_ 920 StsOfAhbcRi 0 "DevSts4_Off" 1 "DevSts4_On" 2 "DevSts4_Err" 3 "DevSts4_Resd";
VAL_ 920 StsOfFrntSideMkrLampLe2 0 "DevSts4_Off" 1 "DevSts4_On" 2 "DevSts4_Err" 3 "DevSts4_Resd";
VAL_ 920 StsOfFrntSideMkrLampRi2 0 "DevSts4_Off" 1 "DevSts4_On" 2 "DevSts4_Err" 3 "DevSts4_Resd";
VAL_ 920 StsOfLedCornrgLampLe 0 "DevSts4_Off" 1 "DevSts4_On" 2 "DevSts4_Err" 3 "DevSts4_Resd";
VAL_ 920 StsOfLedCornrgLampRi 0 "DevSts4_Off" 1 "DevSts4_On" 2 "DevSts4_Err" 3 "DevSts4_Resd";
VAL_ 920 StsOfLedDaytiRunngLampLe 0 "DevSts4_Off" 1 "DevSts4_On" 2 "DevSts4_Err" 3 "DevSts4_Resd";
VAL_ 920 StsOfLedDaytiRunngLampRi 0 "DevSts4_Off" 1 "DevSts4_On" 2 "DevSts4_Err" 3 "DevSts4_Resd";
VAL_ 920 StsOfLedFrntFogLampLe 0 "DevSts4_Off" 1 "DevSts4_On" 2 "DevSts4_Err" 3 "DevSts4_Resd";
VAL_ 920 StsOfLedFrntFogLampRi 0 "DevSts4_Off" 1 "DevSts4_On" 2 "DevSts4_Err" 3 "DevSts4_Resd";
VAL_ 920 StsOfLedFrntPosnLampLe 0 "DevSts4_Off" 1 "DevSts4_On" 2 "DevSts4_Err" 3 "DevSts4_Resd";
VAL_ 920 StsOfLedFrntPosnLampRi 0 "DevSts4_Off" 1 "DevSts4_On" 2 "DevSts4_Err" 3 "DevSts4_Resd";
VAL_ 920 StsOfLedFrntTurnIndcrLe 0 "DevSts4_Off" 1 "DevSts4_On" 2 "DevSts4_Err" 3 "DevSts4_Resd";
VAL_ 920 StsOfLedFrntTurnIndcrRi 0 "DevSts4_Off" 1 "DevSts4_On" 2 "DevSts4_Err" 3 "DevSts4_Resd";
VAL_ 920 StsOfLedLeLogoLamp 0 "DevSts4_Off" 1 "DevSts4_On" 2 "DevSts4_Err" 3 "DevSts4_Resd";
VAL_ 920 StsOfLedRiLogoLamp 0 "DevSts4_Off" 1 "DevSts4_On" 2 "DevSts4_Err" 3 "DevSts4_Resd";
VAL_ 920 StsOfLvlgLeStsOfLvlgLe 0 "DevSts4_Off" 1 "DevSts4_On" 2 "DevSts4_Err" 3 "DevSts4_Resd";
VAL_ 920 StsOfLvlgRiStsOfLvlgRi 0 "DevSts4_Off" 1 "DevSts4_On" 2 "DevSts4_Err" 3 "DevSts4_Resd";
VAL_ 920 StsOfTouristModLe 0 "DevSts4_Off" 1 "DevSts4_On" 2 "DevSts4_Err" 3 "DevSts4_Resd";
VAL_ 920 StsOfTouristModRi 0 "DevSts4_Off" 1 "DevSts4_On" 2 "DevSts4_Err" 3 "DevSts4_Resd";
VAL_ 920 StsOfWelGbyFrntLe 0 "OnOff1_Off" 1 "OnOff1_On";
VAL_ 920 StsOfWelGbyFrntRi 0 "OnOff1_Off" 1 "OnOff1_On";
VAL_ 920 SunRoofAndCurtBtnSts2Pos 0 "SunRoofAndCurtBtnStsTyp2_Idle" 1 "SunRoofAndCurtBtnStsTyp2_BackwStep1" 2 "SunRoofAndCurtBtnStsTyp2_BackwStep2" 3 "SunRoofAndCurtBtnStsTyp2_ForwStep1" 4 "SunRoofAndCurtBtnStsTyp2_ForwStep2" 5 "SunRoofAndCurtBtnStsTyp2_TiltUpStep1" 6 "SunRoofAndCurtBtnStsTyp2_TiltDwnStep1" 7 "SunRoofAndCurtBtnStsTyp2_Failr";
VAL_ 920 SunRoofImpctDetnSts2 0 "SunRoofAndCurtImpctDetnStsTyp_ImpctDetnDi" 1 "SunRoofAndCurtImpctDetnStsTyp_ImpctDetnEna" 2 "SunRoofAndCurtImpctDetnStsTyp_ClsPinch" 3 "SunRoofAndCurtImpctDetnStsTyp_ClsBlk" 4 "SunRoofAndCurtImpctDetnStsTyp_OpenPinch" 5 "SunRoofAndCurtImpctDetnStsTyp_OpenBlk";
VAL_ 920 TCSDoorSts 0 "OnOff1_Off" 1 "OnOff1_On";
VAL_ 920 WiprInPrkgPosnLoFromWMM 0 "OnOff1_Off" 1 "OnOff1_On";
VAL_ 920 WiprInWipgArFromWMM 0 "OnOff1_Off" 1 "OnOff1_On";
VAL_ 920 WiprMotDiagcWiprMotHiVoltDetd 0 "OnOffCrit1_NotVld1" 1 "OnOffCrit1_Off" 2 "OnOffCrit1_On" 3 "OnOffCrit1_NotVld2";
VAL_ 920 WiprMotDiagcWiprMotLoVoltDetd 0 "OnOffCrit1_NotVld1" 1 "OnOffCrit1_Off" 2 "OnOffCrit1_On" 3 "OnOffCrit1_NotVld2";
VAL_ 920 WiprMotDiagcWiprMotOvldDetd 0 "OnOffCrit1_NotVld1" 1 "OnOffCrit1_Off" 2 "OnOffCrit1_On" 3 "OnOffCrit1_NotVld2";
VAL_ 920 WiprMotErrSafe 0 "OnOffCrit1_NotVld1" 1 "OnOffCrit1_Off" 2 "OnOffCrit1_On" 3 "OnOffCrit1_NotVld2";
VAL_ 920 WshngCycActvFromWMM 0 "OnOff1_Off" 1 "OnOff1_On";
VAL_ 416 CnvnInhb 0 "InhibitSts_NotInhibited" 1 "InhibitSts_Inhibited";
VAL_ 416 CPSRClsReq 0 "OpenClose_Open" 1 "OpenClose_Close";
VAL_ 416 CPSRFbSt 0 "OpenClose_Open" 1 "OpenClose_Close";
VAL_ 416 EexvStsExvBlkErr 0 "Err1_NoErr" 1 "Err1_Err";
VAL_ 416 EexvStsExvCalibSts 0 "ExvCalibSts_NotInitialized" 1 "ExvCalibSts_InitializationInProcess" 2 "ExvCalibSts_Initialized" 3 "ExvCalibSts_Reserved";
VAL_ 416 EexvStsExvElecStsErr 0 "ExvElecStsErr_NoError" 1 "ExvElecStsErr_OpenCircuit" 2 "ExvElecStsErr_ShortCircuit" 3 "ExvElecStsErr_OverTemperatureShutdown" 4 "ExvElecStsErr_IndeterminateElectricFault" 5 "ExvElecStsErr_Reserved";
VAL_ 416 EexvStsExvMovSts 0 "ExvMovSts_NotMove" 1 "ExvMovSts_Moving";
VAL_ 416 EexvStsExvOvrTempErr 0 "Err1_NoErr" 1 "Err1_Err";
VAL_ 416 EexvStsExvOvrTrvlErr 0 "Err1_NoErr" 1 "Err1_Err";
VAL_ 416 EexvStsExvPreHeatgSts 0 "OnOff1_Off" 1 "OnOff1_On";
VAL_ 416 EexvStsExvVoltgRangErr 0 "VoltgRangErr_NoErr" 1 "VoltgRangErr_UnderVoltageErr" 2 "VoltgRangErr_OverVoltageErr" 3 "VoltgRangErr_Reserved";
VAL_ 416 ExvStsExvBlkErr 0 "Err1_NoErr" 1 "Err1_Err";
VAL_ 416 ExvStsExvCalibSts 0 "ExvCalibSts_NotInitialized" 1 "ExvCalibSts_InitializationInProcess" 2 "ExvCalibSts_Initialized" 3 "ExvCalibSts_Reserved";
VAL_ 416 ExvStsExvElecStsErr 0 "ExvElecStsErr_NoError" 1 "ExvElecStsErr_OpenCircuit" 2 "ExvElecStsErr_ShortCircuit" 3 "ExvElecStsErr_OverTemperatureShutdown" 4 "ExvElecStsErr_IndeterminateElectricFault" 5 "ExvElecStsErr_Reserved";
VAL_ 416 ExvStsExvMovSts 0 "ExvMovSts_NotMove" 1 "ExvMovSts_Moving";
VAL_ 416 ExvStsExvOvrTempErr 0 "Err1_NoErr" 1 "Err1_Err";
VAL_ 416 ExvStsExvOvrTrvlErr 0 "Err1_NoErr" 1 "Err1_Err";
VAL_ 416 ExvStsExvPreHeatgSts 0 "OnOff1_Off" 1 "OnOff1_On";
VAL_ 416 ExvStsExvVoltgRangErr 0 "VoltgRangErr_NoErr" 1 "VoltgRangErr_UnderVoltageErr" 2 "VoltgRangErr_OverVoltageErr" 3 "VoltgRangErr_Reserved";
VAL_ 416 HvchOnForBattHeatg 0 "OnOff1_Off" 1 "OnOff1_On";
VAL_ 416 LoTemEneStorage 0 "Boolean_FALSE" 1 "Boolean_TRUE";
VAL_ 422 EwpAflFlagCooling 0 "Boolean_FALSE" 1 "Boolean_TRUE";
VAL_ 422 HvActvReq 0 "HvCpsrOnOff_Off" 1 "HvCpsrOnOff_CpsrOn" 2 "HvCpsrOnOff_HvOn" 3 "HvCpsrOnOff_Error";
VAL_ 422 IsgCoolgReqInvrCloud 0 "HvCoolg1_NoRequestForMoreCoolantPower" 1 "HvCoolg1_IncreaseLevel1ForMoreCoolantPower" 2 "HvCoolg1_IncreaseLevel2ForMoreCoolantPower" 3 "HvCoolg1_MaxCoolingPower" 4 "HvCoolg1_NotDefined";
VAL_ 422 IsgHeatFdBckCloud 0 "IsgHeatFdBck_On" 1 "IsgHeatFdBck_Off" 2 "IsgHeatFdBck_Inhibt" 3 "IsgHeatFdBck_Reserved";
VAL_ 422 OTAActvHVReq 0 "OnOff1_Off" 1 "OnOff1_On";
VAL_ 422 PrpsnAllwd 0 "Boolean_FALSE" 1 "Boolean_TRUE";
VAL_ 422 RemStrt 0 "NotActvActv1_NotActv" 1 "NotActvActv1_Actv";
SIG_GROUP_ 920 ActvnOfHndlDoorLi 1 : ActvnOfHndlDoorLiHndlDoorLiDrvr ActvnOfHndlDoorLiHndlDoorLiDrvrRe ActvnOfHndlDoorLiHndlDoorLiPass ActvnOfHndlDoorLiHndlDoorLiPassRe;
SIG_GROUP_ 52 BodyDataTraceZCUDM1 1 : BodyDataTraceZCUDM1Functiondevpsignalgroup1 BodyDataTraceZCUDM1Functiondevpsignalgroup2 BodyDataTraceZCUDM1Functiondevpsignalgroup3 BodyDataTraceZCUDM1Functiondevpsignalgroup4 BodyDataTraceZCUDM1Functiondevpsignalgroup5 BodyDataTraceZCUDM1Functiondevpsignalgroup6 BodyDataTraceZCUDM1Functiondevpsignalgroup7 BodyDataTraceZCUDM1Functiondevpsignalgroup8;
SIG_GROUP_ 52 BodyDataTraceZCUDM2 1 : BodyDataTraceZCUDM2Functiondevpsignalgroup1 BodyDataTraceZCUDM2Functiondevpsignalgroup2 BodyDataTraceZCUDM2Functiondevpsignalgroup3 BodyDataTraceZCUDM2Functiondevpsignalgroup4 BodyDataTraceZCUDM2Functiondevpsignalgroup5 BodyDataTraceZCUDM2Functiondevpsignalgroup6 BodyDataTraceZCUDM2Functiondevpsignalgroup7 BodyDataTraceZCUDM2Functiondevpsignalgroup8;
SIG_GROUP_ 52 BodyDataTraceZCUDM3 1 : BodyDataTraceZCUDM3Functiondevpsignalgroup1 BodyDataTraceZCUDM3Functiondevpsignalgroup2 BodyDataTraceZCUDM3Functiondevpsignalgroup3 BodyDataTraceZCUDM3Functiondevpsignalgroup4 BodyDataTraceZCUDM3Functiondevpsignalgroup5 BodyDataTraceZCUDM3Functiondevpsignalgroup6 BodyDataTraceZCUDM3Functiondevpsignalgroup7 BodyDataTraceZCUDM3Functiondevpsignalgroup8;
SIG_GROUP_ 52 BodyDataTraceZCUDM4 1 : BodyDataTraceZCUDM4Functiondevpsignalgroup1 BodyDataTraceZCUDM4Functiondevpsignalgroup2 BodyDataTraceZCUDM4Functiondevpsignalgroup3 BodyDataTraceZCUDM4Functiondevpsignalgroup4 BodyDataTraceZCUDM4Functiondevpsignalgroup5 BodyDataTraceZCUDM4Functiondevpsignalgroup6 BodyDataTraceZCUDM4Functiondevpsignalgroup7 BodyDataTraceZCUDM4Functiondevpsignalgroup8;
SIG_GROUP_ 52 BodyDataTraceZCUDM5 1 : BodyDataTraceZCUDM5Functiondevpsignalgroup1 BodyDataTraceZCUDM5Functiondevpsignalgroup2 BodyDataTraceZCUDM5Functiondevpsignalgroup3 BodyDataTraceZCUDM5Functiondevpsignalgroup4 BodyDataTraceZCUDM5Functiondevpsignalgroup5 BodyDataTraceZCUDM5Functiondevpsignalgroup6 BodyDataTraceZCUDM5Functiondevpsignalgroup7 BodyDataTraceZCUDM5Functiondevpsignalgroup8;
SIG_GROUP_ 52 BodyDataTraceZCUDM6 1 : BodyDataTraceZCUDM6Functiondevpsignalgroup1 BodyDataTraceZCUDM6Functiondevpsignalgroup2 BodyDataTraceZCUDM6Functiondevpsignalgroup3 BodyDataTraceZCUDM6Functiondevpsignalgroup4 BodyDataTraceZCUDM6Functiondevpsignalgroup5 BodyDataTraceZCUDM6Functiondevpsignalgroup6 BodyDataTraceZCUDM6Functiondevpsignalgroup7 BodyDataTraceZCUDM6Functiondevpsignalgroup8;
SIG_GROUP_ 52 BodyDataTraceZCUDM7 1 : BodyDataTraceZCUDM7Functiondevpsignalgroup1 BodyDataTraceZCUDM7Functiondevpsignalgroup2 BodyDataTraceZCUDM7Functiondevpsignalgroup3 BodyDataTraceZCUDM7Functiondevpsignalgroup4 BodyDataTraceZCUDM7Functiondevpsignalgroup5 BodyDataTraceZCUDM7Functiondevpsignalgroup6 BodyDataTraceZCUDM7Functiondevpsignalgroup7 BodyDataTraceZCUDM7Functiondevpsignalgroup8;
SIG_GROUP_ 569 ConvPwrRelsForb 1 : ConvPwrRelsForbRelsFrbn1 ConvPwrRelsForbRelsMtnFrbn;
SIG_GROUP_ 659 DiagFrameForECM 1 : DiagFrameForECMByte0 DiagFrameForECMByte1 DiagFrameForECMByte2 DiagFrameForECMByte3 DiagFrameForECMByte4 DiagFrameForECMByte5 DiagFrameForECMByte6 DiagFrameForECMByte7;
SIG_GROUP_ 81 DKDataFromCEM 1 : DKDataFromCEMAcknowledgment DKDataFromCEMDKDataByte1 DKDataFromCEMDKDataByte2 DKDataFromCEMDKDataByte3 DKDataFromCEMDKDataByte4 DKDataFromCEMDKDataByte5 DKDataFromCEMDKDataByte6 DKDataFromCEMHeader;
SIG_GROUP_ 1161 DmcStsFrntToEsc 1 : DmcStsFrntToEscChks DmcStsFrntToEscCntr DmcStsFrntToEscDmcActAppTarTq DmcStsFrntToEscDmcSts DmcStsFrntToEscDmcSWInfo;
SIG_GROUP_ 1161 DrvrSteerActv 1 : DrvrSteerActvChks DrvrSteerActvCntr DrvrSteerActvDrvrSteerActv;
SIG_GROUP_ 416 EexvSts 1 : EexvStsExvActrPosn EexvStsExvBlkErr EexvStsExvCalibSts EexvStsExvElecStsErr EexvStsExvMovSts EexvStsExvOvrTempErr EexvStsExvOvrTrvlErr EexvStsExvPreHeatgSts EexvStsExvVoltgRangErr;
SIG_GROUP_ 1173 EngNSafe 1 : EngNSafeEngN EngNSafeEngNChks EngNSafeEngNCntr EngNSafeEngNGrdt;
SIG_GROUP_ 1173 EngRunngReqByVehModMgr 1 : EngRunngReqByVehModMgrChassie EngRunngReqByVehModMgrClimate EngRunngReqByVehModMgrElectricalSystem EngRunngReqByVehModMgrTrailerPrsnt;
SIG_GROUP_ 1161 EpbAvlSec 1 : EpbAvlSecChks EpbAvlSecCntr EpbAvlSecCommunicationAvailable EpbAvlSecHostAvailabilityFull EpbAvlSecHostAvailabilityRelOnly EpbAvlSecReserved1 EpbAvlSecReserved2 EpbAvlSecReserved3 EpbAvlSecReserved4 EpbAvlSecReserved5 EpbAvlSecReserved6 EpbAvlSecReserved7;
SIG_GROUP_ 416 EtpActualSpeed 1 : EtpActualSpeedBackup EtpActualSpeedEtpActualSpeed EtpActualSpeedSts;
SIG_GROUP_ 416 EtpCurrent 1 : EtpCurrent_Backup EtpCurrentEtpCurrent EtpCurrentStsBackup;
SIG_GROUP_ 416 EtpHallSignal 1 : EtpHallSignalError EtpHallSignalSt;
SIG_GROUP_ 416 EtpMcu 1 : EtpMcuTemperature EtpMcuTOutRngHiSts EtpMcuTOutRngLoSts EtpMcuTStuckSts;
SIG_GROUP_ 416 EtpMos 1 : EtpMosTemperature EtpMosTemperatureBackup EtpMosTOpenSts EtpMosTOutRngHiSts EtpMosTOutRngLoSts EtpMosTShoBattSts EtpMosTShoGndSts EtpMosTStuckSts;
SIG_GROUP_ 416 EtpPhase 1 : EtpPhaseCurrent EtpPhaseCurrentBackup EtpPhaseCurrentStsBackup EtpPhaseOverCurrent;
SIG_GROUP_ 416 EtpVHDVoltage 1 : EtpVHDVoltageBackup EtpVHDVoltageEtpVHDVoltage;
SIG_GROUP_ 416 ExvSts 1 : ExvStsExvActrPosn ExvStsExvBlkErr ExvStsExvCalibSts ExvStsExvElecStsErr ExvStsExvMovSts ExvStsExvOvrTempErr ExvStsExvOvrTrvlErr ExvStsExvPreHeatgSts ExvStsExvVoltgRangErr;
SIG_GROUP_ 569 HeatrPmpStat 1 : HeatrPmpStatCooltPmpDryErr HeatrPmpStatCooltPmpEmgyModSts HeatrPmpStatCooltPmpErrSts HeatrPmpStatCooltPmpI HeatrPmpStatCooltPmpIErr HeatrPmpStatCooltPmpMonrSpd HeatrPmpStatCooltPmpPostRunSts HeatrPmpStatCooltPmpSetPostRunReq HeatrPmpStatCooltPmpSetSpdReq HeatrPmpStatCooltPmpSpd HeatrPmpStatCooltPmpT HeatrPmpStatCooltPmpTErr HeatrPmpStatCooltPmpU HeatrPmpStatCooltPmpUErr HeatrPmpStatCooltPmpUnstallSts;
SIG_GROUP_ 659 HvBattThermInfoCorrInFuture 1 : HvBattThermInfoCorrInFuturePwrAtTime HvBattThermInfoCorrInFutureSequenceNo HvBattThermInfoCorrInFutureTempAtTime HvBattThermInfoCorrInFutureThermModAtTime HvBattThermInfoCorrInFutureTime HvBattThermInfoCorrInFutureVersionNo;
SIG_GROUP_ 1173 IntrMirrCmd 1 : IntrMirrCmdDrvrSide IntrMirrCmdIntrMirrAsyFanCmpMag IntrMirrCmdIntrMirrDiagcRst IntrMirrCmdIntrMirrDimSnvty IntrMirrCmdIntrMirrEna IntrMirrCmdIntrMirrInhbDim IntrMirrCmdIntrMirrWindHeatrCmpMag;
SIG_GROUP_ 416 IsgForWRC 1 : IsgForWRCIsgSpdForWRC IsgForWRCIsgTqEstForWRC;
SIG_GROUP_ 1161 IsgSpdActSgnSafe 1 : IsgSpdActSgnSafeChks IsgSpdActSgnSafeCntr IsgSpdActSgnSafeIsgSpdWSgnTyp IsgSpdActSgnSafeQf;
SIG_GROUP_ 1161 IsgTqAvl 1 : IsgTqAvlMax IsgTqAvlMin;
SIG_GROUP_ 422 IvtrDAxis 1 : IvtrDAxisCurrtSp IvtrDAxisU;
SIG_GROUP_ 422 IvtrDerating 1 : IvtrDeratingReason IvtrDeratingSts;
SIG_GROUP_ 422 IvtrOffsAg 1 : IvtrOffsAgIvtrOffsAg IvtrOffsAgSts;
SIG_GROUP_ 422 IvtrPhaPwmDuty 1 : IvtrPhaPwmDutyIvtrPhaUPwmDuty IvtrPhaPwmDutyIvtrPhaVPwmDuty IvtrPhaPwmDutyIvtrPhaWPwmDuty;
SIG_GROUP_ 422 IvtrQ 1 : IvtrQAxisCurrtSp IvtrQAxisU;
SIG_GROUP_ 422 IvtrSfty 1 : IvtrSftyFctMod IvtrSftySpd IvtrSftyTq IvtrSftyTqQf;
SIG_GROUP_ 422 IvtrTraPhaCurrtAry 1 : IvtrTraPhaCurrtAryU IvtrTraPhaCurrtAryV IvtrTraPhaCurrtAryW;
SIG_GROUP_ 1173 LatCtrlModCfmd 1 : LatCtrlModCfmdChks LatCtrlModCfmdCntr LatCtrlModCfmdLatCtrlMod;
SIG_GROUP_ 1161 Mot1ReqSafe 1 : Mot1ReqSafeChks Mot1ReqSafeCntr Mot1ReqSafemod Mot1ReqSafeRsv Mot1ReqSafespd Mot1ReqSafetq;
SIG_GROUP_ 1161 Mot3ReqSafe 1 : Mot3ReqSafeChks Mot3ReqSafeCntr Mot3ReqSafemod Mot3ReqSafeRsv Mot3ReqSafespd Mot3ReqSafetq;
SIG_GROUP_ 82 NFCAndBLEKeyDiReq 1 : NFCAndBLEKeyDiReqData1 NFCAndBLEKeyDiReqData10 NFCAndBLEKeyDiReqData11 NFCAndBLEKeyDiReqData12 NFCAndBLEKeyDiReqData13 NFCAndBLEKeyDiReqData14 NFCAndBLEKeyDiReqData15 NFCAndBLEKeyDiReqData16 NFCAndBLEKeyDiReqData2 NFCAndBLEKeyDiReqData3 NFCAndBLEKeyDiReqData4 NFCAndBLEKeyDiReqData5 NFCAndBLEKeyDiReqData6 NFCAndBLEKeyDiReqData7 NFCAndBLEKeyDiReqData8 NFCAndBLEKeyDiReqData9;
SIG_GROUP_ 82 NFCKeySearchReq 1 : NFCKeySearchReqKeyLocn NFCKeySearchReqTirgger;
SIG_GROUP_ 659 PrpsnDataPrdA 1 : PrpsnDataPrdACnt PrpsnDataPrdAData1 PrpsnDataPrdAData2 PrpsnDataPrdAData3 PrpsnDataPrdAData4 PrpsnDataPrdAData5 PrpsnDataPrdAData6 PrpsnDataPrdAData7;
SIG_GROUP_ 659 PrpsnDataPrdB 1 : PrpsnDataPrdBCnt PrpsnDataPrdBData1 PrpsnDataPrdBData2 PrpsnDataPrdBData3 PrpsnDataPrdBData4 PrpsnDataPrdBData5 PrpsnDataPrdBData6 PrpsnDataPrdBData7;
SIG_GROUP_ 1161 PtCluTq 1 : PtCluTqDyn PtCluTqPtCluTq PtCluTqQly;
SIG_GROUP_ 659 PtTotBrkTqReq 1 : PtTotBrkTqReqPtTotBrkTqEna PtTotBrkTqReqPtTotBrkTqReq;
SIG_GROUP_ 422 PtTqMCU 1 : PtTqMCUPtTqFrntMotMaxReq PtTqMCUPtTqFrntMotMinReq PtTqMCUPtTqReMotMaxReq PtTqMCUPtTqReMotMinReq;
SIG_GROUP_ 1173 RainSnsrSnvtyForUsrSnvty 1 : RainSnsrSnvtyForUsrSnvty0 RainSnsrSnvtyForUsrSnvty1 RainSnsrSnvtyForUsrSnvty2 RainSnsrSnvtyForUsrSnvty3 RainSnsrSnvtyForUsrSnvty4 RainSnsrSnvtyForUsrSnvty5 RainSnsrSnvtyForUsrSnvty6;
SIG_GROUP_ 1173 RemStrtMsgToDrvr 1 : RemStrtMsgToDrvrRemStrtBlkd1 RemStrtMsgToDrvrRemStrtDev1;
SIG_GROUP_ 920 SnsrSoundrBattBackedSts 1 : SnsrSoundrBattBackedStsArmSts SnsrSoundrBattBackedStsCfgSts SnsrSoundrBattBackedStsSnsrInclnExist SnsrSoundrBattBackedStsSoundrBattBackedErrSts SnsrSoundrBattBackedStsSoundSts;
SIG_GROUP_ 1161 SteerExtFctSts 1 : SteerExtFctStsChks SteerExtFctStsCntr SteerExtFctStsDrvrSteerOvrd SteerExtFctStsExtFctLowerLimActive SteerExtFctStsExtFctRateLimActive SteerExtFctStsExtFctUpperLimActive SteerExtFctStsExtSafeLimActive SteerExtFctStsLatAgReqNotInRange SteerExtFctStsLatCtrlReqNotInRange;
SIG_GROUP_ 920 StsOfLvlgLe 1 : StsOfLvlgLeChks StsOfLvlgLeCntr StsOfLvlgLeStsOfLvlgLe;
SIG_GROUP_ 920 StsOfLvlgRi 1 : StsOfLvlgRiChks StsOfLvlgRiCntr StsOfLvlgRiStsOfLvlgRi;
SIG_GROUP_ 920 SunRoofAndCurtBtnSts2 1 : SunRoofAndCurtBtnSts2Cntr SunRoofAndCurtBtnSts2Pos;
SIG_GROUP_ 1161 SuspFailrSts 1 : SuspFailrStsChks SuspFailrStsCntr SuspFailrStsSuspFailrSts SuspFailrStsTypQf;
SIG_GROUP_ 1173 TrOpenerReq 1 : TrOpenerReqTrigSrc TrOpenerReqTrOpenerReq;
SIG_GROUP_ 1161 TrsmActrPosnSafeAux 1 : TrsmActrPosnSafeAuxTrsmActrPosn TrsmActrPosnSafeAuxTrsmActrPosnChks TrsmActrPosnSafeAuxTrsmActrPosnCntr;
SIG_GROUP_ 1161 TrsmTqLoss 1 : TrsmTqLossChks TrsmTqLossCntr TrsmTqLossTrsmTqEff TrsmTqLossTrsmTqLoss;
SIG_GROUP_ 920 WiprMotDiagc 1 : WiprMotDiagcWiprMotHiVoltDetd WiprMotDiagcWiprMotLoVoltDetd WiprMotDiagcWiprMotOvldDetd;
SIG_GROUP_ 1173 WiprMotFrntLvrCmdSafe 1 : WiprMotFrntLvrCmdSafeLvrInHiSpdPosnSafe WiprMotFrntLvrCmdSafeLvrInIntlPosn WiprMotFrntLvrCmdSafeLvrInLoSpdPosnSafe WiprMotFrntLvrCmdSafeLvrInSnglStrokePos;
