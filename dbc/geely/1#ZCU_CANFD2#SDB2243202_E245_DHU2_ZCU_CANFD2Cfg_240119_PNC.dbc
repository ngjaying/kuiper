VERSION "ZCU_CANFD2"

NS_ :

BS_ :

BU_ :  ETC IHU ZCUD ZCUP

BO_ 565 ZCUDZCUCANFD2Fr12 : 64 ZCUD
 SG_ BrkSysWarnIndcnReqSec : 74|1@0+ (1,0) [0|1] "" IHU
 SG_ BrkSysWarnIndcnReqSec_UB : 75|1@0+ (1,0) [0|1] "" IHU
 SG_ CarLoctrActvnSts : 7|2@0+ (1,0) [0|3] "" IHU
 SG_ CarLoctrActvnSts_UB : 107|1@0+ (1,0) [0|1] "" IHU
 SG_ CcvmSts_UB : 297|1@0+ (1,0) [0|1] "" IHU
 SG_ CcvmStsVlvBlkFlt : 319|1@0+ (1,0) [0|1] "" IHU
 SG_ CcvmStsVlvCalibSts : 318|2@0+ (1,0) [0|3] "" IHU
 SG_ CcvmStsVlvCmdPosnErr : 316|1@0+ (1,0) [0|1] "" IHU
 SG_ CcvmStsVlvLoTErr : 315|1@0+ (1,0) [0|1] "" IHU
 SG_ CcvmStsVlvMoveSts : 314|1@0+ (1,0) [0|1] "" IHU
 SG_ CcvmStsVlvNVMFlt : 313|1@0+ (1,0) [0|1] "" IHU
 SG_ CcvmStsVlvOpenCircFlt : 312|1@0+ (1,0) [0|1] "" IHU
 SG_ CcvmStsVlvOverTErr : 327|1@0+ (1,0) [0|1] "" IHU
 SG_ CcvmStsVlvOverTrvlFlt : 326|1@0+ (1,0) [0|1] "" IHU
 SG_ CcvmStsVlvOverTWarn : 325|1@0+ (1,0) [0|1] "" IHU
 SG_ CcvmStsVlvOverUErr : 324|1@0+ (1,0) [0|1] "" IHU
 SG_ CcvmStsVlvPosn : 321|10@0+ (0.1,0.0) [0.0|100.0] "%" IHU
 SG_ CcvmStsVlvPosnCtrlTimeOutFlt : 322|1@0+ (1,0) [0|1] "" IHU
 SG_ CcvmStsVlvPosnUkwnFlt : 323|1@0+ (1,0) [0|1] "" IHU
 SG_ CcvmStsVlvPreHeatgSts : 343|1@0+ (1,0) [0|1] "" IHU
 SG_ CcvmStsVlvSelfLearnFlt : 342|1@0+ (1,0) [0|1] "" IHU
 SG_ CcvmStsVlvShoCircFlt : 341|1@0+ (1,0) [0|1] "" IHU
 SG_ CcvmStsVlvSpdLvlSts : 340|2@0+ (1,0) [0|3] "" IHU
 SG_ CcvmStsVlvUnderUErr : 338|1@0+ (1,0) [0|1] "" IHU
 SG_ CcvVlvSts_UB : 352|1@0+ (1,0) [0|1] "" IHU
 SG_ CcvVlvSts2PosSts : 337|10@0+ (0.26367188,-45.0) [-45.0|224.73633324000002] "Unitless" IHU
 SG_ CcvVlvSts2PosSts_UB : 296|1@0+ (1,0) [0|1] "" IHU
 SG_ CcvVlvStsARC : 359|2@0+ (1.0,0.0) [0.0|3.0] "Unitless" IHU
 SG_ CcvVlvStsIntFlt : 357|1@0+ (1,0) [0|1] "" IHU
 SG_ CcvVlvStsOprFlt : 356|1@0+ (1,0) [0|1] "" IHU
 SG_ CcvVlvStsTrqSts : 355|3@0+ (1,0) [0|7] "" IHU
 SG_ ChdLockRightFailStsToHmi : 5|2@0+ (1,0) [0|3] "" IHU
 SG_ ChdLockRightFailStsToHmi_UB : 106|1@0+ (1,0) [0|1] "" IHU
 SG_ ChdPrtnLeftFailStsToHmi : 3|2@0+ (1,0) [0|3] "" IHU
 SG_ ChdPrtnLeftFailStsToHmi_UB : 105|1@0+ (1,0) [0|1] "" IHU
 SG_ ChrgnSpd : 167|11@0+ (1.0,0.0) [0.0|2047.0] "Km/h" IHU
 SG_ ChrgnSpd_UB : 96|1@0+ (1,0) [0|1] "" IHU
 SG_ ClimaCmd : 23|1@0+ (1,0) [0|1] "" IHU,ZCUP
 SG_ ClimaCmd_UB : 104|1@0+ (1,0) [0|1] "" IHU,ZCUP
 SG_ CmprFb_UB : 172|1@0+ (1,0) [0|1] "" IHU
 SG_ CmprFbCmprI : 183|12@0+ (0.1,0.0) [0.0|409.5] "A" IHU
 SG_ CmprFbCmprIPha : 199|8@0+ (0.5,0.0) [0.0|127.0] "A" IHU
 SG_ CmprFbCmprSpd : 207|8@0+ (50.0,0.0) [0.0|12700.0] "rpm" IHU
 SG_ CmprFbCmprSts1 : 237|3@0+ (1,0) [0|7] "" IHU
 SG_ CmprFbCmprSts2 : 187|4@0+ (1,0) [0|15] "" IHU
 SG_ CmprFbCmprT1 : 215|8@0+ (1.0,-50.0) [-50.0|204.0] "degC" IHU
 SG_ CmprFbCmprT2 : 223|8@0+ (1.0,-50.0) [-50.0|204.0] "degC" IHU
 SG_ CmprFbCmprU : 231|10@0+ (2.0,0.0) [0.0|2046.0] "Volt" IHU
 SG_ CrashUnlckFailrSts : 22|2@0+ (1,0) [0|3] "" IHU
 SG_ CrashUnlckFailrSts_UB : 103|1@0+ (1,0) [0|1] "" IHU
 SG_ DrvrSeatHeatgAutoSts : 19|2@0+ (1,0) [0|3] "" IHU
 SG_ DrvrSeatHeatgAutoSts_UB : 100|1@0+ (1,0) [0|1] "" IHU
 SG_ DrvrSeatVentnAutoSts : 39|2@0+ (1,0) [0|3] "" IHU
 SG_ DrvrSeatVentnAutoSts_UB : 99|1@0+ (1,0) [0|1] "" IHU
 SG_ Edcp2PmpSts_UB : 70|1@0+ (1,0) [0|1] "" IHU
 SG_ Edcp2PmpStsCooltPmpDryErr : 367|2@0+ (1,0) [0|3] "" IHU
 SG_ Edcp2PmpStsCooltPmpEmgyModSts : 365|2@0+ (1,0) [0|3] "" IHU
 SG_ Edcp2PmpStsCooltPmpErrSts : 363|2@0+ (1,0) [0|3] "" IHU
 SG_ Edcp2PmpStsCooltPmpI : 375|8@0+ (0.2,0.0) [0.0|50.800000000000004] "A" IHU
 SG_ Edcp2PmpStsCooltPmpIErr : 361|2@0+ (1,0) [0|3] "" IHU
 SG_ Edcp2PmpStsCooltPmpMonrSpd : 383|2@0+ (1,0) [0|3] "" IHU
 SG_ Edcp2PmpStsCooltPmpPostRunSts : 381|2@0+ (1,0) [0|3] "" IHU
 SG_ Edcp2PmpStsCooltPmpSetPostRunReq : 423|3@0+ (1,0) [0|7] "" IHU
 SG_ Edcp2PmpStsCooltPmpSetSpdReq : 391|8@0+ (1.0,0.0) [0.0|254.0] "Unitless" IHU
 SG_ Edcp2PmpStsCooltPmpSpd : 399|8@0+ (1.0,0.0) [0.0|254.0] "Unitless" IHU
 SG_ Edcp2PmpStsCooltPmpT : 407|8@0+ (1.0,-50.0) [-50.0|200.0] "degC" IHU
 SG_ Edcp2PmpStsCooltPmpTErr : 379|2@0+ (1,0) [0|3] "" IHU
 SG_ Edcp2PmpStsCooltPmpU : 415|8@0+ (0.1,0.0) [0.0|25.0] "Volt" IHU
 SG_ Edcp2PmpStsCooltPmpUErr : 377|2@0+ (1,0) [0|3] "" IHU
 SG_ Edcp2PmpStsCooltPmpUnstallSts : 420|2@0+ (1,0) [0|3] "" IHU
 SG_ EngForbidRespFromVMM : 20|1@0+ (1,0) [0|1] "" IHU
 SG_ EngForbidRespFromVMM_UB : 97|1@0+ (1,0) [0|1] "" IHU
 SG_ EpbApplyEnaSec : 171|1@0+ (1,0) [0|1] "" IHU
 SG_ EpbApplyEnaSec_UB : 170|1@0+ (1,0) [0|1] "" IHU
 SG_ EpbRelsEnaSec : 169|1@0+ (1,0) [0|1] "" IHU
 SG_ EpbRelsEnaSec_UB : 168|1@0+ (1,0) [0|1] "" IHU
 SG_ ErsCmdByKey : 33|2@0+ (1,0) [0|3] "" IHU,ZCUP
 SG_ ErsCmdByKey_UB : 95|1@0+ (1,0) [0|1] "" IHU,ZCUP
 SG_ HctvSts_UB : 76|1@0+ (1,0) [0|1] "" IHU
 SG_ HctvStsVlvBlkFlt : 431|1@0+ (1,0) [0|1] "" IHU
 SG_ HctvStsVlvCalibSts : 430|2@0+ (1,0) [0|3] "" IHU
 SG_ HctvStsVlvCmdPosnErr : 428|1@0+ (1,0) [0|1] "" IHU
 SG_ HctvStsVlvLoTErr : 427|1@0+ (1,0) [0|1] "" IHU
 SG_ HctvStsVlvMoveSts : 426|1@0+ (1,0) [0|1] "" IHU
 SG_ HctvStsVlvNVMFlt : 425|1@0+ (1,0) [0|1] "" IHU
 SG_ HctvStsVlvOpenCircFlt : 424|1@0+ (1,0) [0|1] "" IHU
 SG_ HctvStsVlvOverTErr : 439|1@0+ (1,0) [0|1] "" IHU
 SG_ HctvStsVlvOverTrvlFlt : 438|1@0+ (1,0) [0|1] "" IHU
 SG_ HctvStsVlvOverTWarn : 437|1@0+ (1,0) [0|1] "" IHU
 SG_ HctvStsVlvOverUErr : 436|1@0+ (1,0) [0|1] "" IHU
 SG_ HctvStsVlvPosn : 433|10@0+ (0.1,0.0) [0.0|100.0] "%" IHU
 SG_ HctvStsVlvPosnCtrlTimeOutFlt : 435|1@0+ (1,0) [0|1] "" IHU
 SG_ HctvStsVlvPosnUkwnFlt : 434|1@0+ (1,0) [0|1] "" IHU
 SG_ HctvStsVlvPreHeatgSts : 455|1@0+ (1,0) [0|1] "" IHU
 SG_ HctvStsVlvSelfLearnFlt : 454|1@0+ (1,0) [0|1] "" IHU
 SG_ HctvStsVlvShoCircFlt : 453|1@0+ (1,0) [0|1] "" IHU
 SG_ HctvStsVlvSpdLvlSts : 452|2@0+ (1,0) [0|3] "" IHU
 SG_ HctvStsVlvUnderUErr : 450|1@0+ (1,0) [0|1] "" IHU
 SG_ HmiDefrstrElecSts_UB : 94|1@0+ (1,0) [0|1] "" IHU
 SG_ HmiDefrstrElecStsFrnt : 47|3@0+ (1,0) [0|7] "" IHU
 SG_ HmiDefrstrElecStsMirrr : 44|3@0+ (1,0) [0|7] "" IHU
 SG_ HmiDefrstrElecStsRe : 55|3@0+ (1,0) [0|7] "" IHU
 SG_ HvBattPmpStat_UB : 298|1@0+ (1,0) [0|1] "" IHU
 SG_ HvBattPmpStatCooltPmpDryErr : 247|2@0+ (1,0) [0|3] "" IHU
 SG_ HvBattPmpStatCooltPmpEmgyModSts : 245|2@0+ (1,0) [0|3] "" IHU
 SG_ HvBattPmpStatCooltPmpErrSts : 243|2@0+ (1,0) [0|3] "" IHU
 SG_ HvBattPmpStatCooltPmpI : 255|8@0+ (0.2,0.0) [0.0|50.800000000000004] "A" IHU
 SG_ HvBattPmpStatCooltPmpIErr : 241|2@0+ (1,0) [0|3] "" IHU
 SG_ HvBattPmpStatCooltPmpMonrSpd : 263|2@0+ (1,0) [0|3] "" IHU
 SG_ HvBattPmpStatCooltPmpPostRunSts : 261|2@0+ (1,0) [0|3] "" IHU
 SG_ HvBattPmpStatCooltPmpSetPostRunReq : 303|3@0+ (1,0) [0|7] "" IHU
 SG_ HvBattPmpStatCooltPmpSetSpdReq : 271|8@0+ (1.0,0.0) [0.0|254.0] "Unitless" IHU
 SG_ HvBattPmpStatCooltPmpSpd : 279|8@0+ (1.0,0.0) [0.0|254.0] "Unitless" IHU
 SG_ HvBattPmpStatCooltPmpT : 287|8@0+ (1.0,-50.0) [-50.0|200.0] "degC" IHU
 SG_ HvBattPmpStatCooltPmpTErr : 259|2@0+ (1,0) [0|3] "" IHU
 SG_ HvBattPmpStatCooltPmpU : 295|8@0+ (0.1,0.0) [0.0|25.0] "Volt" IHU
 SG_ HvBattPmpStatCooltPmpUErr : 257|2@0+ (1,0) [0|3] "" IHU
 SG_ HvBattPmpStatCooltPmpUnstallSts : 300|2@0+ (1,0) [0|3] "" IHU
 SG_ HvCooltHeatrICnsSig : 15|8@0+ (0.25,0.0) [0.0|63.75] "Unitless" IHU
 SG_ HvCooltHeatrICnsSig_UB : 0|1@0+ (1,0) [0|1] "" IHU
 SG_ HvHeatrPwrCnsDes : 17|10@0+ (20.0,0.0) [0.0|20460.0] "W" IHU
 SG_ HvHeatrPwrCnsDes_UB : 1|1@0+ (1,0) [0|1] "" IHU
 SG_ ImobMgrWarnIndcn : 51|2@0+ (1,0) [0|3] "" IHU
 SG_ ImobMgrWarnIndcn_UB : 93|1@0+ (1,0) [0|1] "" IHU
 SG_ KeyNotPrsntMsgToDrvr : 73|1@0+ (1,0) [0|1] "" IHU
 SG_ KeyNotPrsntMsgToDrvr_UB : 72|1@0+ (1,0) [0|1] "" IHU
 SG_ MotConsDrvCyc : 119|32@0+ (0.1,0.0) [0.0|800000.0] "Kilojoule_1" IHU
 SG_ MotConsDrvCyc_UB : 52|1@0+ (1,0) [0|1] "" IHU
 SG_ PostHeatgRunTiEstimd : 151|16@0+ (1.0,0.0) [0.0|65535.0] "Unitless" ZCUP
 SG_ PostHeatgRunTiEstimd_UB : 98|1@0+ (1,0) [0|1] "" ZCUP
 SG_ PrpsnErrIndcnReq : 49|2@0+ (1,0) [0|3] "" Vector__XXX
 SG_ PrpsnErrIndcnReq_UB : 91|1@0+ (1,0) [0|1] "" Vector__XXX
 SG_ RlyPwrDistbnCmd1WdIgnRlyExtCmd : 59|1@0+ (1,0) [0|1] "" IHU
 SG_ RlyPwrDistbnCmd1WdIgnRlyExtCmd_UB : 89|1@0+ (1,0) [0|1] "" IHU
 SG_ SteerWhlHeatgAvlSts : 58|3@0+ (1,0) [0|7] "" IHU
 SG_ SteerWhlHeatgAvlSts_UB : 86|1@0+ (1,0) [0|1] "" IHU
 SG_ SteerWhlHeatgStrtAutCdnOk : 65|1@0+ (1,0) [0|1] "" IHU
 SG_ SteerWhlHeatgStrtAutCdnOk_UB : 84|1@0+ (1,0) [0|1] "" IHU
 SG_ StrtInProgs : 67|2@0+ (1,0) [0|3] "" IHU,ZCUP
 SG_ StrtInProgs_UB : 83|1@0+ (1,0) [0|1] "" IHU,ZCUP
 SG_ StrtMsgToDrvr : 63|4@0+ (1,0) [0|15] "" IHU
 SG_ StrtMsgToDrvr_UB : 71|1@0+ (1,0) [0|1] "" IHU
 SG_ SysDirIndcnFailr : 64|1@0+ (1,0) [0|1] "" IHU
 SG_ SysDirIndcnFailr_UB : 82|1@0+ (1,0) [0|1] "" IHU
 SG_ TInCooltAtStrtOfClima : 311|8@0+ (1.0,-40.0) [-40.0|215.0] "degC" IHU,ZCUP
 SG_ TInCooltAtStrtOfClima_UB : 77|1@0+ (1,0) [0|1] "" IHU,ZCUP
 SG_ TrAntiPnch : 79|1@0+ (1,0) [0|1] "" IHU
 SG_ TrAntiPnch_UB : 81|1@0+ (1,0) [0|1] "" IHU
 SG_ TrObstclDetn : 78|1@0+ (1,0) [0|1] "" IHU
 SG_ TrObstclDetn_UB : 80|1@0+ (1,0) [0|1] "" IHU

BO_ 1154 ZCUDZCUCANFD2Fr13 : 64 ZCUD
 SG_ BattSnsrStReq : 507|2@0+ (1,0) [0|3] "" IHU
 SG_ BattSnsrStReq_UB : 505|1@0+ (1,0) [0|1] "" IHU
 SG_ BrkLiReqRegen_UB : 19|1@0+ (1,0) [0|1] "" IHU
 SG_ BrkLiReqRegenChks : 31|8@0+ (1.0,0.0) [0.0|255.0] "Unitless" IHU
 SG_ BrkLiReqRegenCntr : 39|4@0+ (1.0,0.0) [0.0|15.0] "Unitless" IHU
 SG_ BrkLiReqRegenOnOff : 35|1@0+ (1,0) [0|1] "" IHU
 SG_ DHTStSafe_UB : 416|1@0+ (1,0) [0|1] "" IHU
 SG_ DHTStSafeChks : 383|8@0+ (1.0,0.0) [0.0|255.0] "Unitless" IHU
 SG_ DHTStSafeCntr : 391|4@0+ (1.0,0.0) [0.0|15.0] "Unitless" IHU
 SG_ DHTStSafeRsv : 387|4@0+ (1.0,0.0) [0.0|15.0] "Unitless" IHU
 SG_ DHTStSafeSpd : 415|15@0- (1.0,0.0) [-16384.0|16383.0] "rpm" IHU
 SG_ DHTStSafeSpdQf : 399|2@0+ (1,0) [0|3] "" IHU
 SG_ DHTStSafeTqRt : 395|12@0+ (0.01,0.0) [0.0|40.95] "Unitless" IHU
 SG_ DHTStSafeTqRtQf : 397|2@0+ (1,0) [0|3] "" IHU
 SG_ DtEngdSt_UB : 8|1@0+ (1,0) [0|1] "" IHU
 SG_ DtEngdStDtEngdFrnt : 23|1@0+ (1,0) [0|1] "" IHU
 SG_ DtEngdStDtEngdRe : 22|1@0+ (1,0) [0|1] "" IHU
 SG_ DtEngdStDtNotEngdFrnt : 21|1@0+ (1,0) [0|1] "" IHU
 SG_ DtEngdStDtNotEngdRe : 20|1@0+ (1,0) [0|1] "" IHU
 SG_ ElecMot2ErrIndcnReq : 207|1@0+ (1,0) [0|1] "" Vector__XXX
 SG_ ElecMot2ErrIndcnReq_UB : 206|1@0+ (1,0) [0|1] "" Vector__XXX
 SG_ ElecMot2LimnIndcn : 431|16@0+ (1.0,0.0) [0.0|65535.0] "Unitless" Vector__XXX
 SG_ ElecMot2LimnIndcn_UB : 205|1@0+ (1,0) [0|1] "" Vector__XXX
 SG_ ElecMot2UDc : 447|11@0+ (0.25,0.0) [0.0|511.0] "Volt" Vector__XXX
 SG_ ElecMot2UDc_UB : 204|1@0+ (1,0) [0|1] "" Vector__XXX
 SG_ EngRunngReqByTrsm : 203|2@0+ (1,0) [0|3] "" IHU
 SG_ EngRunngReqByTrsm_UB : 271|1@0+ (1,0) [0|1] "" IHU
 SG_ IsgActvDampgModReq : 18|2@0+ (1,0) [0|3] "" IHU
 SG_ IsgActvDampgModReq_UB : 16|1@0+ (1,0) [0|1] "" IHU
 SG_ IsgModReq : 55|4@0+ (1,0) [0|15] "" IHU
 SG_ IsgModReq_UB : 51|1@0+ (1,0) [0|1] "" IHU
 SG_ IsgPwrLimMax : 33|10@0+ (0.5,0.0) [0.0|511.0] "kW" IHU
 SG_ IsgPwrLimMax_UB : 34|1@0+ (1,0) [0|1] "" IHU
 SG_ IsgPwrLimMin : 49|10@0+ (0.5,-511.0) [-511.0|0.0] "kW" IHU
 SG_ IsgPwrLimMin_UB : 50|1@0+ (1,0) [0|1] "" IHU
 SG_ IsgSpdReq : 71|15@0- (1.0,0.0) [-16384.0|16383.0] "rpm" IHU
 SG_ IsgSpdReq_UB : 72|1@0+ (1,0) [0|1] "" IHU
 SG_ IsgTqAllwd_UB : 103|1@0+ (1,0) [0|1] "" IHU
 SG_ IsgTqAllwdChks : 87|8@0+ (1.0,0.0) [0.0|255.0] "Unitless" IHU
 SG_ IsgTqAllwdCntr : 95|4@0+ (1.0,0.0) [0.0|15.0] "Unitless" IHU
 SG_ IsgTqAllwdIsgTqAllwd : 91|4@0+ (1.0,0.0) [0.0|15.0] "Unitless" IHU
 SG_ OvrdDecelByDrvr_UB : 101|1@0+ (1,0) [0|1] "" IHU
 SG_ OvrdDecelByDrvrChks : 111|8@0+ (1.0,0.0) [0.0|255.0] "Unitless" IHU
 SG_ OvrdDecelByDrvrCntr : 99|4@0+ (1.0,0.0) [0.0|15.0] "Unitless" IHU
 SG_ OvrdDecelByDrvrOvrdDecelByDrvr : 100|1@0+ (1,0) [0|1] "" IHU
 SG_ ParkByDrvrWhlsFrntSafe_UB : 102|1@0+ (1,0) [0|1] "" IHU
 SG_ ParkByDrvrWhlsFrntSafeChks : 119|8@0+ (1.0,0.0) [0.0|255.0] "Unitless" IHU
 SG_ ParkByDrvrWhlsFrntSafeCntr : 127|4@0+ (1.0,0.0) [0.0|15.0] "Unitless" IHU
 SG_ ParkByDrvrWhlsFrntSafeSts : 123|1@0+ (1,0) [0|1] "" IHU
 SG_ PropLgtCtrlModCfmd_UB : 136|1@0+ (1,0) [0|1] "" IHU
 SG_ PropLgtCtrlModCfmdChks : 135|8@0+ (1.0,0.0) [0.0|255.0] "Unitless" IHU
 SG_ PropLgtCtrlModCfmdCntr : 143|4@0+ (1.0,0.0) [0.0|15.0] "Unitless" IHU
 SG_ PropLgtCtrlModCfmdLgtDegradation : 122|3@0+ (1,0) [0|7] "" IHU
 SG_ PropLgtCtrlModCfmdPropLgtCtrlModCfmd : 139|3@0+ (1,0) [0|7] "" IHU
 SG_ PrpsnTqFrntReq : 151|16@0- (1.0,0.0) [-20000.0|20000.0] "NewtonMeter" IHU
 SG_ PrpsnTqFrntReq_UB : 167|1@0+ (1,0) [0|1] "" IHU
 SG_ PrpsnTqReReq : 175|16@0- (1.0,0.0) [-20000.0|20000.0] "NewtonMeter" IHU
 SG_ PrpsnTqReReq_UB : 166|1@0+ (1,0) [0|1] "" IHU
 SG_ PtAllwdToTrsmActrSafe_UB : 165|1@0+ (1,0) [0|1] "" IHU
 SG_ PtAllwdToTrsmActrSafeChks : 191|8@0+ (1.0,0.0) [0.0|255.0] "Unitless" IHU
 SG_ PtAllwdToTrsmActrSafeCntr : 199|4@0+ (1.0,0.0) [0.0|15.0] "Unitless" IHU
 SG_ PtAllwdToTrsmActrSafePtAllwdToTrsmActr : 195|4@0+ (1,0) [0|15] "" IHU
 SG_ PtBrkTqCpTot_UB : 216|1@0+ (1,0) [0|1] "" IHU
 SG_ PtBrkTqCpTot1 : 215|15@0- (1.0,0.0) [-16384.0|16380.0] "NewtonMeter" IHU
 SG_ PtBrkTqCpTotQf : 201|2@0+ (1,0) [0|3] "" IHU
 SG_ PtGearRatFrntAct : 231|12@0+ (0.01,0.0) [0.0|40.95] "Unitless" IHU
 SG_ PtGearRatFrntAct_UB : 164|1@0+ (1,0) [0|1] "" IHU
 SG_ PtGearTar : 235|4@0+ (1,0) [0|15] "" IHU
 SG_ PtGearTar_UB : 163|1@0+ (1,0) [0|1] "" IHU
 SG_ PtJTot_UB : 162|1@0+ (1,0) [0|1] "" IHU
 SG_ PtJTotAtTrsmAxleOutp : 247|12@0+ (0.03,0.0) [0.0|122.85] "Unitless" IHU
 SG_ PtJTotChks : 263|8@0+ (1.0,0.0) [0.0|255.0] "Unitless" IHU
 SG_ PtJTotCntr : 251|4@0+ (1.0,0.0) [0.0|15.0] "Unitless" IHU
 SG_ PtRgnTarTqAtReAxle_UB : 280|1@0+ (1,0) [0|1] "" IHU
 SG_ PtRgnTarTqAtReAxleAtReAxle : 279|15@0- (1.0,0.0) [-16384.0|16380.0] "NewtonMeter" IHU
 SG_ PtRgnTarTqAtReAxleQf : 265|2@0+ (1,0) [0|3] "" IHU
 SG_ PtTotRgnTarTq_UB : 304|1@0+ (1,0) [0|1] "" IHU
 SG_ PtTotRgnTarTq1 : 303|15@0- (1.0,0.0) [-16384.0|16380.0] "NewtonMeter" IHU
 SG_ PtTotRgnTarTqQf : 289|2@0+ (1,0) [0|3] "" IHU
 SG_ PtTqAtAxleAvlFrntMax : 319|13@0- (4.0,0.0) [-16384.0|16380.0] "NewtonMeter" IHU
 SG_ PtTqAtAxleAvlFrntMax_UB : 161|1@0+ (1,0) [0|1] "" IHU
 SG_ PtTqAtAxleAvlFrntMin : 335|13@0- (4.0,0.0) [-16384.0|16380.0] "NewtonMeter" IHU
 SG_ PtTqAtAxleAvlFrntMin_UB : 160|1@0+ (1,0) [0|1] "" IHU
 SG_ PtTqAtAxleAvlReMax : 351|13@0- (4.0,0.0) [-16384.0|16380.0] "NewtonMeter" IHU
 SG_ PtTqAtAxleAvlReMax_UB : 322|1@0+ (1,0) [0|1] "" IHU
 SG_ PtTqAtAxleAvlReMin : 367|15@0- (1.0,0.0) [-16384.0|16380.0] "NewtonMeter" IHU
 SG_ PtTqAtAxleAvlReMin_UB : 368|1@0+ (1,0) [0|1] "" IHU
 SG_ PtWhlTqTar : 7|14@0+ (1.0,-6383.0) [-6383.0|10000.0] "NewtonMeter" Vector__XXX
 SG_ PtWhlTqTar_UB : 9|1@0+ (1,0) [0|1] "" Vector__XXX
 SG_ RlyCrashForHvsysReq : 321|1@0+ (1,0) [0|1] "" IHU
 SG_ RlyCrashForHvsysReq_UB : 320|1@0+ (1,0) [0|1] "" IHU
 SG_ TrsmActrPosn2_UB : 464|1@0+ (1,0) [0|1] "" IHU
 SG_ TrsmActrPosn2TrsmActrPosn : 467|3@0+ (1,0) [0|7] "" IHU
 SG_ TrsmActrPosn2TrsmActrPosnChks : 463|8@0+ (1.0,0.0) [0.0|255.0] "Unitless" IHU
 SG_ TrsmActrPosn2TrsmActrPosnCntr : 471|4@0+ (1.0,0.0) [0.0|15.0] "Unitless" IHU
 SG_ TrsmGearAct : 270|4@0+ (1,0) [0|15] "" IHU
 SG_ TrsmGearAct_UB : 266|1@0+ (1,0) [0|1] "" IHU
 SG_ TrsmGearChgProgs : 295|3@0+ (1,0) [0|7] "" IHU
 SG_ TrsmGearChgProgs_UB : 292|1@0+ (1,0) [0|1] "" IHU
 SG_ TrsmGearNotAvlSts : 479|12@0+ (1.0,0.0) [0.0|4095.0] "Unitless" IHU
 SG_ TrsmGearNotAvlSts_UB : 291|1@0+ (1,0) [0|1] "" IHU
 SG_ TrsmGearRat : 483|12@0+ (0.01,0.0) [0.0|40.95] "Unitless" IHU
 SG_ TrsmGearRat_UB : 290|1@0+ (1,0) [0|1] "" IHU
 SG_ TrsmGearRatTar : 503|12@0+ (0.01,0.0) [0.0|40.95] "Unitless" IHU
 SG_ TrsmGearRatTar_UB : 338|1@0+ (1,0) [0|1] "" IHU
 SG_ TrsmGearTar : 451|4@0+ (1,0) [0|15] "" IHU
 SG_ TrsmGearTar_UB : 452|1@0+ (1,0) [0|1] "" IHU

BO_ 528 ZCUDZCUCANFD2Fr14 : 64 ZCUD
 SG_ DrvrSeatHeatgActlPwrCns : 7|8@0+ (1.0,0.0) [0.0|255.0] "Unitless" IHU,ZCUP
 SG_ DrvrSeatHeatgActlPwrCns_UB : 351|1@0+ (1,0) [0|1] "" IHU,ZCUP
 SG_ DrvrSeatHeatgDesPwrCns : 15|8@0+ (1.0,0.0) [0.0|255.0] "Unitless" IHU,ZCUP
 SG_ DrvrSeatHeatgDesPwrCns_UB : 350|1@0+ (1,0) [0|1] "" IHU,ZCUP
 SG_ DrvrSeatVentnActlPwrCns : 23|8@0+ (1.0,0.0) [0.0|255.0] "Unitless" IHU,ZCUP
 SG_ DrvrSeatVentnActlPwrCns_UB : 348|1@0+ (1,0) [0|1] "" IHU,ZCUP
 SG_ DrvrSeatVentnDesPwrCns : 31|8@0+ (1.0,0.0) [0.0|255.0] "Unitless" IHU,ZCUP
 SG_ DrvrSeatVentnDesPwrCns_UB : 347|1@0+ (1,0) [0|1] "" IHU,ZCUP
 SG_ DstEstimdToEmptyForDrvgElecPredTyp2 : 41|10@0+ (1.0,0.0) [0.0|1023.0] "KiloMtr" IHU
 SG_ DstEstimdToEmptyForDrvgElecPredTyp2_UB : 345|1@0+ (1,0) [0|1] "" IHU
 SG_ DstTrvldAct : 87|25@0+ (0.1,0.0) [0.0|2000000.0] "km" IHU
 SG_ DstTrvldAct_UB : 342|1@0+ (1,0) [0|1] "" IHU
 SG_ DstTrvldOfEng : 104|25@0+ (0.1,0.0) [0.0|2000000.0] "km" IHU
 SG_ DstTrvldOfEng_UB : 341|1@0+ (1,0) [0|1] "" IHU
 SG_ DstTrvldOfEV : 143|25@0+ (0.1,0.0) [0.0|2000000.0] "km" IHU
 SG_ DstTrvldOfEV_UB : 340|1@0+ (1,0) [0|1] "" IHU
 SG_ EPedlDrvrIndcnMsg : 43|2@0+ (1,0) [0|3] "" IHU
 SG_ EPedlDrvrIndcnMsg_UB : 338|1@0+ (1,0) [0|1] "" IHU
 SG_ EPedlInhbnSts : 189|1@0+ (1,0) [0|1] "" IHU
 SG_ EPedlInhbnSts_UB : 337|1@0+ (1,0) [0|1] "" IHU
 SG_ ErsDelayTiCfm : 188|1@0+ (1,0) [0|1] "" IHU
 SG_ ErsDelayTiCfm_UB : 336|1@0+ (1,0) [0|1] "" IHU
 SG_ ErsStrtRes : 110|5@0+ (1,0) [0|31] "" IHU
 SG_ ErsStrtRes_UB : 105|1@0+ (1,0) [0|1] "" IHU
 SG_ HealthOfEngOil : 175|7@0+ (1.0,0.0) [0.0|100.0] "%" IHU
 SG_ HealthOfEngOil_UB : 335|1@0+ (1,0) [0|1] "" IHU
 SG_ HpcDeiceReq : 69|3@0+ (1,0) [0|7] "" IHU,ZCUP
 SG_ HpcDeiceReq_UB : 66|1@0+ (1,0) [0|1] "" IHU,ZCUP
 SG_ HpcHpCoolgPwrSts : 187|1@0+ (1,0) [0|1] "" IHU,ZCUP
 SG_ HpcHpCoolgPwrSts_UB : 334|1@0+ (1,0) [0|1] "" IHU,ZCUP
 SG_ HpcHpHeatgPwrSts : 186|1@0+ (1,0) [0|1] "" IHU,ZCUP
 SG_ HpcHpHeatgPwrSts_UB : 333|1@0+ (1,0) [0|1] "" IHU,ZCUP
 SG_ HpcHpModReq : 166|7@0+ (1,0) [0|127] "" IHU,ZCUP
 SG_ HpcHpModReq_UB : 332|1@0+ (1,0) [0|1] "" IHU,ZCUP
 SG_ HvacCooltFlowAct : 183|10@0+ (0.05,0.0) [0.0|51.150000000000006] "L / min" IHU,ZCUP
 SG_ HvacCooltFlowAct_UB : 331|1@0+ (1,0) [0|1] "" IHU,ZCUP
 SG_ HvacCooltVlvStsSig : 207|3@0+ (1,0) [0|7] "" IHU,ZCUP
 SG_ HvacCooltVlvStsSig_UB : 330|1@0+ (1,0) [0|1] "" IHU,ZCUP
 SG_ HvBattThermPwrCns : 185|10@0+ (20.0,0.0) [0.0|20460.0] "W" IHU
 SG_ HvBattThermPwrCns_UB : 329|1@0+ (1,0) [0|1] "" IHU
 SG_ HvCabinThermPwrCns : 201|10@0+ (20.0,0.0) [0.0|20460.0] "W" IHU
 SG_ HvCabinThermPwrCns_UB : 328|1@0+ (1,0) [0|1] "" IHU
 SG_ HvCooltHeatrEnad : 343|1@0+ (1,0) [0|1] "" IHU,ZCUP
 SG_ HvCooltHeatrEnad_UB : 318|1@0+ (1,0) [0|1] "" IHU,ZCUP
 SG_ HvCooltHeatrStsSig : 204|3@0+ (1,0) [0|7] "" IHU,ZCUP
 SG_ HvCooltHeatrStsSig_UB : 327|1@0+ (1,0) [0|1] "" IHU,ZCUP
 SG_ HvSysRlySts_UB : 326|1@0+ (1,0) [0|1] "" ZCUP
 SG_ HvSysRlyStsChks : 223|8@0+ (1.0,0.0) [0.0|255.0] "Unitless" ZCUP
 SG_ HvSysRlyStsCntr : 231|4@0+ (1.0,0.0) [0.0|15.0] "Unitless" ZCUP
 SG_ HvSysRlyStsHvSysRlySts : 227|2@0+ (1,0) [0|3] "" ZCUP
 SG_ NatUsgDayOfOil : 247|10@0+ (1.0,0.0) [0.0|1023.0] "Unitless" IHU
 SG_ NatUsgDayOfOil_UB : 324|1@0+ (1,0) [0|1] "" IHU
 SG_ OilHealthIfDisp : 253|1@0+ (1,0) [0|1] "" IHU
 SG_ OilHealthIfDisp_UB : 323|1@0+ (1,0) [0|1] "" IHU
 SG_ PEMState : 225|2@0+ (1,0) [0|3] "" IHU
 SG_ PEMState_UB : 321|1@0+ (1,0) [0|1] "" IHU
 SG_ RainSnsrStsToHMI : 320|1@0+ (1,0) [0|1] "" IHU
 SG_ RainSnsrStsToHMI_UB : 312|1@0+ (1,0) [0|1] "" IHU
 SG_ RemindChrgn : 252|1@0+ (1,0) [0|1] "" Vector__XXX
 SG_ RemindChrgn_UB : 317|1@0+ (1,0) [0|1] "" Vector__XXX
 SG_ RoadInFor : 263|3@0+ (1,0) [0|7] "" Vector__XXX
 SG_ RoadInFor_UB : 316|1@0+ (1,0) [0|1] "" Vector__XXX
 SG_ SeatOccptAtRowSecMid2 : 251|2@0+ (1,0) [0|3] "" IHU,ZCUP
 SG_ SeatOccptAtRowSecMid2_UB : 325|1@0+ (1,0) [0|1] "" IHU,ZCUP
 SG_ SeatOccptAtRowSecMidSnsSts2 : 249|2@0+ (1,0) [0|3] "" IHU,ZCUP
 SG_ SeatOccptAtRowSecMidSnsSts2_UB : 339|1@0+ (1,0) [0|1] "" IHU,ZCUP
 SG_ SlopReducEngCoeff_UB : 315|1@0+ (1,0) [0|1] "" IHU
 SG_ SlopReducEngCoeffSlopEqu12 : 359|8@0+ (1.0,0.0) [0.0|100.0] "%" IHU
 SG_ SlopReducEngCoeffSlopEqu2 : 367|8@0+ (1.0,0.0) [0.0|100.0] "%" IHU
 SG_ SlopReducEngCoeffSlopEqu4 : 375|8@0+ (1.0,0.0) [0.0|100.0] "%" IHU
 SG_ SlopReducEngCoeffSlopEqu6 : 383|8@0+ (1.0,0.0) [0.0|100.0] "%" IHU
 SG_ SlopReducEngCoeffSlopEqu9 : 391|8@0+ (1.0,0.0) [0.0|100.0] "%" IHU
 SG_ SlopRiseEngCoeff_UB : 314|1@0+ (1,0) [0|1] "" IHU
 SG_ SlopRiseEngCoeffSlopEqu12 : 399|8@0+ (1.0,0.0) [0.0|100.0] "%" IHU
 SG_ SlopRiseEngCoeffSlopEqu2 : 407|8@0+ (1.0,0.0) [0.0|100.0] "%" IHU
 SG_ SlopRiseEngCoeffSlopEqu4 : 415|8@0+ (1.0,0.0) [0.0|100.0] "%" IHU
 SG_ SlopRiseEngCoeffSlopEqu6 : 423|8@0+ (1.0,0.0) [0.0|100.0] "%" IHU
 SG_ SlopRiseEngCoeffSlopEqu9 : 431|8@0+ (1.0,0.0) [0.0|100.0] "%" IHU
 SG_ SpdRelatWght_UB : 313|1@0+ (1,0) [0|1] "" IHU
 SG_ SpdRelatWghtSpdEqu10 : 439|8@0+ (1.0,0.0) [0.0|255.0] "Unitless" IHU
 SG_ SpdRelatWghtSpdEqu100 : 447|8@0+ (1.0,0.0) [0.0|255.0] "Unitless" IHU
 SG_ SpdRelatWghtSpdEqu120 : 455|8@0+ (1.0,0.0) [0.0|255.0] "Unitless" IHU
 SG_ SpdRelatWghtSpdEqu140 : 463|8@0+ (1.0,0.0) [0.0|255.0] "Unitless" IHU
 SG_ SpdRelatWghtSpdEqu20 : 471|8@0+ (1.0,0.0) [0.0|255.0] "Unitless" IHU
 SG_ SpdRelatWghtSpdEqu40 : 479|8@0+ (1.0,0.0) [0.0|255.0] "Unitless" IHU
 SG_ SpdRelatWghtSpdEqu60 : 487|8@0+ (1.0,0.0) [0.0|255.0] "Unitless" IHU
 SG_ SpdRelatWghtSpdEqu80 : 495|8@0+ (1.0,0.0) [0.0|255.0] "Unitless" IHU
 SG_ SwtStrt3 : 39|2@0+ (1,0) [0|3] "" IHU
 SG_ SwtStrt3_UB : 37|1@0+ (1,0) [0|1] "" IHU
 SG_ SwtStrt4 : 35|2@0+ (1,0) [0|3] "" IHU
 SG_ SwtStrt4_UB : 36|1@0+ (1,0) [0|1] "" IHU
 SG_ TotDstTrvldOfEng : 256|25@0+ (0.1,0.0) [0.0|2000000.0] "km" IHU
 SG_ TotDstTrvldOfEng_UB : 257|1@0+ (1,0) [0|1] "" IHU
 SG_ TotDstTrvldOfEV : 295|25@0+ (0.1,0.0) [0.0|2000000.0] "km" IHU
 SG_ TotDstTrvldOfEV_UB : 259|1@0+ (1,0) [0|1] "" IHU
 SG_ TrOpenerByFootOperCmd : 168|1@0+ (1,0) [0|1] "" IHU
 SG_ TrOpenerByFootOperCmd_UB : 239|1@0+ (1,0) [0|1] "" IHU
 SG_ WiprActvFromWMM : 260|1@0+ (1,0) [0|1] "" Vector__XXX
 SG_ WiprActvFromWMM_UB : 258|1@0+ (1,0) [0|1] "" Vector__XXX

BO_ 880 ZCUDZCUCANFD2Fr15 : 64 ZCUD
 SG_ AccrPedlLnr_UB : 42|1@0+ (1,0) [0|1] "" IHU
 SG_ AccrPedlLnrAccrPedlRat : 111|15@0+ (0.00390625,0.0) [0.0|100.0] "%" IHU
 SG_ AccrPedlLnrChks : 103|8@0+ (1.0,0.0) [0.0|255.0] "Unitless" IHU
 SG_ AccrPedlLnrCntr : 127|4@0+ (1.0,0.0) [0.0|15.0] "Unitless" IHU
 SG_ AccrPedlNotCmpl_UB : 43|1@0+ (1,0) [0|1] "" IHU
 SG_ AccrPedlNotCmplPsd : 143|1@0+ (1,0) [0|1] "" IHU
 SG_ AccrPedlNotCmplPsdChks : 135|8@0+ (1.0,0.0) [0.0|255.0] "Unitless" IHU
 SG_ AccrPedlNotCmplPsdCntr : 123|4@0+ (1.0,0.0) [0.0|15.0] "Unitless" IHU
 SG_ AccrPedlNotCmplPsdSts : 142|1@0+ (1,0) [0|1] "" IHU
 SG_ AccrPedlRatGrdt : 151|15@0- (0.0625,0.0) [-1000.0|1000.0] "PercPerSec" IHU
 SG_ AccrPedlRatGrdt_UB : 48|1@0+ (1,0) [0|1] "" IHU
 SG_ AmbTURaw : 167|12@0+ (0.1,-70.0) [-70.0|339.5] "degC" IHU
 SG_ AmbTURaw_UB : 152|1@0+ (1,0) [0|1] "" IHU
 SG_ CrsCtrlrActvnOk : 141|1@0+ (1,0) [0|1] "" IHU
 SG_ CrsCtrlrActvnOk_UB : 140|1@0+ (1,0) [0|1] "" IHU
 SG_ DeactvtTestCom : 139|1@0+ (1,0) [0|1] "" IHU
 SG_ DeactvtTestCom_UB : 138|1@0+ (1,0) [0|1] "" IHU
 SG_ DrvrPrpsnTqReq : 183|16@0- (1.0,0.0) [-20000.0|20000.0] "NewtonMeter" IHU
 SG_ DrvrPrpsnTqReq_UB : 137|1@0+ (1,0) [0|1] "" IHU
 SG_ EngPAmbAir : 79|8@0+ (5.0,0.0) [0.0|1275.0] "hPa" IHU
 SG_ EngPAmbAir_UB : 66|1@0+ (1,0) [0|1] "" IHU
 SG_ EngPwrCns : 87|11@0+ (1.0,0.0) [0.0|2047.0] "W" Vector__XXX
 SG_ EngPwrCns_UB : 67|1@0+ (1,0) [0|1] "" Vector__XXX
 SG_ ImobBrkNrSerlReq : 171|1@0+ (1,0) [0|1] "" IHU
 SG_ ImobBrkNrSerlReq_UB : 136|1@0+ (1,0) [0|1] "" IHU
 SG_ ImobEngSts1 : 170|2@0+ (1,0) [0|3] "" IHU
 SG_ ImobEngSts1_UB : 168|1@0+ (1,0) [0|1] "" IHU
 SG_ ImobEngSts3 : 89|2@0+ (1,0) [0|3] "" IHU
 SG_ ImobEngSts3_UB : 41|1@0+ (1,0) [0|1] "" IHU
 SG_ PtDtModReq : 71|3@0+ (1,0) [0|7] "" Vector__XXX
 SG_ PtDtModReq_UB : 68|1@0+ (1,0) [0|1] "" Vector__XXX
 SG_ PtReqToTrsmActr : 19|3@0+ (1,0) [0|7] "" Vector__XXX
 SG_ PtReqToTrsmActr_UB : 16|1@0+ (1,0) [0|1] "" Vector__XXX
 SG_ PtTqTotDrgAtWhls : 31|16@0- (1.0,0.0) [-20000.0|20000.0] "NewtonMeter" IHU
 SG_ PtTqTotDrgAtWhls_UB : 62|1@0+ (1,0) [0|1] "" IHU
 SG_ SwtTrClsSts : 47|1@0+ (1,0) [0|1] "" IHU
 SG_ SwtTrClsSts_UB : 46|1@0+ (1,0) [0|1] "" IHU
 SG_ ThermFctReq : 40|1@0+ (1,0) [0|1] "" IHU
 SG_ ThermFctReq_UB : 63|1@0+ (1,0) [0|1] "" IHU
 SG_ TrsmCluTEstimdOfClu0 : 15|9@0+ (1.25,-40.0) [-40.0|598.75] "degC" IHU
 SG_ TrsmCluTEstimdOfClu0_UB : 22|1@0+ (1,0) [0|1] "" IHU
 SG_ TrsmErrIndcnReq : 21|1@0+ (1,0) [0|1] "" IHU
 SG_ TrsmErrIndcnReq_UB : 20|1@0+ (1,0) [0|1] "" IHU
 SG_ TrsmHotSt : 92|2@0+ (1,0) [0|3] "" IHU
 SG_ TrsmHotSt_UB : 90|1@0+ (1,0) [0|1] "" IHU
 SG_ TrsmShiftInhb : 45|1@0+ (1,0) [0|1] "" IHU
 SG_ TrsmShiftInhb_UB : 44|1@0+ (1,0) [0|1] "" IHU

BO_ 800 ZCUDZCUCANFD2Fr16 : 64 ZCUD
 SG_ CmprSpdAct : 7|8@0+ (50.0,0.0) [0.0|12700.0] "rpm" IHU,ZCUP
 SG_ CmprSpdAct_UB : 231|1@0+ (1,0) [0|1] "" IHU,ZCUP
 SG_ EngCrashFb : 26|2@0+ (1,0) [0|3] "" IHU
 SG_ EngCrashFb_UB : 232|1@0+ (1,0) [0|1] "" IHU
 SG_ HvCooltHeatrEnadWhE2E_UB : 235|1@0+ (1,0) [0|1] "" IHU,ZCUP
 SG_ HvCooltHeatrEnadWhE2EChks : 23|8@0+ (1.0,0.0) [0.0|255.0] "Unitless" IHU,ZCUP
 SG_ HvCooltHeatrEnadWhE2ECntr : 31|4@0+ (1.0,0.0) [0.0|15.0] "Unitless" IHU,ZCUP
 SG_ HvCooltHeatrEnadWhE2EHvchEnad : 27|1@0+ (1,0) [0|1] "" IHU,ZCUP
 SG_ SafetyCrashFb : 13|2@0+ (1,0) [0|3] "" IHU
 SG_ SafetyCrashFb_UB : 14|1@0+ (1,0) [0|1] "" IHU
 SG_ VFCVectorPCM_UB : 24|1@0+ (1,0) [0|1] "" IHU
 SG_ VFCVectorPCMBlockID : 33|2@0+ (1.0,0.0) [0.0|3.0] "Unitless" IHU
 SG_ VFCVectorPCMVFCid0 : 34|1@0+ (1,0) [0|1] "" IHU
 SG_ VFCVectorPCMVFCid1 : 35|1@0+ (1,0) [0|1] "" IHU
 SG_ VFCVectorPCMVFCid10 : 44|1@0+ (1,0) [0|1] "" IHU
 SG_ VFCVectorPCMVFCid11 : 45|1@0+ (1,0) [0|1] "" IHU
 SG_ VFCVectorPCMVFCid12 : 46|1@0+ (1,0) [0|1] "" IHU
 SG_ VFCVectorPCMVFCid13 : 47|1@0+ (1,0) [0|1] "" IHU
 SG_ VFCVectorPCMVFCid14 : 48|1@0+ (1,0) [0|1] "" IHU
 SG_ VFCVectorPCMVFCid15 : 49|1@0+ (1,0) [0|1] "" IHU
 SG_ VFCVectorPCMVFCid16 : 50|1@0+ (1,0) [0|1] "" IHU
 SG_ VFCVectorPCMVFCid17 : 51|1@0+ (1,0) [0|1] "" IHU
 SG_ VFCVectorPCMVFCid18 : 52|1@0+ (1,0) [0|1] "" IHU
 SG_ VFCVectorPCMVFCid19 : 53|1@0+ (1,0) [0|1] "" IHU
 SG_ VFCVectorPCMVFCid2 : 36|1@0+ (1,0) [0|1] "" IHU
 SG_ VFCVectorPCMVFCid20 : 54|1@0+ (1,0) [0|1] "" IHU
 SG_ VFCVectorPCMVFCid21 : 55|1@0+ (1,0) [0|1] "" IHU
 SG_ VFCVectorPCMVFCid22 : 56|1@0+ (1,0) [0|1] "" IHU
 SG_ VFCVectorPCMVFCid23 : 57|1@0+ (1,0) [0|1] "" IHU
 SG_ VFCVectorPCMVFCid24 : 58|1@0+ (1,0) [0|1] "" IHU
 SG_ VFCVectorPCMVFCid25 : 59|1@0+ (1,0) [0|1] "" IHU
 SG_ VFCVectorPCMVFCid26 : 60|1@0+ (1,0) [0|1] "" IHU
 SG_ VFCVectorPCMVFCid27 : 61|1@0+ (1,0) [0|1] "" IHU
 SG_ VFCVectorPCMVFCid28 : 62|1@0+ (1,0) [0|1] "" IHU
 SG_ VFCVectorPCMVFCid29 : 63|1@0+ (1,0) [0|1] "" IHU
 SG_ VFCVectorPCMVFCid3 : 37|1@0+ (1,0) [0|1] "" IHU
 SG_ VFCVectorPCMVFCid30 : 64|1@0+ (1,0) [0|1] "" IHU
 SG_ VFCVectorPCMVFCid31 : 65|1@0+ (1,0) [0|1] "" IHU
 SG_ VFCVectorPCMVFCid32 : 66|1@0+ (1,0) [0|1] "" IHU
 SG_ VFCVectorPCMVFCid33 : 67|1@0+ (1,0) [0|1] "" IHU
 SG_ VFCVectorPCMVFCid34 : 68|1@0+ (1,0) [0|1] "" IHU
 SG_ VFCVectorPCMVFCid35 : 69|1@0+ (1,0) [0|1] "" IHU
 SG_ VFCVectorPCMVFCid36 : 70|1@0+ (1,0) [0|1] "" IHU
 SG_ VFCVectorPCMVFCid37 : 71|1@0+ (1,0) [0|1] "" IHU
 SG_ VFCVectorPCMVFCid38 : 72|1@0+ (1,0) [0|1] "" IHU
 SG_ VFCVectorPCMVFCid39 : 73|1@0+ (1,0) [0|1] "" IHU
 SG_ VFCVectorPCMVFCid4 : 38|1@0+ (1,0) [0|1] "" IHU
 SG_ VFCVectorPCMVFCid40 : 74|1@0+ (1,0) [0|1] "" IHU
 SG_ VFCVectorPCMVFCid41 : 75|1@0+ (1,0) [0|1] "" IHU
 SG_ VFCVectorPCMVFCid42 : 76|1@0+ (1,0) [0|1] "" IHU
 SG_ VFCVectorPCMVFCid43 : 77|1@0+ (1,0) [0|1] "" IHU
 SG_ VFCVectorPCMVFCid44 : 78|1@0+ (1,0) [0|1] "" IHU
 SG_ VFCVectorPCMVFCid45 : 79|1@0+ (1,0) [0|1] "" IHU
 SG_ VFCVectorPCMVFCid46 : 80|1@0+ (1,0) [0|1] "" IHU
 SG_ VFCVectorPCMVFCid47 : 81|1@0+ (1,0) [0|1] "" IHU
 SG_ VFCVectorPCMVFCid48 : 82|1@0+ (1,0) [0|1] "" IHU
 SG_ VFCVectorPCMVFCid49 : 83|1@0+ (1,0) [0|1] "" IHU
 SG_ VFCVectorPCMVFCid5 : 39|1@0+ (1,0) [0|1] "" IHU
 SG_ VFCVectorPCMVFCid50 : 84|1@0+ (1,0) [0|1] "" IHU
 SG_ VFCVectorPCMVFCid51 : 85|1@0+ (1,0) [0|1] "" IHU
 SG_ VFCVectorPCMVFCid52 : 86|1@0+ (1,0) [0|1] "" IHU
 SG_ VFCVectorPCMVFCid53 : 87|1@0+ (1,0) [0|1] "" IHU
 SG_ VFCVectorPCMVFCid54 : 88|1@0+ (1,0) [0|1] "" IHU
 SG_ VFCVectorPCMVFCid55 : 89|1@0+ (1,0) [0|1] "" IHU
 SG_ VFCVectorPCMVFCid56 : 90|1@0+ (1,0) [0|1] "" IHU
 SG_ VFCVectorPCMVFCid57 : 91|1@0+ (1,0) [0|1] "" IHU
 SG_ VFCVectorPCMVFCid58 : 92|1@0+ (1,0) [0|1] "" IHU
 SG_ VFCVectorPCMVFCid59 : 93|1@0+ (1,0) [0|1] "" IHU
 SG_ VFCVectorPCMVFCid6 : 40|1@0+ (1,0) [0|1] "" IHU
 SG_ VFCVectorPCMVFCid60 : 94|1@0+ (1,0) [0|1] "" IHU
 SG_ VFCVectorPCMVFCid61 : 95|1@0+ (1,0) [0|1] "" IHU
 SG_ VFCVectorPCMVFCid7 : 41|1@0+ (1,0) [0|1] "" IHU
 SG_ VFCVectorPCMVFCid8 : 42|1@0+ (1,0) [0|1] "" IHU
 SG_ VFCVectorPCMVFCid9 : 43|1@0+ (1,0) [0|1] "" IHU
 SG_ VFCVectorPOT_UB : 237|1@0+ (1,0) [0|1] "" IHU
 SG_ VFCVectorPOTBlockID : 97|2@0+ (1.0,0.0) [0.0|3.0] "Unitless" IHU
 SG_ VFCVectorPOTVFCid0 : 98|1@0+ (1,0) [0|1] "" IHU
 SG_ VFCVectorPOTVFCid1 : 99|1@0+ (1,0) [0|1] "" IHU
 SG_ VFCVectorPOTVFCid10 : 108|1@0+ (1,0) [0|1] "" IHU
 SG_ VFCVectorPOTVFCid11 : 109|1@0+ (1,0) [0|1] "" IHU
 SG_ VFCVectorPOTVFCid12 : 110|1@0+ (1,0) [0|1] "" IHU
 SG_ VFCVectorPOTVFCid13 : 111|1@0+ (1,0) [0|1] "" IHU
 SG_ VFCVectorPOTVFCid14 : 112|1@0+ (1,0) [0|1] "" IHU
 SG_ VFCVectorPOTVFCid15 : 113|1@0+ (1,0) [0|1] "" IHU
 SG_ VFCVectorPOTVFCid16 : 114|1@0+ (1,0) [0|1] "" IHU
 SG_ VFCVectorPOTVFCid17 : 115|1@0+ (1,0) [0|1] "" IHU
 SG_ VFCVectorPOTVFCid18 : 116|1@0+ (1,0) [0|1] "" IHU
 SG_ VFCVectorPOTVFCid19 : 117|1@0+ (1,0) [0|1] "" IHU
 SG_ VFCVectorPOTVFCid2 : 100|1@0+ (1,0) [0|1] "" IHU
 SG_ VFCVectorPOTVFCid20 : 118|1@0+ (1,0) [0|1] "" IHU
 SG_ VFCVectorPOTVFCid21 : 119|1@0+ (1,0) [0|1] "" IHU
 SG_ VFCVectorPOTVFCid22 : 120|1@0+ (1,0) [0|1] "" IHU
 SG_ VFCVectorPOTVFCid23 : 121|1@0+ (1,0) [0|1] "" IHU
 SG_ VFCVectorPOTVFCid24 : 122|1@0+ (1,0) [0|1] "" IHU
 SG_ VFCVectorPOTVFCid25 : 123|1@0+ (1,0) [0|1] "" IHU
 SG_ VFCVectorPOTVFCid26 : 124|1@0+ (1,0) [0|1] "" IHU
 SG_ VFCVectorPOTVFCid27 : 125|1@0+ (1,0) [0|1] "" IHU
 SG_ VFCVectorPOTVFCid28 : 126|1@0+ (1,0) [0|1] "" IHU
 SG_ VFCVectorPOTVFCid29 : 127|1@0+ (1,0) [0|1] "" IHU
 SG_ VFCVectorPOTVFCid3 : 101|1@0+ (1,0) [0|1] "" IHU
 SG_ VFCVectorPOTVFCid30 : 128|1@0+ (1,0) [0|1] "" IHU
 SG_ VFCVectorPOTVFCid31 : 129|1@0+ (1,0) [0|1] "" IHU
 SG_ VFCVectorPOTVFCid32 : 130|1@0+ (1,0) [0|1] "" IHU
 SG_ VFCVectorPOTVFCid33 : 131|1@0+ (1,0) [0|1] "" IHU
 SG_ VFCVectorPOTVFCid34 : 132|1@0+ (1,0) [0|1] "" IHU
 SG_ VFCVectorPOTVFCid35 : 133|1@0+ (1,0) [0|1] "" IHU
 SG_ VFCVectorPOTVFCid36 : 134|1@0+ (1,0) [0|1] "" IHU
 SG_ VFCVectorPOTVFCid37 : 135|1@0+ (1,0) [0|1] "" IHU
 SG_ VFCVectorPOTVFCid38 : 136|1@0+ (1,0) [0|1] "" IHU
 SG_ VFCVectorPOTVFCid39 : 137|1@0+ (1,0) [0|1] "" IHU
 SG_ VFCVectorPOTVFCid4 : 102|1@0+ (1,0) [0|1] "" IHU
 SG_ VFCVectorPOTVFCid40 : 138|1@0+ (1,0) [0|1] "" IHU
 SG_ VFCVectorPOTVFCid41 : 139|1@0+ (1,0) [0|1] "" IHU
 SG_ VFCVectorPOTVFCid42 : 140|1@0+ (1,0) [0|1] "" IHU
 SG_ VFCVectorPOTVFCid43 : 141|1@0+ (1,0) [0|1] "" IHU
 SG_ VFCVectorPOTVFCid44 : 142|1@0+ (1,0) [0|1] "" IHU
 SG_ VFCVectorPOTVFCid45 : 143|1@0+ (1,0) [0|1] "" IHU
 SG_ VFCVectorPOTVFCid46 : 144|1@0+ (1,0) [0|1] "" IHU
 SG_ VFCVectorPOTVFCid47 : 145|1@0+ (1,0) [0|1] "" IHU
 SG_ VFCVectorPOTVFCid48 : 146|1@0+ (1,0) [0|1] "" IHU
 SG_ VFCVectorPOTVFCid49 : 147|1@0+ (1,0) [0|1] "" IHU
 SG_ VFCVectorPOTVFCid5 : 103|1@0+ (1,0) [0|1] "" IHU
 SG_ VFCVectorPOTVFCid50 : 148|1@0+ (1,0) [0|1] "" IHU
 SG_ VFCVectorPOTVFCid51 : 149|1@0+ (1,0) [0|1] "" IHU
 SG_ VFCVectorPOTVFCid52 : 150|1@0+ (1,0) [0|1] "" IHU
 SG_ VFCVectorPOTVFCid53 : 151|1@0+ (1,0) [0|1] "" IHU
 SG_ VFCVectorPOTVFCid54 : 152|1@0+ (1,0) [0|1] "" IHU
 SG_ VFCVectorPOTVFCid55 : 153|1@0+ (1,0) [0|1] "" IHU
 SG_ VFCVectorPOTVFCid56 : 154|1@0+ (1,0) [0|1] "" IHU
 SG_ VFCVectorPOTVFCid57 : 155|1@0+ (1,0) [0|1] "" IHU
 SG_ VFCVectorPOTVFCid58 : 156|1@0+ (1,0) [0|1] "" IHU
 SG_ VFCVectorPOTVFCid59 : 157|1@0+ (1,0) [0|1] "" IHU
 SG_ VFCVectorPOTVFCid6 : 104|1@0+ (1,0) [0|1] "" IHU
 SG_ VFCVectorPOTVFCid60 : 158|1@0+ (1,0) [0|1] "" IHU
 SG_ VFCVectorPOTVFCid61 : 159|1@0+ (1,0) [0|1] "" IHU
 SG_ VFCVectorPOTVFCid7 : 105|1@0+ (1,0) [0|1] "" IHU
 SG_ VFCVectorPOTVFCid8 : 106|1@0+ (1,0) [0|1] "" IHU
 SG_ VFCVectorPOTVFCid9 : 107|1@0+ (1,0) [0|1] "" IHU
 SG_ VFCVectorSRS_UB : 238|1@0+ (1,0) [0|1] "" IHU
 SG_ VFCVectorSRSBlockID : 161|2@0+ (1.0,0.0) [0.0|3.0] "Unitless" IHU
 SG_ VFCVectorSRSVFCid0 : 162|1@0+ (1,0) [0|1] "" IHU
 SG_ VFCVectorSRSVFCid1 : 163|1@0+ (1,0) [0|1] "" IHU
 SG_ VFCVectorSRSVFCid10 : 172|1@0+ (1,0) [0|1] "" IHU
 SG_ VFCVectorSRSVFCid11 : 173|1@0+ (1,0) [0|1] "" IHU
 SG_ VFCVectorSRSVFCid12 : 174|1@0+ (1,0) [0|1] "" IHU
 SG_ VFCVectorSRSVFCid13 : 175|1@0+ (1,0) [0|1] "" IHU
 SG_ VFCVectorSRSVFCid14 : 176|1@0+ (1,0) [0|1] "" IHU
 SG_ VFCVectorSRSVFCid15 : 177|1@0+ (1,0) [0|1] "" IHU
 SG_ VFCVectorSRSVFCid16 : 178|1@0+ (1,0) [0|1] "" IHU
 SG_ VFCVectorSRSVFCid17 : 179|1@0+ (1,0) [0|1] "" IHU
 SG_ VFCVectorSRSVFCid18 : 180|1@0+ (1,0) [0|1] "" IHU
 SG_ VFCVectorSRSVFCid19 : 181|1@0+ (1,0) [0|1] "" IHU
 SG_ VFCVectorSRSVFCid2 : 164|1@0+ (1,0) [0|1] "" IHU
 SG_ VFCVectorSRSVFCid20 : 182|1@0+ (1,0) [0|1] "" IHU
 SG_ VFCVectorSRSVFCid21 : 183|1@0+ (1,0) [0|1] "" IHU
 SG_ VFCVectorSRSVFCid22 : 184|1@0+ (1,0) [0|1] "" IHU
 SG_ VFCVectorSRSVFCid23 : 185|1@0+ (1,0) [0|1] "" IHU
 SG_ VFCVectorSRSVFCid24 : 186|1@0+ (1,0) [0|1] "" IHU
 SG_ VFCVectorSRSVFCid25 : 187|1@0+ (1,0) [0|1] "" IHU
 SG_ VFCVectorSRSVFCid26 : 188|1@0+ (1,0) [0|1] "" IHU
 SG_ VFCVectorSRSVFCid27 : 189|1@0+ (1,0) [0|1] "" IHU
 SG_ VFCVectorSRSVFCid28 : 190|1@0+ (1,0) [0|1] "" IHU
 SG_ VFCVectorSRSVFCid29 : 191|1@0+ (1,0) [0|1] "" IHU
 SG_ VFCVectorSRSVFCid3 : 165|1@0+ (1,0) [0|1] "" IHU
 SG_ VFCVectorSRSVFCid30 : 192|1@0+ (1,0) [0|1] "" IHU
 SG_ VFCVectorSRSVFCid31 : 193|1@0+ (1,0) [0|1] "" IHU
 SG_ VFCVectorSRSVFCid32 : 194|1@0+ (1,0) [0|1] "" IHU
 SG_ VFCVectorSRSVFCid33 : 195|1@0+ (1,0) [0|1] "" IHU
 SG_ VFCVectorSRSVFCid34 : 196|1@0+ (1,0) [0|1] "" IHU
 SG_ VFCVectorSRSVFCid35 : 197|1@0+ (1,0) [0|1] "" IHU
 SG_ VFCVectorSRSVFCid36 : 198|1@0+ (1,0) [0|1] "" IHU
 SG_ VFCVectorSRSVFCid37 : 199|1@0+ (1,0) [0|1] "" IHU
 SG_ VFCVectorSRSVFCid38 : 200|1@0+ (1,0) [0|1] "" IHU
 SG_ VFCVectorSRSVFCid39 : 201|1@0+ (1,0) [0|1] "" IHU
 SG_ VFCVectorSRSVFCid4 : 166|1@0+ (1,0) [0|1] "" IHU
 SG_ VFCVectorSRSVFCid40 : 202|1@0+ (1,0) [0|1] "" IHU
 SG_ VFCVectorSRSVFCid41 : 203|1@0+ (1,0) [0|1] "" IHU
 SG_ VFCVectorSRSVFCid42 : 204|1@0+ (1,0) [0|1] "" IHU
 SG_ VFCVectorSRSVFCid43 : 205|1@0+ (1,0) [0|1] "" IHU
 SG_ VFCVectorSRSVFCid44 : 206|1@0+ (1,0) [0|1] "" IHU
 SG_ VFCVectorSRSVFCid45 : 207|1@0+ (1,0) [0|1] "" IHU
 SG_ VFCVectorSRSVFCid46 : 208|1@0+ (1,0) [0|1] "" IHU
 SG_ VFCVectorSRSVFCid47 : 209|1@0+ (1,0) [0|1] "" IHU
 SG_ VFCVectorSRSVFCid48 : 210|1@0+ (1,0) [0|1] "" IHU
 SG_ VFCVectorSRSVFCid49 : 211|1@0+ (1,0) [0|1] "" IHU
 SG_ VFCVectorSRSVFCid5 : 167|1@0+ (1,0) [0|1] "" IHU
 SG_ VFCVectorSRSVFCid50 : 212|1@0+ (1,0) [0|1] "" IHU
 SG_ VFCVectorSRSVFCid51 : 213|1@0+ (1,0) [0|1] "" IHU
 SG_ VFCVectorSRSVFCid52 : 214|1@0+ (1,0) [0|1] "" IHU
 SG_ VFCVectorSRSVFCid53 : 215|1@0+ (1,0) [0|1] "" IHU
 SG_ VFCVectorSRSVFCid54 : 216|1@0+ (1,0) [0|1] "" IHU
 SG_ VFCVectorSRSVFCid55 : 217|1@0+ (1,0) [0|1] "" IHU
 SG_ VFCVectorSRSVFCid56 : 218|1@0+ (1,0) [0|1] "" IHU
 SG_ VFCVectorSRSVFCid57 : 219|1@0+ (1,0) [0|1] "" IHU
 SG_ VFCVectorSRSVFCid58 : 220|1@0+ (1,0) [0|1] "" IHU
 SG_ VFCVectorSRSVFCid59 : 221|1@0+ (1,0) [0|1] "" IHU
 SG_ VFCVectorSRSVFCid6 : 168|1@0+ (1,0) [0|1] "" IHU
 SG_ VFCVectorSRSVFCid60 : 222|1@0+ (1,0) [0|1] "" IHU
 SG_ VFCVectorSRSVFCid61 : 223|1@0+ (1,0) [0|1] "" IHU
 SG_ VFCVectorSRSVFCid7 : 169|1@0+ (1,0) [0|1] "" IHU
 SG_ VFCVectorSRSVFCid8 : 170|1@0+ (1,0) [0|1] "" IHU
 SG_ VFCVectorSRSVFCid9 : 171|1@0+ (1,0) [0|1] "" IHU
 SG_ VFCVectorSUM_UB : 15|1@0+ (1,0) [0|1] "" Vector__XXX
 SG_ VFCVectorSUMBlockID : 305|2@0+ (1.0,0.0) [0.0|3.0] "Unitless" Vector__XXX
 SG_ VFCVectorSUMVFCid0 : 306|1@0+ (1,0) [0|1] "" Vector__XXX
 SG_ VFCVectorSUMVFCid1 : 307|1@0+ (1,0) [0|1] "" Vector__XXX
 SG_ VFCVectorSUMVFCid10 : 316|1@0+ (1,0) [0|1] "" Vector__XXX
 SG_ VFCVectorSUMVFCid11 : 317|1@0+ (1,0) [0|1] "" Vector__XXX
 SG_ VFCVectorSUMVFCid12 : 318|1@0+ (1,0) [0|1] "" Vector__XXX
 SG_ VFCVectorSUMVFCid13 : 319|1@0+ (1,0) [0|1] "" Vector__XXX
 SG_ VFCVectorSUMVFCid14 : 320|1@0+ (1,0) [0|1] "" Vector__XXX
 SG_ VFCVectorSUMVFCid15 : 321|1@0+ (1,0) [0|1] "" Vector__XXX
 SG_ VFCVectorSUMVFCid16 : 322|1@0+ (1,0) [0|1] "" Vector__XXX
 SG_ VFCVectorSUMVFCid17 : 323|1@0+ (1,0) [0|1] "" Vector__XXX
 SG_ VFCVectorSUMVFCid18 : 324|1@0+ (1,0) [0|1] "" Vector__XXX
 SG_ VFCVectorSUMVFCid19 : 325|1@0+ (1,0) [0|1] "" Vector__XXX
 SG_ VFCVectorSUMVFCid2 : 308|1@0+ (1,0) [0|1] "" Vector__XXX
 SG_ VFCVectorSUMVFCid20 : 326|1@0+ (1,0) [0|1] "" Vector__XXX
 SG_ VFCVectorSUMVFCid21 : 327|1@0+ (1,0) [0|1] "" Vector__XXX
 SG_ VFCVectorSUMVFCid22 : 328|1@0+ (1,0) [0|1] "" Vector__XXX
 SG_ VFCVectorSUMVFCid23 : 329|1@0+ (1,0) [0|1] "" Vector__XXX
 SG_ VFCVectorSUMVFCid24 : 330|1@0+ (1,0) [0|1] "" Vector__XXX
 SG_ VFCVectorSUMVFCid25 : 331|1@0+ (1,0) [0|1] "" Vector__XXX
 SG_ VFCVectorSUMVFCid26 : 332|1@0+ (1,0) [0|1] "" Vector__XXX
 SG_ VFCVectorSUMVFCid27 : 333|1@0+ (1,0) [0|1] "" Vector__XXX
 SG_ VFCVectorSUMVFCid28 : 334|1@0+ (1,0) [0|1] "" Vector__XXX
 SG_ VFCVectorSUMVFCid29 : 335|1@0+ (1,0) [0|1] "" Vector__XXX
 SG_ VFCVectorSUMVFCid3 : 309|1@0+ (1,0) [0|1] "" Vector__XXX
 SG_ VFCVectorSUMVFCid30 : 336|1@0+ (1,0) [0|1] "" Vector__XXX
 SG_ VFCVectorSUMVFCid31 : 337|1@0+ (1,0) [0|1] "" Vector__XXX
 SG_ VFCVectorSUMVFCid32 : 338|1@0+ (1,0) [0|1] "" Vector__XXX
 SG_ VFCVectorSUMVFCid33 : 339|1@0+ (1,0) [0|1] "" Vector__XXX
 SG_ VFCVectorSUMVFCid34 : 340|1@0+ (1,0) [0|1] "" Vector__XXX
 SG_ VFCVectorSUMVFCid35 : 341|1@0+ (1,0) [0|1] "" Vector__XXX
 SG_ VFCVectorSUMVFCid36 : 342|1@0+ (1,0) [0|1] "" Vector__XXX
 SG_ VFCVectorSUMVFCid37 : 343|1@0+ (1,0) [0|1] "" Vector__XXX
 SG_ VFCVectorSUMVFCid38 : 344|1@0+ (1,0) [0|1] "" Vector__XXX
 SG_ VFCVectorSUMVFCid39 : 345|1@0+ (1,0) [0|1] "" Vector__XXX
 SG_ VFCVectorSUMVFCid4 : 310|1@0+ (1,0) [0|1] "" Vector__XXX
 SG_ VFCVectorSUMVFCid40 : 346|1@0+ (1,0) [0|1] "" Vector__XXX
 SG_ VFCVectorSUMVFCid41 : 347|1@0+ (1,0) [0|1] "" Vector__XXX
 SG_ VFCVectorSUMVFCid42 : 348|1@0+ (1,0) [0|1] "" Vector__XXX
 SG_ VFCVectorSUMVFCid43 : 349|1@0+ (1,0) [0|1] "" Vector__XXX
 SG_ VFCVectorSUMVFCid44 : 350|1@0+ (1,0) [0|1] "" Vector__XXX
 SG_ VFCVectorSUMVFCid45 : 351|1@0+ (1,0) [0|1] "" Vector__XXX
 SG_ VFCVectorSUMVFCid46 : 352|1@0+ (1,0) [0|1] "" Vector__XXX
 SG_ VFCVectorSUMVFCid47 : 353|1@0+ (1,0) [0|1] "" Vector__XXX
 SG_ VFCVectorSUMVFCid48 : 354|1@0+ (1,0) [0|1] "" Vector__XXX
 SG_ VFCVectorSUMVFCid49 : 355|1@0+ (1,0) [0|1] "" Vector__XXX
 SG_ VFCVectorSUMVFCid5 : 311|1@0+ (1,0) [0|1] "" Vector__XXX
 SG_ VFCVectorSUMVFCid50 : 356|1@0+ (1,0) [0|1] "" Vector__XXX
 SG_ VFCVectorSUMVFCid51 : 357|1@0+ (1,0) [0|1] "" Vector__XXX
 SG_ VFCVectorSUMVFCid52 : 358|1@0+ (1,0) [0|1] "" Vector__XXX
 SG_ VFCVectorSUMVFCid53 : 359|1@0+ (1,0) [0|1] "" Vector__XXX
 SG_ VFCVectorSUMVFCid54 : 360|1@0+ (1,0) [0|1] "" Vector__XXX
 SG_ VFCVectorSUMVFCid55 : 361|1@0+ (1,0) [0|1] "" Vector__XXX
 SG_ VFCVectorSUMVFCid56 : 362|1@0+ (1,0) [0|1] "" Vector__XXX
 SG_ VFCVectorSUMVFCid57 : 363|1@0+ (1,0) [0|1] "" Vector__XXX
 SG_ VFCVectorSUMVFCid58 : 364|1@0+ (1,0) [0|1] "" Vector__XXX
 SG_ VFCVectorSUMVFCid59 : 365|1@0+ (1,0) [0|1] "" Vector__XXX
 SG_ VFCVectorSUMVFCid6 : 312|1@0+ (1,0) [0|1] "" Vector__XXX
 SG_ VFCVectorSUMVFCid60 : 366|1@0+ (1,0) [0|1] "" Vector__XXX
 SG_ VFCVectorSUMVFCid61 : 367|1@0+ (1,0) [0|1] "" Vector__XXX
 SG_ VFCVectorSUMVFCid7 : 313|1@0+ (1,0) [0|1] "" Vector__XXX
 SG_ VFCVectorSUMVFCid8 : 314|1@0+ (1,0) [0|1] "" Vector__XXX
 SG_ VFCVectorSUMVFCid9 : 315|1@0+ (1,0) [0|1] "" Vector__XXX
 SG_ VFCVectorZCUDS_UB : 239|1@0+ (1,0) [0|1] "" IHU
 SG_ VFCVectorZCUDSBlockID : 241|2@0+ (1.0,0.0) [0.0|3.0] "Unitless" IHU
 SG_ VFCVectorZCUDSVFCid0 : 242|1@0+ (1,0) [0|1] "" IHU
 SG_ VFCVectorZCUDSVFCid1 : 243|1@0+ (1,0) [0|1] "" IHU
 SG_ VFCVectorZCUDSVFCid10 : 252|1@0+ (1,0) [0|1] "" IHU
 SG_ VFCVectorZCUDSVFCid11 : 253|1@0+ (1,0) [0|1] "" IHU
 SG_ VFCVectorZCUDSVFCid12 : 254|1@0+ (1,0) [0|1] "" IHU
 SG_ VFCVectorZCUDSVFCid13 : 255|1@0+ (1,0) [0|1] "" IHU
 SG_ VFCVectorZCUDSVFCid14 : 256|1@0+ (1,0) [0|1] "" IHU
 SG_ VFCVectorZCUDSVFCid15 : 257|1@0+ (1,0) [0|1] "" IHU
 SG_ VFCVectorZCUDSVFCid16 : 258|1@0+ (1,0) [0|1] "" IHU
 SG_ VFCVectorZCUDSVFCid17 : 259|1@0+ (1,0) [0|1] "" IHU
 SG_ VFCVectorZCUDSVFCid18 : 260|1@0+ (1,0) [0|1] "" IHU
 SG_ VFCVectorZCUDSVFCid19 : 261|1@0+ (1,0) [0|1] "" IHU
 SG_ VFCVectorZCUDSVFCid2 : 244|1@0+ (1,0) [0|1] "" IHU
 SG_ VFCVectorZCUDSVFCid20 : 262|1@0+ (1,0) [0|1] "" IHU
 SG_ VFCVectorZCUDSVFCid21 : 263|1@0+ (1,0) [0|1] "" IHU
 SG_ VFCVectorZCUDSVFCid22 : 264|1@0+ (1,0) [0|1] "" IHU
 SG_ VFCVectorZCUDSVFCid23 : 265|1@0+ (1,0) [0|1] "" IHU
 SG_ VFCVectorZCUDSVFCid24 : 266|1@0+ (1,0) [0|1] "" IHU
 SG_ VFCVectorZCUDSVFCid25 : 267|1@0+ (1,0) [0|1] "" IHU
 SG_ VFCVectorZCUDSVFCid26 : 268|1@0+ (1,0) [0|1] "" IHU
 SG_ VFCVectorZCUDSVFCid27 : 269|1@0+ (1,0) [0|1] "" IHU
 SG_ VFCVectorZCUDSVFCid28 : 270|1@0+ (1,0) [0|1] "" IHU
 SG_ VFCVectorZCUDSVFCid29 : 271|1@0+ (1,0) [0|1] "" IHU
 SG_ VFCVectorZCUDSVFCid3 : 245|1@0+ (1,0) [0|1] "" IHU
 SG_ VFCVectorZCUDSVFCid30 : 272|1@0+ (1,0) [0|1] "" IHU
 SG_ VFCVectorZCUDSVFCid31 : 273|1@0+ (1,0) [0|1] "" IHU
 SG_ VFCVectorZCUDSVFCid32 : 274|1@0+ (1,0) [0|1] "" IHU
 SG_ VFCVectorZCUDSVFCid33 : 275|1@0+ (1,0) [0|1] "" IHU
 SG_ VFCVectorZCUDSVFCid34 : 276|1@0+ (1,0) [0|1] "" IHU
 SG_ VFCVectorZCUDSVFCid35 : 277|1@0+ (1,0) [0|1] "" IHU
 SG_ VFCVectorZCUDSVFCid36 : 278|1@0+ (1,0) [0|1] "" IHU
 SG_ VFCVectorZCUDSVFCid37 : 279|1@0+ (1,0) [0|1] "" IHU
 SG_ VFCVectorZCUDSVFCid38 : 280|1@0+ (1,0) [0|1] "" IHU
 SG_ VFCVectorZCUDSVFCid39 : 281|1@0+ (1,0) [0|1] "" IHU
 SG_ VFCVectorZCUDSVFCid4 : 246|1@0+ (1,0) [0|1] "" IHU
 SG_ VFCVectorZCUDSVFCid40 : 282|1@0+ (1,0) [0|1] "" IHU
 SG_ VFCVectorZCUDSVFCid41 : 283|1@0+ (1,0) [0|1] "" IHU
 SG_ VFCVectorZCUDSVFCid42 : 284|1@0+ (1,0) [0|1] "" IHU
 SG_ VFCVectorZCUDSVFCid43 : 285|1@0+ (1,0) [0|1] "" IHU
 SG_ VFCVectorZCUDSVFCid44 : 286|1@0+ (1,0) [0|1] "" IHU
 SG_ VFCVectorZCUDSVFCid45 : 287|1@0+ (1,0) [0|1] "" IHU
 SG_ VFCVectorZCUDSVFCid46 : 288|1@0+ (1,0) [0|1] "" IHU
 SG_ VFCVectorZCUDSVFCid47 : 289|1@0+ (1,0) [0|1] "" IHU
 SG_ VFCVectorZCUDSVFCid48 : 290|1@0+ (1,0) [0|1] "" IHU
 SG_ VFCVectorZCUDSVFCid49 : 291|1@0+ (1,0) [0|1] "" IHU
 SG_ VFCVectorZCUDSVFCid5 : 247|1@0+ (1,0) [0|1] "" IHU
 SG_ VFCVectorZCUDSVFCid50 : 292|1@0+ (1,0) [0|1] "" IHU
 SG_ VFCVectorZCUDSVFCid51 : 293|1@0+ (1,0) [0|1] "" IHU
 SG_ VFCVectorZCUDSVFCid52 : 294|1@0+ (1,0) [0|1] "" IHU
 SG_ VFCVectorZCUDSVFCid53 : 295|1@0+ (1,0) [0|1] "" IHU
 SG_ VFCVectorZCUDSVFCid54 : 296|1@0+ (1,0) [0|1] "" IHU
 SG_ VFCVectorZCUDSVFCid55 : 297|1@0+ (1,0) [0|1] "" IHU
 SG_ VFCVectorZCUDSVFCid56 : 298|1@0+ (1,0) [0|1] "" IHU
 SG_ VFCVectorZCUDSVFCid57 : 299|1@0+ (1,0) [0|1] "" IHU
 SG_ VFCVectorZCUDSVFCid58 : 300|1@0+ (1,0) [0|1] "" IHU
 SG_ VFCVectorZCUDSVFCid59 : 301|1@0+ (1,0) [0|1] "" IHU
 SG_ VFCVectorZCUDSVFCid6 : 248|1@0+ (1,0) [0|1] "" IHU
 SG_ VFCVectorZCUDSVFCid60 : 302|1@0+ (1,0) [0|1] "" IHU
 SG_ VFCVectorZCUDSVFCid61 : 303|1@0+ (1,0) [0|1] "" IHU
 SG_ VFCVectorZCUDSVFCid7 : 249|1@0+ (1,0) [0|1] "" IHU
 SG_ VFCVectorZCUDSVFCid8 : 250|1@0+ (1,0) [0|1] "" IHU
 SG_ VFCVectorZCUDSVFCid9 : 251|1@0+ (1,0) [0|1] "" IHU

BO_ 264 ZCUDZCUCANFD2Fr17 : 64 ZCUD
 SG_ ChdPrtnLeftSwReq : 151|1@0+ (1,0) [0|1] "" IHU
 SG_ ChdPrtnLeftSwReq_UB : 150|1@0+ (1,0) [0|1] "" IHU
 SG_ ChdPrtnRightSwReq : 149|1@0+ (1,0) [0|1] "" IHU
 SG_ ChdPrtnRightSwReq_UB : 148|1@0+ (1,0) [0|1] "" IHU
 SG_ DispBattEgyIn : 39|8@0+ (0.5,0.0) [0.0|127.5] "Wh" IHU
 SG_ DispBattEgyIn_UB : 55|1@0+ (1,0) [0|1] "" IHU
 SG_ DispBattEgyOut : 47|8@0+ (0.5,0.0) [0.0|127.5] "Wh" IHU
 SG_ DispBattEgyOut_UB : 54|1@0+ (1,0) [0|1] "" IHU
 SG_ DrvrSeatSnsrSts : 79|2@0+ (1,0) [0|3] "" IHU,ZCUP
 SG_ DrvrSeatSnsrSts_UB : 77|1@0+ (1,0) [0|1] "" IHU,ZCUP
 SG_ EngSpdDispd : 7|15@0+ (0.5,0.0) [0.0|16383.5] "rpm" IHU
 SG_ EngSpdDispd_UB : 8|1@0+ (1,0) [0|1] "" IHU
 SG_ EngSpdMaxDispd : 23|15@0+ (0.5,0.0) [0.0|16383.5] "rpm" IHU
 SG_ EngSpdMaxDispd_UB : 24|1@0+ (1,0) [0|1] "" IHU
 SG_ FrntSeatCmftCtrlReSeatLe : 76|2@0+ (1,0) [0|3] "" ZCUP
 SG_ FrntSeatCmftCtrlReSeatLe_UB : 74|1@0+ (1,0) [0|1] "" ZCUP
 SG_ FrntSeatCmftCtrlReSeatRi : 73|2@0+ (1,0) [0|3] "" ZCUP
 SG_ FrntSeatCmftCtrlReSeatRi_UB : 87|1@0+ (1,0) [0|1] "" ZCUP
 SG_ RowSecLeMassgRunng : 71|1@0+ (1,0) [0|1] "" IHU
 SG_ RowSecLeMassgRunng_UB : 70|1@0+ (1,0) [0|1] "" IHU
 SG_ RowSecLeSeatActvSpplFct : 59|3@0+ (1,0) [0|7] "" IHU
 SG_ RowSecLeSeatActvSpplFct_UB : 56|1@0+ (1,0) [0|1] "" IHU
 SG_ RowSecRiMassgRunng : 65|1@0+ (1,0) [0|1] "" IHU
 SG_ RowSecRiMassgRunng_UB : 64|1@0+ (1,0) [0|1] "" IHU
 SG_ RowSecRiSeatActvSpplFct : 69|3@0+ (1,0) [0|7] "" IHU
 SG_ RowSecRiSeatActvSpplFct_UB : 66|1@0+ (1,0) [0|1] "" IHU
 SG_ TCSCmprStrtFlt : 63|1@0+ (1,0) [0|1] "" Vector__XXX
 SG_ TCSCmprStrtFlt_UB : 48|1@0+ (1,0) [0|1] "" Vector__XXX
 SG_ TCSFltSts : 53|4@0+ (1.0,0.0) [0.0|15.0] "Unitless" Vector__XXX
 SG_ TCSFltSts_UB : 49|1@0+ (1,0) [0|1] "" Vector__XXX
 SG_ TCSModSwtSts : 62|2@0+ (1,0) [0|3] "" Vector__XXX
 SG_ TCSModSwtSts_UB : 60|1@0+ (1,0) [0|1] "" Vector__XXX

BO_ 67 ZCUDZCUCANFD2Fr18 : 64 ZCUD
 SG_ BookTrvlFltSts : 7|1@0+ (1,0) [0|1] "" IHU
 SG_ BookTrvlFltSts_UB : 6|1@0+ (1,0) [0|1] "" IHU
 SG_ BookTrvlSetResponse : 5|2@0+ (1,0) [0|3] "" IHU
 SG_ BookTrvlSetResponse_UB : 3|1@0+ (1,0) [0|1] "" IHU
 SG_ BookTrvlTiSetReq_UB : 19|1@0+ (1,0) [0|1] "" IHU
 SG_ BookTrvlTiSetReqBookTrvlChrgnTi : 15|11@0+ (1.0,0.0) [0.0|2047.0] "Mins" IHU
 SG_ BookTrvlTiSetReqBookTrvlTiSetReq : 20|1@0+ (1,0) [0|1] "" IHU
 SG_ CrashSts2 : 1|2@0+ (1,0) [0|3] "" IHU
 SG_ CrashSts2_UB : 2|1@0+ (1,0) [0|1] "" IHU
 SG_ DchaStopByTarDrvrIndcn : 18|1@0+ (1,0) [0|1] "" IHU
 SG_ DchaStopByTarDrvrIndcn_UB : 17|1@0+ (1,0) [0|1] "" IHU
 SG_ PrpsnDataEvtA_UB : 359|1@0+ (1,0) [0|1] "" Vector__XXX
 SG_ PrpsnDataEvtACnt : 358|7@0+ (1.0,0.0) [0.0|127.0] "Unitless" Vector__XXX
 SG_ PrpsnDataEvtAData1 : 367|8@0+ (1.0,0.0) [0.0|255.0] "Unitless" Vector__XXX
 SG_ PrpsnDataEvtAData2 : 375|8@0+ (1.0,0.0) [0.0|255.0] "Unitless" Vector__XXX
 SG_ PrpsnDataEvtAData3 : 383|8@0+ (1.0,0.0) [0.0|255.0] "Unitless" Vector__XXX
 SG_ PrpsnDataEvtAData4 : 391|8@0+ (1.0,0.0) [0.0|255.0] "Unitless" Vector__XXX
 SG_ PrpsnDataEvtAData5 : 399|8@0+ (1.0,0.0) [0.0|255.0] "Unitless" Vector__XXX
 SG_ PrpsnDataEvtAData6 : 407|8@0+ (1.0,0.0) [0.0|255.0] "Unitless" Vector__XXX
 SG_ PrpsnDataEvtAID : 415|8@0+ (1.0,0.0) [0.0|255.0] "Unitless" Vector__XXX
 SG_ PrpsnDataEvtB_UB : 423|1@0+ (1,0) [0|1] "" Vector__XXX
 SG_ PrpsnDataEvtBCnt : 422|7@0+ (1.0,0.0) [0.0|127.0] "Unitless" Vector__XXX
 SG_ PrpsnDataEvtBData1 : 431|8@0+ (1.0,0.0) [0.0|255.0] "Unitless" Vector__XXX
 SG_ PrpsnDataEvtBData2 : 439|8@0+ (1.0,0.0) [0.0|255.0] "Unitless" Vector__XXX
 SG_ PrpsnDataEvtBData3 : 447|8@0+ (1.0,0.0) [0.0|255.0] "Unitless" Vector__XXX
 SG_ PrpsnDataEvtBData4 : 455|8@0+ (1.0,0.0) [0.0|255.0] "Unitless" Vector__XXX
 SG_ PrpsnDataEvtBData5 : 463|8@0+ (1.0,0.0) [0.0|255.0] "Unitless" Vector__XXX
 SG_ PrpsnDataEvtBData6 : 471|8@0+ (1.0,0.0) [0.0|255.0] "Unitless" Vector__XXX
 SG_ PrpsnDataEvtBID : 479|8@0+ (1.0,0.0) [0.0|255.0] "Unitless" Vector__XXX

CM_ SG_ 565 BrkSysWarnIndcnReqSec "Secondary brake system warning indication request";
CM_ SG_ 565 CarLoctrActvnSts "Notification to telematics if the Car locator activation has failed. System1 for Exterior light AND System2 for Sound and signaling.";
CM_ SG_ 565 CcvmStsVlvBlkFlt "Valve blocked error.";
CM_ SG_ 565 CcvmStsVlvCalibSts "Valve calibration status.";
CM_ SG_ 565 CcvmStsVlvCmdPosnErr "Valve position command is not plausible.";
CM_ SG_ 565 CcvmStsVlvLoTErr "Valve lower-temp error.";
CM_ SG_ 565 CcvmStsVlvMoveSts "Valve move status.";
CM_ SG_ 565 CcvmStsVlvNVMFlt "Valve position memory is lost.";
CM_ SG_ 565 CcvmStsVlvOpenCircFlt "Valve open circuit fault.";
CM_ SG_ 565 CcvmStsVlvOverTErr "Valve over-temp error.";
CM_ SG_ 565 CcvmStsVlvOverTrvlFlt "Valve over-temp warning.";
CM_ SG_ 565 CcvmStsVlvOverTWarn "Valve over-travel error.";
CM_ SG_ 565 CcvmStsVlvOverUErr "Valve error due to the voltage over the maximum.";
CM_ SG_ 565 CcvmStsVlvPosn "Valve actual position.";
CM_ SG_ 565 CcvmStsVlvPosnCtrlTimeOutFlt "Valve position control is time out.";
CM_ SG_ 565 CcvmStsVlvPosnUkwnFlt "Valve position unkown fault.";
CM_ SG_ 565 CcvmStsVlvPreHeatgSts "Valve preheated status";
CM_ SG_ 565 CcvmStsVlvSelfLearnFlt "Valve self-learning fault.";
CM_ SG_ 565 CcvmStsVlvShoCircFlt "Valve short circuit fault.";
CM_ SG_ 565 CcvmStsVlvSpdLvlSts "Valve speed level status.";
CM_ SG_ 565 CcvmStsVlvUnderUErr "Valve error due to the voltage under the minimum";
CM_ SG_ 565 CcvVlvSts2PosSts "Valve Position Feedback";
CM_ SG_ 565 CcvVlvStsARC "Valves Alive Rolling Counter";
CM_ SG_ 565 CcvVlvStsIntFlt "Valve Internal Fualt Present";
CM_ SG_ 565 CcvVlvStsOprFlt "Valve Operational Fault Present";
CM_ SG_ 565 CcvVlvStsTrqSts "Valve Torque Feedback";
CM_ SG_ 565 ChdLockRightFailStsToHmi "Signal sent from the Driver door module to the Driver information module to inform if there is a failure in the electric child lock funtionality for right rear door";
CM_ SG_ 565 ChdPrtnLeftFailStsToHmi "Signal sent from the Driver door module to the Driver information module to inform if there is a failure in the electric child lock funtionality";
CM_ SG_ 565 ChrgnSpd "Charging speed indication to driver in kph.";
CM_ SG_ 565 ClimaCmd "Indicates whether the climate sub-system is allowed by CELC to start a requested operation.";
CM_ SG_ 565 CmprFbCmprI "Compressor current";
CM_ SG_ 565 CmprFbCmprIPha "Compressor phase current";
CM_ SG_ 565 CmprFbCmprSpd "Compressor rotational speed";
CM_ SG_ 565 CmprFbCmprSts1 "Compressor status";
CM_ SG_ 565 CmprFbCmprSts2 "Compressor status";
CM_ SG_ 565 CmprFbCmprT1 "Compressor IGBT temperature";
CM_ SG_ 565 CmprFbCmprT2 "Compressor capacitor/IGBT temperature";
CM_ SG_ 565 CmprFbCmprU "Compressor high voltage";
CM_ SG_ 565 CrashUnlckFailrSts "CrashUnlckFailrStsToHmi - Crash unlock failure status to HMI
When a fault is detected, that may lead to that the vehicle side doors are not correctly unlocked at impact, the driver shall be warned via HMI. The warning shall be shown when this signal is equal to OnOffSafeOn.";
CM_ SG_ 565 DrvrSeatHeatgAutoSts "Automatic status feedback signal for seats heating of first row left.";
CM_ SG_ 565 DrvrSeatVentnAutoSts "Automatic status feedback signal for seats ventilation of first row left.";
CM_ SG_ 565 Edcp2PmpStsCooltPmpDryErr "water pump MT Dryrun error";
CM_ SG_ 565 Edcp2PmpStsCooltPmpEmgyModSts "water pump MT, Status Emergency mode";
CM_ SG_ 565 Edcp2PmpStsCooltPmpErrSts "water pump error status";
CM_ SG_ 565 Edcp2PmpStsCooltPmpI "Actual current consumption";
CM_ SG_ 565 Edcp2PmpStsCooltPmpIErr "water pump MT current error";
CM_ SG_ 565 Edcp2PmpStsCooltPmpMonrSpd "water pump MT, RPM Monitoring";
CM_ SG_ 565 Edcp2PmpStsCooltPmpPostRunSts "water pump post run status";
CM_ SG_ 565 Edcp2PmpStsCooltPmpSetPostRunReq "water pump set post run speed request";
CM_ SG_ 565 Edcp2PmpStsCooltPmpSetSpdReq "water pump MT Set speed";
CM_ SG_ 565 Edcp2PmpStsCooltPmpSpd "Actual speed from coolant pump";
CM_ SG_ 565 Edcp2PmpStsCooltPmpT "water pump MT Temperature";
CM_ SG_ 565 Edcp2PmpStsCooltPmpTErr "water pump MT temperature error";
CM_ SG_ 565 Edcp2PmpStsCooltPmpU "water pump MT Voltage";
CM_ SG_ 565 Edcp2PmpStsCooltPmpUErr "water pump MT voltage error";
CM_ SG_ 565 Edcp2PmpStsCooltPmpUnstallSts "water pump MT, Deblocking";
CM_ SG_ 565 EngForbidRespFromVMM "response for Telematic that VMM had received EngForbidReq and stored in NVM";
CM_ SG_ 565 EpbApplyEnaSec "EPB software apply button enable.";
CM_ SG_ 565 EpbRelsEnaSec "EPB software release button enable.";
CM_ SG_ 565 ErsCmdByKey "Signaling Engine Remote Start commands from the keyfob.

- ErsCmdNotSet: No ERS command active
- ErsCmdOn: Keyfob command to start ERS
- ErsCmdOff: Keyfob command to stop ERS";
CM_ SG_ 565 HctvStsVlvBlkFlt "Valve blocked error.";
CM_ SG_ 565 HctvStsVlvCalibSts "Valve calibration status.";
CM_ SG_ 565 HctvStsVlvCmdPosnErr "Valve position command is not plausible";
CM_ SG_ 565 HctvStsVlvLoTErr "Valve lower-temp error";
CM_ SG_ 565 HctvStsVlvMoveSts "Valve move status";
CM_ SG_ 565 HctvStsVlvNVMFlt "Valve position memory is lost.";
CM_ SG_ 565 HctvStsVlvOpenCircFlt "Valve open circuit fault.";
CM_ SG_ 565 HctvStsVlvOverTErr "Valve over-temp error.";
CM_ SG_ 565 HctvStsVlvOverTrvlFlt "Valve over-temp warning.";
CM_ SG_ 565 HctvStsVlvOverTWarn "Valve over-travel error.";
CM_ SG_ 565 HctvStsVlvOverUErr "Valve error due to the voltage over the maximum.";
CM_ SG_ 565 HctvStsVlvPosn "Valve actual position.";
CM_ SG_ 565 HctvStsVlvPosnCtrlTimeOutFlt "Valve position control is time out.";
CM_ SG_ 565 HctvStsVlvPosnUkwnFlt "Valve position unkown fault.";
CM_ SG_ 565 HctvStsVlvPreHeatgSts "Valve preheated status";
CM_ SG_ 565 HctvStsVlvSelfLearnFlt "Valve self-learning fault.";
CM_ SG_ 565 HctvStsVlvShoCircFlt "Valve short circuit fault.";
CM_ SG_ 565 HctvStsVlvSpdLvlSts "Valve speed level status.";
CM_ SG_ 565 HctvStsVlvUnderUErr "Valve error due to the voltage under the minimum";
CM_ SG_ 565 HmiDefrstrElecStsFrnt "Front windscreen, rear window and exterior rear view mirror electrical defroster status as indicated in the HMI (does not reflect when the defrosters have been activated by climate control hidden from driver). Includes information regarding how they have been activated and their availability.";
CM_ SG_ 565 HmiDefrstrElecStsMirrr "Front windscreen, rear window and exterior rear view mirror electrical defroster status as indicated in the HMI (does not reflect when the defrosters have been activated by climate control hidden from driver). Includes information regarding how they have been activated and their availability. ";
CM_ SG_ 565 HmiDefrstrElecStsRe "Front windscreen, rear window and exterior rear view mirror electrical defroster status as indicated in the HMI (does not reflect when the defrosters have been activated by climate control hidden from driver). Includes information regarding how they have been activated and their availability. ";
CM_ SG_ 565 HvBattPmpStatCooltPmpDryErr "water pump MT Dryrun error";
CM_ SG_ 565 HvBattPmpStatCooltPmpEmgyModSts "water pump MT, Status Emergency mode";
CM_ SG_ 565 HvBattPmpStatCooltPmpErrSts "water pump error status";
CM_ SG_ 565 HvBattPmpStatCooltPmpI "Actual current consumption from battery coolant pump.";
CM_ SG_ 565 HvBattPmpStatCooltPmpIErr "water pump MT current error";
CM_ SG_ 565 HvBattPmpStatCooltPmpMonrSpd "water pump MT, RPM Monitoring";
CM_ SG_ 565 HvBattPmpStatCooltPmpPostRunSts "water pump post run status";
CM_ SG_ 565 HvBattPmpStatCooltPmpSetPostRunReq "water pump set post run speed request";
CM_ SG_ 565 HvBattPmpStatCooltPmpSetSpdReq "Coolant pump set speed request";
CM_ SG_ 565 HvBattPmpStatCooltPmpSpd "Coolant pump actual speed";
CM_ SG_ 565 HvBattPmpStatCooltPmpT "water pump MT Temperature ";
CM_ SG_ 565 HvBattPmpStatCooltPmpTErr "water pump MT temperature error";
CM_ SG_ 565 HvBattPmpStatCooltPmpU "Coolant pump voltage";
CM_ SG_ 565 HvBattPmpStatCooltPmpUErr "water pump MT voltage error";
CM_ SG_ 565 HvBattPmpStatCooltPmpUnstallSts "water pump MT, Deblocking";
CM_ SG_ 565 HvCooltHeatrICnsSig "contains information of how much current that is consumed  from the high voltage supply.";
CM_ SG_ 565 HvHeatrPwrCnsDes "Desired power consumption for the HVCH.";
CM_ SG_ 565 ImobMgrWarnIndcn "RVI warning to be shown in DIM";
CM_ SG_ 565 KeyNotPrsntMsgToDrvr "Trigger HMI message regarding a non present key.";
CM_ SG_ 565 MotConsDrvCyc "Cumulatived charge amount of all motors in this driving cycle";
CM_ SG_ 565 PostHeatgRunTiEstimd "Estimated heating afterrun time.";
CM_ SG_ 565 PrpsnErrIndcnReq "MIL signal sent to DIM";
CM_ SG_ 565 RlyPwrDistbnCmd1WdIgnRlyExtCmd "status of the ignition extended relay";
CM_ SG_ 565 SteerWhlHeatgAvlSts "Steering wheel heating activation, deactivation, unavailable and error status.";
CM_ SG_ 565 SteerWhlHeatgStrtAutCdnOk "Information about if it is OK to start the steering wheel heating automatically";
CM_ SG_ 565 StrtInProgs "Indicating to HMI that a driver start is initiated";
CM_ SG_ 565 StrtMsgToDrvr "Signal to HMI used for messages to driver related to start and turning off the engine";
CM_ SG_ 565 SysDirIndcnFailr "Indication of Direction Indicator system failure to the driver.

Values:
No Fault or Fault.";
CM_ SG_ 565 TInCooltAtStrtOfClima "Temperature measured by the heater in the coolant at the start of the latest pre-conditioning.";
CM_ SG_ 565 TrAntiPnch "Contains info if POT motor anti-pinch is activated or not";
CM_ SG_ 565 TrObstclDetn "TrObstclDetn - Trunk Obstacle Detection
Signal if obstacle is detected by trunk while opening.
False - No obstacle detected
True - Obstacle detected";
CM_ SG_ 1154 BattSnsrStReq "Battery sensor state";
CM_ SG_ 1154 BrkLiReqRegenChks "checksum";
CM_ SG_ 1154 BrkLiReqRegenCntr "counter";
CM_ SG_ 1154 BrkLiReqRegenOnOff "Brake light illumination request for regeneration.";
CM_ SG_ 1154 DHTStSafeChks "Chechsum";
CM_ SG_ 1154 DHTStSafeCntr "Rolling Counter";
CM_ SG_ 1154 DHTStSafeRsv "Reserved for FuSa";
CM_ SG_ 1154 DHTStSafeSpd "P1 actual speed";
CM_ SG_ 1154 DHTStSafeSpdQf "P1 actual speed quality factor";
CM_ SG_ 1154 DHTStSafeTqRt "Actual gear ratio";
CM_ SG_ 1154 DHTStSafeTqRtQf "Actual gear ratio quality factor";
CM_ SG_ 1154 DtEngdStDtEngdFrnt "Drivetrain engaged, front wheels";
CM_ SG_ 1154 DtEngdStDtEngdRe "Drivetrain engaged, rear wheels";
CM_ SG_ 1154 DtEngdStDtNotEngdFrnt "Drivetrain not engaged, front wheels";
CM_ SG_ 1154 DtEngdStDtNotEngdRe "Drivetrain not engaged, rear wheels";
CM_ SG_ 1154 ElecMot2ErrIndcnReq "MIL ilumination req from EM2";
CM_ SG_ 1154 ElecMot2LimnIndcn "LOS signal";
CM_ SG_ 1154 ElecMot2UDc "HVDC voltage";
CM_ SG_ 1154 EngRunngReqByTrsm "Engine running request from transmission. Supplier request engine running to prevent stalling when transmisson is disengaged. 2 bit signal. 0 - Default, 1 - Inhibit Stop, 2 - Running Requested, 3 - Reserved.";
CM_ SG_ 1154 IsgActvDampgModReq "Mode signal for ISG damping. 0 = No damping; 1 = Low damping; 2 = Medium damping; 3 = High damping";
CM_ SG_ 1154 IsgModReq "Mode request for ISG motor drive system.";
CM_ SG_ 1154 IsgPwrLimMax "Maximum ISG motor drive system powerlimit on DC side. Positive power means power flowing into inverter.";
CM_ SG_ 1154 IsgPwrLimMin "Minimum ISG motor drive system powerlimit on DC side. Positive power means power flowing into inverter.";
CM_ SG_ 1154 IsgSpdReq "ISG speed request for engine speed control by ISG.";
CM_ SG_ 1154 IsgTqAllwdChks "Checksum for IsgTqAllwd";
CM_ SG_ 1154 IsgTqAllwdCntr "Counter for IsgTqAllwd";
CM_ SG_ 1154 IsgTqAllwdIsgTqAllwd "Indication if ISG is allowed to apply propulsive or regenerative torque on wheels.";
CM_ SG_ 1154 OvrdDecelByDrvrChks "Reports the driver intent to override a deceleration. Based on Accelerator pedal being distinctively pressed.checksum";
CM_ SG_ 1154 OvrdDecelByDrvrCntr "Reports the driver intent to override a deceleration. Based on Accelerator pedal being distinctively pressed.checksum";
CM_ SG_ 1154 OvrdDecelByDrvrOvrdDecelByDrvr "Reports the driver intent to override a deceleration. Based on Accelerator pedal being distinctively pressed.";
CM_ SG_ 1154 ParkByDrvrWhlsFrntSafeChks "Checksum of ParkByDrvrWhlsFrntSafe";
CM_ SG_ 1154 ParkByDrvrWhlsFrntSafeCntr "Counter of ParkByDrvrWhlsFrntSafe";
CM_ SG_ 1154 ParkByDrvrWhlsFrntSafeSts "Front wheels safe status when parking by driver.";
CM_ SG_ 1154 PropLgtCtrlModCfmdChks "Checksum for PropLgtCtrlModCfmd";
CM_ SG_ 1154 PropLgtCtrlModCfmdCntr "Counter for PropLgtCtrlModCfmd";
CM_ SG_ 1154 PropLgtCtrlModCfmdLgtDegradation "Defradation status for longitudinal control mode";
CM_ SG_ 1154 PropLgtCtrlModCfmdPropLgtCtrlModCfmd "Describe which longitudinal control mode is actived ";
CM_ SG_ 1154 PrpsnTqFrntReq "Propulsion wheel torque request at front wheel axle. This request is arbitrated from driver request and autonomous driving functions (CC, ACC, etc) requests. The torque includes effects from auxiliary loads, transmissions, etc.";
CM_ SG_ 1154 PrpsnTqReReq "Propulsion wheel torque request at rear wheel axle. This request is arbitrated from driver request and autonomous driving functions (CC, ACC, etc) requests. The torque includes effects from auxiliary loads, transmission, etc.";
CM_ SG_ 1154 PtAllwdToTrsmActrSafeChks "Checksum for PtAllwdToTrsmActr";
CM_ SG_ 1154 PtAllwdToTrsmActrSafeCntr "Counter for PtAllwdToTrsmActr";
CM_ SG_ 1154 PtAllwdToTrsmActrSafePtAllwdToTrsmActr "Powertrain allowed to transmission actuator.";
CM_ SG_ 1154 PtBrkTqCpTot1 "Powertrain total brake torque capacity, including zero accelerator pedal coast retardation torque.";
CM_ SG_ 1154 PtBrkTqCpTotQf "Quality factor";
CM_ SG_ 1154 PtGearRatFrntAct "The signal is used to conclude if a tire lost contact with the road surface.";
CM_ SG_ 1154 PtGearTar "Target gear is for most cases identical to actual gear. The value differs to actual gear during gear shifts and for a hybrid when in electric mode.";
CM_ SG_ 1154 PtJTotAtTrsmAxleOutp "Total aggregated powertrain inertia at transmission output axle including final drive, before left/right differential, and before front/rear differental.";
CM_ SG_ 1154 PtJTotChks "Checksum of Total aggregated powertrain inertia at transmission output axle including final drive, before left/right differential, and before front/rear differental.";
CM_ SG_ 1154 PtJTotCntr "Rollingcounter of Total aggregated powertrain inertia at transmission output axle including final drive, before left/right differential, and before front/rear differental.";
CM_ SG_ 1154 PtRgnTarTqAtReAxleAtReAxle "powertrain regeneration target torque at rear axle";
CM_ SG_ 1154 PtRgnTarTqAtReAxleQf "Quality factor";
CM_ SG_ 1154 PtTotRgnTarTq1 "powertrain total regeneration target torque";
CM_ SG_ 1154 PtTotRgnTarTqQf "Quality factor";
CM_ SG_ 1154 PtTqAtAxleAvlFrntMax "Available propulsion maximum torque at front wheel axle, mean value of right and left wheels. Sign definition: A positive torque will accelerate the vehicle in the driver desired direction. ";
CM_ SG_ 1154 PtTqAtAxleAvlFrntMin "Available propulsion munimum torque at front wheel axle, mean value of right and left wheels. Sign definition: A positive torque will accelerate the vehicle in the driver desired direction. ";
CM_ SG_ 1154 PtTqAtAxleAvlReMax "Available propulsion maximum torque at rear wheel axle, mean value of right and left wheels. Sign definition: A positive torque will accelerate the vehicle in the driver desired direction. ";
CM_ SG_ 1154 PtTqAtAxleAvlReMin "Available propulsion minimum torque at rear wheel axle, mean value of right and left wheels. Sign definition: A positive torque will accelerate the vehicle in the driver desired direction. ";
CM_ SG_ 1154 PtWhlTqTar "Powertrain final torque request on the wheel";
CM_ SG_ 1154 RlyCrashForHvsysReq "Request to CEM to close crash relay.";
CM_ SG_ 1154 TrsmActrPosn2TrsmActrPosn "Describes the transmission position (P, R, N, D). Can also take intermediate positions (PR, RN, ND). If error are detected on position sensors undefined is set. Transmission measured gear lever position";
CM_ SG_ 1154 TrsmActrPosn2TrsmActrPosnChks "E2E checksum";
CM_ SG_ 1154 TrsmActrPosn2TrsmActrPosnCntr "Data counter";
CM_ SG_ 1154 TrsmGearAct "Transmission Gear Actual. Actual gear engaged sent by transmission supplier.";
CM_ SG_ 1154 TrsmGearChgProgs "Transmission gear change in progress. Transmission supplier sent signal containing informatoin regarding which phase the gear shift is in. 0 - not changing gear, 1 - start phase, 2 - tourqe phase, 3 - inertia phase, 4 - end phase.";
CM_ SG_ 1154 TrsmGearNotAvlSts "TCM use signal Trsm Gear Not Available Status to inform ECM which gears is unavailable for gear shifting.Signal is used during failsafe operation Availability mode.Default 0-no gears unavailable.Bit 0-First gear EB not available.Bit 1-First gear not available.Bit X-Xth gear not available";
CM_ SG_ 1154 TrsmGearRat "Transmission gear ratio. Ratio between rotational speed on ingoing shaft and outgoing shaft.";
CM_ SG_ 1154 TrsmGearRatTar "Transmission gear ratio target. Target gear ratio for fix lock-up and current gear.";
CM_ SG_ 1154 TrsmGearTar " Transmission gear target. Target gear recieved by transmission supplier. 0 - neutral disengaged, 1-13 - gear 1-13, 14 - unknown, 15 - reverse.";
CM_ SG_ 528 DrvrSeatHeatgActlPwrCns "Actual power consumption for driver seat climate, including ventilation and heating.";
CM_ SG_ 528 DrvrSeatHeatgDesPwrCns "Desired power consumption for driver seat climate, including ventilation and heating.";
CM_ SG_ 528 DrvrSeatVentnActlPwrCns "Actual driver seat ventilation power consumption.";
CM_ SG_ 528 DrvrSeatVentnDesPwrCns "Desired driver seat ventilation power consumption.";
CM_ SG_ 528 DstEstimdToEmptyForDrvgElecPredTyp2 "Predicted distance till empty in economic driving behavior of type 2.";
CM_ SG_ 528 DstTrvldAct "Actual Total Travlled Distance after Last Reset, in km";
CM_ SG_ 528 DstTrvldOfEng "Travlled Distance after Last Reset (Engine), in km";
CM_ SG_ 528 DstTrvldOfEV "Travlled Distance after Last Reset (EV), in km";
CM_ SG_ 528 EPedlDrvrIndcnMsg "E-pedal pop out message driver indication.";
CM_ SG_ 528 EPedlInhbnSts "E-Pedal inhibit flag.";
CM_ SG_ 528 ErsDelayTiCfm "response to Telematics when received the signal TelmEngDelayTi";
CM_ SG_ 528 ErsStrtRes "Result of the latest ErsOn cmd attempt or, if last ERS run was aborted, the reason for that abort";
CM_ SG_ 528 HealthOfEngOil "Health of Engine Oil";
CM_ SG_ 528 HpcDeiceReq "Deice request from heat pump.";
CM_ SG_ 528 HpcHpCoolgPwrSts "Whether heat pump satisfies cooling request of climate control.";
CM_ SG_ 528 HpcHpHeatgPwrSts "Whether heat pump satisfies heating request of climate control.";
CM_ SG_ 528 HpcHpModReq "Heat pump mode request.";
CM_ SG_ 528 HvacCooltFlowAct "Actual coolant flow through HVAC unit generated by the engine coolant system control. (l/min)";
CM_ SG_ 528 HvacCooltVlvStsSig "HW heating three-way valve status in EMA or CMA1.5";
CM_ SG_ 528 HvBattThermPwrCns "High voltage power consumption for battery thermal management.";
CM_ SG_ 528 HvCabinThermPwrCns "High voltage power consumption for AC cabin cooling or heating.";
CM_ SG_ 528 HvCooltHeatrEnad "HVCH enable signal sent by thermal management.";
CM_ SG_ 528 HvCooltHeatrStsSig "Informs of HVCH status.";
CM_ SG_ 528 HvSysRlyStsChks "Checksum for E2E";
CM_ SG_ 528 HvSysRlyStsCntr "Counter for E2E";
CM_ SG_ 528 HvSysRlyStsHvSysRlySts "Actual state of the main contactors.";
CM_ SG_ 528 NatUsgDayOfOil "Natural Using Days of Engine Oil after Last Reset";
CM_ SG_ 528 OilHealthIfDisp "The flag for whether to display the oil health signal or not";
CM_ SG_ 528 PEMState "Predict energy management state";
CM_ SG_ 528 RainSnsrStsToHMI "Information regarding when the rain sensor function is turned on and in control of the wipers. ";
CM_ SG_ 528 RemindChrgn "When the vehicle is in the commonly used charging place and meets the commonly used charging time, and the deviation between the current SOC and the commonly charged SOC is within a certain range, this signal should be used to inform the large screen to remind the user.";
CM_ SG_ 528 RoadInFor "Indicates the current road condition information";
CM_ SG_ 528 SeatOccptAtRowSecMid2 "Describes if an occupant is detected in the  seat.";
CM_ SG_ 528 SeatOccptAtRowSecMidSnsSts2 "Informs if there is a fault on the driver seat sensor is detected through electrical measurements, or plausibility judgement. NotOk means sensor is judged as faulty. Di means that the sensor is not configured.";
CM_ SG_ 528 SlopReducEngCoeffSlopEqu12 "Energy consumption reduce coefficiency at road slopes=-12 degrees.";
CM_ SG_ 528 SlopReducEngCoeffSlopEqu2 "Energy consumption reduce coefficiency at road slopes=-2 degrees.";
CM_ SG_ 528 SlopReducEngCoeffSlopEqu4 "Energy consumption reduce coefficiency at road slopes=-4 degrees.";
CM_ SG_ 528 SlopReducEngCoeffSlopEqu6 "Energy consumption reduce coefficiency at road slopes=-6 degrees.";
CM_ SG_ 528 SlopReducEngCoeffSlopEqu9 "Energy consumption reduce coefficiency at road slopes=-9 degrees.";
CM_ SG_ 528 SlopRiseEngCoeffSlopEqu12 "Energy consumption rise coefficiency at road slopes=12 degrees.";
CM_ SG_ 528 SlopRiseEngCoeffSlopEqu2 "Energy consumption rise coefficiency at road slopes=2 degrees.";
CM_ SG_ 528 SlopRiseEngCoeffSlopEqu4 "Energy consumption rise coefficiency at road slopes=4 degrees.";
CM_ SG_ 528 SlopRiseEngCoeffSlopEqu6 "Energy consumption rise coefficiency at road slopes=6 degrees.";
CM_ SG_ 528 SlopRiseEngCoeffSlopEqu9 "Energy consumption rise coefficiency at road slopes=9 degrees.";
CM_ SG_ 528 SpdRelatWghtSpdEqu10 "Energy consumption coefficiency at vehicle speeds=10kph.";
CM_ SG_ 528 SpdRelatWghtSpdEqu100 "Energy consumption coefficiency at vehicle speeds=100kph.";
CM_ SG_ 528 SpdRelatWghtSpdEqu120 "Energy consumption coefficiency at vehicle speeds=120kph.";
CM_ SG_ 528 SpdRelatWghtSpdEqu140 "Energy consumption coefficiency at vehicle speeds=140kph.";
CM_ SG_ 528 SpdRelatWghtSpdEqu20 "Energy consumption coefficiency at vehicle speeds=20kph.";
CM_ SG_ 528 SpdRelatWghtSpdEqu40 "Energy consumption coefficiency at vehicle speeds=40kph.";
CM_ SG_ 528 SpdRelatWghtSpdEqu60 "Energy consumption coefficiency at vehicle speeds=60kph.";
CM_ SG_ 528 SpdRelatWghtSpdEqu80 "Energy consumption coefficiency at vehicle speeds=80kph.";
CM_ SG_ 528 SwtStrt3 "one way knob --Start device actuated";
CM_ SG_ 528 SwtStrt4 "one way button --Start device actuated";
CM_ SG_ 528 TotDstTrvldOfEng "Total Travlled Distance(Engine), in km";
CM_ SG_ 528 TotDstTrvldOfEV "Total Travlled Distance(EV), in km";
CM_ SG_ 528 TrOpenerByFootOperCmd "TrOpenerByFootOperCmd - Command for FMDM (Foot Movement Detection Module)
This signal is used to activate or deactivate FMDM foor movement detection.
On - Foot movement detection ON
Off - Foot movement detection OFF";
CM_ SG_ 528 WiprActvFromWMM "Information regarding wiper activation";
CM_ SG_ 880 AccrPedlLnrAccrPedlRat "CVC filtered accelerator pedal";
CM_ SG_ 880 AccrPedlLnrChks "checksum";
CM_ SG_ 880 AccrPedlLnrCntr "counter";
CM_ SG_ 880 AccrPedlNotCmplPsd "Indicate if the accelerator pedal is not fully pressed. Indicate Yes if it is secured to ASIL-A that the accelerator pedal is not fully pressed. Safe state=No";
CM_ SG_ 880 AccrPedlNotCmplPsdChks "Indicate if the accelerator pedal is not fully pressed. Checksum";
CM_ SG_ 880 AccrPedlNotCmplPsdCntr "Indicate if the accelerator pedal is not fully pressed. Counter";
CM_ SG_ 880 AccrPedlNotCmplPsdSts "Indicate if the accelerator pedal is not fully pressed. If set, then AccrPedlNotCmpl fulfill ASIL-B integrity";
CM_ SG_ 880 AccrPedlRatGrdt "Derivative of accelerator pedal position.";
CM_ SG_ 880 AmbTURaw "Ambient temp raw data in deg C";
CM_ SG_ 880 CrsCtrlrActvnOk "The signal informs if Cruise Controller can be activated or not. Primarily used by HMI to know if Cruise Controller activation requests by driver should be ignored or not.";
CM_ SG_ 880 DeactvtTestCom "Scantool communication on/ff0=on=scantool communication is on1=off=scantool communication is off.";
CM_ SG_ 880 DrvrPrpsnTqReq "Torque request from driver via accelerator pedal.";
CM_ SG_ 880 EngPAmbAir "Ambient pressure";
CM_ SG_ 880 EngPwrCns "The current actual power consumption of power train.";
CM_ SG_ 880 ImobBrkNrSerlReq "ECM request to BCM to send serial number used for immo authentication.";
CM_ SG_ 880 ImobEngSts1 "ECM CEM immo status. Can be undefined, immobilised, motive mobilised or non motive mobilised.";
CM_ SG_ 880 ImobEngSts3 "IGM CEM message immo status. Undefined, immobilised, motive mobilised or non motive mobilised.";
CM_ SG_ 880 PtDtModReq "Drivetrain mode request(EV/Serial/Parallel)";
CM_ SG_ 880 PtReqToTrsmActr "Request to transmission actuator (PRND)";
CM_ SG_ 880 PtTqTotDrgAtWhls "Propulsion torque level at zero accelerator pedal position.";
CM_ SG_ 880 SwtTrClsSts "SwtTrClsSts - Close Tailgate/Bootlid switch status

Status signal for shutface close switch.

Psd - Pressed
NotPsd - Not Pressed";
CM_ SG_ 880 ThermFctReq "Request from ThermalManagement to set usage mode to inactive";
CM_ SG_ 880 TrsmCluTEstimdOfClu0 "Clutch C0 temperature";
CM_ SG_ 880 TrsmErrIndcnReq "TCM uses signal Transmission Error Indication Request to send a MIL-request to ECM. ECM will then act upon this request and iluminate the MIL. For VEP software, TCM transmits signal after two consecutive failed driving cycles (for a MIL-relevant code). Default value - 0 (Off)";
CM_ SG_ 880 TrsmHotSt "Transmission hot state. Indicate transmission is in hot state. 0 - Not in hot state, 1 - Hot state level 1, 2 - Hot state level 2.";
CM_ SG_ 880 TrsmShiftInhb "Transmission Shift Inhibit. Block shifting request signal sent from transmission supplier. 0 - shift inhibit not active, 1 - Shift inhibit active.";
CM_ SG_ 800 CmprSpdAct "Electrical compressor actual speed";
CM_ SG_ 800 EngCrashFb "Propulsion shall set EngCrashFb depending on the status of leakage detection after a crash have occured.";
CM_ SG_ 800 HvCooltHeatrEnadWhE2EChks "Checksum for E2E.";
CM_ SG_ 800 HvCooltHeatrEnadWhE2ECntr "Counter for E2E.";
CM_ SG_ 800 HvCooltHeatrEnadWhE2EHvchEnad "HVHC enable.";
CM_ SG_ 800 SafetyCrashFb "If brake pedal has been disconnected after a crash it is NOK, else OK after crash.";
CM_ SG_ 800 VFCVectorPCMBlockID "BlockID";
CM_ SG_ 800 VFCVectorPCMVFCid0 "SettingsComfort";
CM_ SG_ 800 VFCVectorPCMVFCid1 "ParkingDrivingClimatization";
CM_ SG_ 800 VFCVectorPCMVFCid10 "ExteriorLighting";
CM_ SG_ 800 VFCVectorPCMVFCid11 "VFCid11";
CM_ SG_ 800 VFCVectorPCMVFCid12 "Alarm";
CM_ SG_ 800 VFCVectorPCMVFCid13 "VFCid13";
CM_ SG_ 800 VFCVectorPCMVFCid14 "InteriorLighting";
CM_ SG_ 800 VFCVectorPCMVFCid15 "VFCid15";
CM_ SG_ 800 VFCVectorPCMVFCid16 "Locking";
CM_ SG_ 800 VFCVectorPCMVFCid17 "RemoteKeyFunctionality";
CM_ SG_ 800 VFCVectorPCMVFCid18 "PropulsionStart";
CM_ SG_ 800 VFCVectorPCMVFCid19 "VFCid19";
CM_ SG_ 800 VFCVectorPCMVFCid2 "PostClimatisation";
CM_ SG_ 800 VFCVectorPCMVFCid20 "VFCid20";
CM_ SG_ 800 VFCVectorPCMVFCid21 "PowerClosures";
CM_ SG_ 800 VFCVectorPCMVFCid22 "VehicleDriving";
CM_ SG_ 800 VFCVectorPCMVFCid23 "VFCid23";
CM_ SG_ 800 VFCVectorPCMVFCid24 "SettingsProfile";
CM_ SG_ 800 VFCVectorPCMVFCid25 "SeatComfortFunctions";
CM_ SG_ 800 VFCVectorPCMVFCid26 "Brake";
CM_ SG_ 800 VFCVectorPCMVFCid27 "InfotainmentPoll";
CM_ SG_ 800 VFCVectorPCMVFCid28 "HVEnergyStorage";
CM_ SG_ 800 VFCVectorPCMVFCid29 "VFCid29";
CM_ SG_ 800 VFCVectorPCMVFCid3 "PowertrainParkingClimatization";
CM_ SG_ 800 VFCVectorPCMVFCid30 "TelematicsConnectivity";
CM_ SG_ 800 VFCVectorPCMVFCid31 "VFCid31";
CM_ SG_ 800 VFCVectorPCMVFCid32 "VFCid32";
CM_ SG_ 800 VFCVectorPCMVFCid33 "Diagnostics";
CM_ SG_ 800 VFCVectorPCMVFCid34 "VehicleModeManagement";
CM_ SG_ 800 VFCVectorPCMVFCid35 "TrailerCaravanFunctions";
CM_ SG_ 800 VFCVectorPCMVFCid36 "Immobilizer";
CM_ SG_ 800 VFCVectorPCMVFCid37 "Windows";
CM_ SG_ 800 VFCVectorPCMVFCid38 "Visibility";
CM_ SG_ 800 VFCVectorPCMVFCid39 "VFCid39";
CM_ SG_ 800 VFCVectorPCMVFCid4 "VFCid4";
CM_ SG_ 800 VFCVectorPCMVFCid40 "VFCid40";
CM_ SG_ 800 VFCVectorPCMVFCid41 "InfotainmentPush";
CM_ SG_ 800 VFCVectorPCMVFCid42 "ChargingHV";
CM_ SG_ 800 VFCVectorPCMVFCid43 "BodyPreClimatisation";
CM_ SG_ 800 VFCVectorPCMVFCid44 "Crash";
CM_ SG_ 800 VFCVectorPCMVFCid45 "GlobalShortDuration";
CM_ SG_ 800 VFCVectorPCMVFCid46 "ExteriorLightsHazard";
CM_ SG_ 800 VFCVectorPCMVFCid47 "VFCid47";
CM_ SG_ 800 VFCVectorPCMVFCid48 "DoorOpenWarning";
CM_ SG_ 800 VFCVectorPCMVFCid49 "ChargingLVInit";
CM_ SG_ 800 VFCVectorPCMVFCid5 "VFCid5";
CM_ SG_ 800 VFCVectorPCMVFCid50 "VFCid50";
CM_ SG_ 800 VFCVectorPCMVFCid51 "VFCid51";
CM_ SG_ 800 VFCVectorPCMVFCid52 "HVBatteryThermalEventWarning";
CM_ SG_ 800 VFCVectorPCMVFCid53 "VisualAssist";
CM_ SG_ 800 VFCVectorPCMVFCid54 "PassiveSafety";
CM_ SG_ 800 VFCVectorPCMVFCid55 "LifeDetection";
CM_ SG_ 800 VFCVectorPCMVFCid56 "BackboneFlexray";
CM_ SG_ 800 VFCVectorPCMVFCid57 "Functionmarket";
CM_ SG_ 800 VFCVectorPCMVFCid58 "VFCid58";
CM_ SG_ 800 VFCVectorPCMVFCid59 "VFCid59";
CM_ SG_ 800 VFCVectorPCMVFCid6 "SettingsVehicle";
CM_ SG_ 800 VFCVectorPCMVFCid60 "VFCid60";
CM_ SG_ 800 VFCVectorPCMVFCid61 "VFCid61";
CM_ SG_ 800 VFCVectorPCMVFCid7 "VFCid7";
CM_ SG_ 800 VFCVectorPCMVFCid8 "VFCid8";
CM_ SG_ 800 VFCVectorPCMVFCid9 "IPWakeup";
CM_ SG_ 800 VFCVectorPOTBlockID "BlockID";
CM_ SG_ 800 VFCVectorPOTVFCid0 "SettingsComfort";
CM_ SG_ 800 VFCVectorPOTVFCid1 "ParkingDrivingClimatization";
CM_ SG_ 800 VFCVectorPOTVFCid10 "ExteriorLighting";
CM_ SG_ 800 VFCVectorPOTVFCid11 "VFCid11";
CM_ SG_ 800 VFCVectorPOTVFCid12 "Alarm";
CM_ SG_ 800 VFCVectorPOTVFCid13 "VFCid13";
CM_ SG_ 800 VFCVectorPOTVFCid14 "InteriorLighting";
CM_ SG_ 800 VFCVectorPOTVFCid15 "VFCid15";
CM_ SG_ 800 VFCVectorPOTVFCid16 "Locking";
CM_ SG_ 800 VFCVectorPOTVFCid17 "RemoteKeyFunctionality";
CM_ SG_ 800 VFCVectorPOTVFCid18 "PropulsionStart";
CM_ SG_ 800 VFCVectorPOTVFCid19 "VFCid19";
CM_ SG_ 800 VFCVectorPOTVFCid2 "PostClimatisation";
CM_ SG_ 800 VFCVectorPOTVFCid20 "VFCid20";
CM_ SG_ 800 VFCVectorPOTVFCid21 "PowerClosures";
CM_ SG_ 800 VFCVectorPOTVFCid22 "VehicleDriving";
CM_ SG_ 800 VFCVectorPOTVFCid23 "VFCid23";
CM_ SG_ 800 VFCVectorPOTVFCid24 "SettingsProfile";
CM_ SG_ 800 VFCVectorPOTVFCid25 "SeatComfortFunctions";
CM_ SG_ 800 VFCVectorPOTVFCid26 "Brake";
CM_ SG_ 800 VFCVectorPOTVFCid27 "InfotainmentPoll";
CM_ SG_ 800 VFCVectorPOTVFCid28 "HVEnergyStorage";
CM_ SG_ 800 VFCVectorPOTVFCid29 "VFCid29";
CM_ SG_ 800 VFCVectorPOTVFCid3 "PowertrainParkingClimatization";
CM_ SG_ 800 VFCVectorPOTVFCid30 "TelematicsConnectivity";
CM_ SG_ 800 VFCVectorPOTVFCid31 "VFCid31";
CM_ SG_ 800 VFCVectorPOTVFCid32 "VFCid32";
CM_ SG_ 800 VFCVectorPOTVFCid33 "Diagnostics";
CM_ SG_ 800 VFCVectorPOTVFCid34 "VehicleModeManagement";
CM_ SG_ 800 VFCVectorPOTVFCid35 "TrailerCaravanFunctions";
CM_ SG_ 800 VFCVectorPOTVFCid36 "Immobilizer";
CM_ SG_ 800 VFCVectorPOTVFCid37 "Windows";
CM_ SG_ 800 VFCVectorPOTVFCid38 "Visibility";
CM_ SG_ 800 VFCVectorPOTVFCid39 "VFCid39";
CM_ SG_ 800 VFCVectorPOTVFCid4 "VFCid4";
CM_ SG_ 800 VFCVectorPOTVFCid40 "VFCid40";
CM_ SG_ 800 VFCVectorPOTVFCid41 "InfotainmentPush";
CM_ SG_ 800 VFCVectorPOTVFCid42 "ChargingHV";
CM_ SG_ 800 VFCVectorPOTVFCid43 "BodyPreClimatisation";
CM_ SG_ 800 VFCVectorPOTVFCid44 "Crash";
CM_ SG_ 800 VFCVectorPOTVFCid45 "GlobalShortDuration";
CM_ SG_ 800 VFCVectorPOTVFCid46 "ExteriorLightsHazard";
CM_ SG_ 800 VFCVectorPOTVFCid47 "VFCid47";
CM_ SG_ 800 VFCVectorPOTVFCid48 "DoorOpenWarning";
CM_ SG_ 800 VFCVectorPOTVFCid49 "ChargingLVInit";
CM_ SG_ 800 VFCVectorPOTVFCid5 "VFCid5";
CM_ SG_ 800 VFCVectorPOTVFCid50 "VFCid50";
CM_ SG_ 800 VFCVectorPOTVFCid51 "VFCid51";
CM_ SG_ 800 VFCVectorPOTVFCid52 "HVBatteryThermalEventWarning";
CM_ SG_ 800 VFCVectorPOTVFCid53 "VisualAssist";
CM_ SG_ 800 VFCVectorPOTVFCid54 "PassiveSafety";
CM_ SG_ 800 VFCVectorPOTVFCid55 "LifeDetection";
CM_ SG_ 800 VFCVectorPOTVFCid56 "BackboneFlexray";
CM_ SG_ 800 VFCVectorPOTVFCid57 "Functionmarket";
CM_ SG_ 800 VFCVectorPOTVFCid58 "VFCid58";
CM_ SG_ 800 VFCVectorPOTVFCid59 "VFCid59";
CM_ SG_ 800 VFCVectorPOTVFCid6 "SettingsVehicle";
CM_ SG_ 800 VFCVectorPOTVFCid60 "VFCid60";
CM_ SG_ 800 VFCVectorPOTVFCid61 "VFCid61";
CM_ SG_ 800 VFCVectorPOTVFCid7 "VFCid7";
CM_ SG_ 800 VFCVectorPOTVFCid8 "VFCid8";
CM_ SG_ 800 VFCVectorPOTVFCid9 "IPWakeup";
CM_ SG_ 800 VFCVectorSRSBlockID "BlockID";
CM_ SG_ 800 VFCVectorSRSVFCid0 "SettingsComfort";
CM_ SG_ 800 VFCVectorSRSVFCid1 "ParkingDrivingClimatization";
CM_ SG_ 800 VFCVectorSRSVFCid10 "ExteriorLighting";
CM_ SG_ 800 VFCVectorSRSVFCid11 "VFC11";
CM_ SG_ 800 VFCVectorSRSVFCid12 "Alarm";
CM_ SG_ 800 VFCVectorSRSVFCid13 "VFC13";
CM_ SG_ 800 VFCVectorSRSVFCid14 "InteriorLighting";
CM_ SG_ 800 VFCVectorSRSVFCid15 "VFC15";
CM_ SG_ 800 VFCVectorSRSVFCid16 "Locking";
CM_ SG_ 800 VFCVectorSRSVFCid17 "RemoteKeyFunctionality";
CM_ SG_ 800 VFCVectorSRSVFCid18 "PropulsionStart";
CM_ SG_ 800 VFCVectorSRSVFCid19 "VFC19";
CM_ SG_ 800 VFCVectorSRSVFCid2 "PostClimatisation";
CM_ SG_ 800 VFCVectorSRSVFCid20 "VFC20";
CM_ SG_ 800 VFCVectorSRSVFCid21 "PowerClosures";
CM_ SG_ 800 VFCVectorSRSVFCid22 "VehicleDriving";
CM_ SG_ 800 VFCVectorSRSVFCid23 "VFC23";
CM_ SG_ 800 VFCVectorSRSVFCid24 "SettingsProfile";
CM_ SG_ 800 VFCVectorSRSVFCid25 "SeatComfortFunctions";
CM_ SG_ 800 VFCVectorSRSVFCid26 "Brake";
CM_ SG_ 800 VFCVectorSRSVFCid27 "InfotainmentPoll";
CM_ SG_ 800 VFCVectorSRSVFCid28 "HVEnergyStorage";
CM_ SG_ 800 VFCVectorSRSVFCid29 "VFC29";
CM_ SG_ 800 VFCVectorSRSVFCid3 "PowertrainParkingClimatization";
CM_ SG_ 800 VFCVectorSRSVFCid30 "TelematicsConnectivity";
CM_ SG_ 800 VFCVectorSRSVFCid31 "VFC31";
CM_ SG_ 800 VFCVectorSRSVFCid32 "VFC32";
CM_ SG_ 800 VFCVectorSRSVFCid33 "Diagnostics";
CM_ SG_ 800 VFCVectorSRSVFCid34 "VehicleModeManagement";
CM_ SG_ 800 VFCVectorSRSVFCid35 "TrailerCaravanFunctions";
CM_ SG_ 800 VFCVectorSRSVFCid36 "Immobilizer";
CM_ SG_ 800 VFCVectorSRSVFCid37 "Windows";
CM_ SG_ 800 VFCVectorSRSVFCid38 "Visibility";
CM_ SG_ 800 VFCVectorSRSVFCid39 "VFC39";
CM_ SG_ 800 VFCVectorSRSVFCid4 "VFC4";
CM_ SG_ 800 VFCVectorSRSVFCid40 "VFC40";
CM_ SG_ 800 VFCVectorSRSVFCid41 "InfotainmentPush";
CM_ SG_ 800 VFCVectorSRSVFCid42 "ChargingHV";
CM_ SG_ 800 VFCVectorSRSVFCid43 "BodyPreClimatisation";
CM_ SG_ 800 VFCVectorSRSVFCid44 "Crash";
CM_ SG_ 800 VFCVectorSRSVFCid45 "GlobalShortDuration";
CM_ SG_ 800 VFCVectorSRSVFCid46 "ExteriorLightsHazard";
CM_ SG_ 800 VFCVectorSRSVFCid47 "VFC47";
CM_ SG_ 800 VFCVectorSRSVFCid48 "DoorOpenWarning";
CM_ SG_ 800 VFCVectorSRSVFCid49 "ChargingLVInit";
CM_ SG_ 800 VFCVectorSRSVFCid5 "VFC5";
CM_ SG_ 800 VFCVectorSRSVFCid50 "VFC50";
CM_ SG_ 800 VFCVectorSRSVFCid51 "VFC51";
CM_ SG_ 800 VFCVectorSRSVFCid52 "HVBatteryThermalEventWarning";
CM_ SG_ 800 VFCVectorSRSVFCid53 "VisualAssist";
CM_ SG_ 800 VFCVectorSRSVFCid54 "PassiveSafety";
CM_ SG_ 800 VFCVectorSRSVFCid55 "LifeDetection";
CM_ SG_ 800 VFCVectorSRSVFCid56 "BackboneFlexray";
CM_ SG_ 800 VFCVectorSRSVFCid57 "Functionmarket";
CM_ SG_ 800 VFCVectorSRSVFCid58 "VFC58";
CM_ SG_ 800 VFCVectorSRSVFCid59 "VFC59";
CM_ SG_ 800 VFCVectorSRSVFCid6 "SettingsVehicle";
CM_ SG_ 800 VFCVectorSRSVFCid60 "VFC60";
CM_ SG_ 800 VFCVectorSRSVFCid61 "VFC61";
CM_ SG_ 800 VFCVectorSRSVFCid7 "VFC7";
CM_ SG_ 800 VFCVectorSRSVFCid8 "VFC8";
CM_ SG_ 800 VFCVectorSRSVFCid9 "IPWakeup";
CM_ SG_ 800 VFCVectorSUMBlockID "BlockID";
CM_ SG_ 800 VFCVectorSUMVFCid0 "SettingsComfort";
CM_ SG_ 800 VFCVectorSUMVFCid1 "ParkingDrivingClimatization";
CM_ SG_ 800 VFCVectorSUMVFCid10 "ExteriorLighting";
CM_ SG_ 800 VFCVectorSUMVFCid11 "VFC11";
CM_ SG_ 800 VFCVectorSUMVFCid12 "Alarm";
CM_ SG_ 800 VFCVectorSUMVFCid13 "VFC13";
CM_ SG_ 800 VFCVectorSUMVFCid14 "InteriorLighting";
CM_ SG_ 800 VFCVectorSUMVFCid15 "VFC15";
CM_ SG_ 800 VFCVectorSUMVFCid16 "Locking";
CM_ SG_ 800 VFCVectorSUMVFCid17 "RemoteKeyFunctionality";
CM_ SG_ 800 VFCVectorSUMVFCid18 "PropulsionStart";
CM_ SG_ 800 VFCVectorSUMVFCid19 "VFC19";
CM_ SG_ 800 VFCVectorSUMVFCid2 "PostClimatisation";
CM_ SG_ 800 VFCVectorSUMVFCid20 "VFC20";
CM_ SG_ 800 VFCVectorSUMVFCid21 "PowerClosures";
CM_ SG_ 800 VFCVectorSUMVFCid22 "VehicleDriving";
CM_ SG_ 800 VFCVectorSUMVFCid23 "VFC23";
CM_ SG_ 800 VFCVectorSUMVFCid24 "SettingsProfile";
CM_ SG_ 800 VFCVectorSUMVFCid25 "SeatComfortFunctions";
CM_ SG_ 800 VFCVectorSUMVFCid26 "Brake";
CM_ SG_ 800 VFCVectorSUMVFCid27 "InfotainmentPoll";
CM_ SG_ 800 VFCVectorSUMVFCid28 "HVEnergyStorage";
CM_ SG_ 800 VFCVectorSUMVFCid29 "VFC29";
CM_ SG_ 800 VFCVectorSUMVFCid3 "PowertrainParkingClimatization";
CM_ SG_ 800 VFCVectorSUMVFCid30 "TelematicsConnectivity";
CM_ SG_ 800 VFCVectorSUMVFCid31 "VFC31";
CM_ SG_ 800 VFCVectorSUMVFCid32 "VFC32";
CM_ SG_ 800 VFCVectorSUMVFCid33 "Diagnostics";
CM_ SG_ 800 VFCVectorSUMVFCid34 "VehicleModeManagement";
CM_ SG_ 800 VFCVectorSUMVFCid35 "TrailerCaravanFunctions";
CM_ SG_ 800 VFCVectorSUMVFCid36 "Immobilizer";
CM_ SG_ 800 VFCVectorSUMVFCid37 "Windows";
CM_ SG_ 800 VFCVectorSUMVFCid38 "Visibility";
CM_ SG_ 800 VFCVectorSUMVFCid39 "VFC39";
CM_ SG_ 800 VFCVectorSUMVFCid4 "VFC4";
CM_ SG_ 800 VFCVectorSUMVFCid40 "VFC40";
CM_ SG_ 800 VFCVectorSUMVFCid41 "InfotainmentPush";
CM_ SG_ 800 VFCVectorSUMVFCid42 "ChargingHV";
CM_ SG_ 800 VFCVectorSUMVFCid43 "BodyPreClimatisation";
CM_ SG_ 800 VFCVectorSUMVFCid44 "Crash";
CM_ SG_ 800 VFCVectorSUMVFCid45 "GlobalShortDuration";
CM_ SG_ 800 VFCVectorSUMVFCid46 "ExteriorLightsHazard";
CM_ SG_ 800 VFCVectorSUMVFCid47 "VFC47";
CM_ SG_ 800 VFCVectorSUMVFCid48 "DoorOpenWarning";
CM_ SG_ 800 VFCVectorSUMVFCid49 "ChargingLVInit";
CM_ SG_ 800 VFCVectorSUMVFCid5 "VFC5";
CM_ SG_ 800 VFCVectorSUMVFCid50 "VFC50";
CM_ SG_ 800 VFCVectorSUMVFCid51 "VFC51";
CM_ SG_ 800 VFCVectorSUMVFCid52 "HVBatteryThermalEventWarning";
CM_ SG_ 800 VFCVectorSUMVFCid53 "VisualAssist";
CM_ SG_ 800 VFCVectorSUMVFCid54 "PassiveSafety";
CM_ SG_ 800 VFCVectorSUMVFCid55 "LifeDetection";
CM_ SG_ 800 VFCVectorSUMVFCid56 "BackboneFlexray";
CM_ SG_ 800 VFCVectorSUMVFCid57 "Functionmarket";
CM_ SG_ 800 VFCVectorSUMVFCid58 "VFC58";
CM_ SG_ 800 VFCVectorSUMVFCid59 "VFC59";
CM_ SG_ 800 VFCVectorSUMVFCid6 "SettingsVehicle";
CM_ SG_ 800 VFCVectorSUMVFCid60 "VFC60";
CM_ SG_ 800 VFCVectorSUMVFCid61 "VFC61";
CM_ SG_ 800 VFCVectorSUMVFCid7 "VFC7";
CM_ SG_ 800 VFCVectorSUMVFCid8 "VFC8";
CM_ SG_ 800 VFCVectorSUMVFCid9 "IPWakeup";
CM_ SG_ 800 VFCVectorZCUDSBlockID "BlockID";
CM_ SG_ 800 VFCVectorZCUDSVFCid0 "SettingsComfort";
CM_ SG_ 800 VFCVectorZCUDSVFCid1 "ParkingDrivingClimatization";
CM_ SG_ 800 VFCVectorZCUDSVFCid10 "ExteriorLighting";
CM_ SG_ 800 VFCVectorZCUDSVFCid11 "VFC11";
CM_ SG_ 800 VFCVectorZCUDSVFCid12 "Alarm";
CM_ SG_ 800 VFCVectorZCUDSVFCid13 "VFC13";
CM_ SG_ 800 VFCVectorZCUDSVFCid14 "InteriorLighting";
CM_ SG_ 800 VFCVectorZCUDSVFCid15 "VFC15";
CM_ SG_ 800 VFCVectorZCUDSVFCid16 "Locking";
CM_ SG_ 800 VFCVectorZCUDSVFCid17 "RemoteKeyFunctionality";
CM_ SG_ 800 VFCVectorZCUDSVFCid18 "PropulsionStart";
CM_ SG_ 800 VFCVectorZCUDSVFCid19 "VFC19";
CM_ SG_ 800 VFCVectorZCUDSVFCid2 "PostClimatisation";
CM_ SG_ 800 VFCVectorZCUDSVFCid20 "VFC20";
CM_ SG_ 800 VFCVectorZCUDSVFCid21 "PowerClosures";
CM_ SG_ 800 VFCVectorZCUDSVFCid22 "VehicleDriving";
CM_ SG_ 800 VFCVectorZCUDSVFCid23 "VFC23";
CM_ SG_ 800 VFCVectorZCUDSVFCid24 "SettingsProfile";
CM_ SG_ 800 VFCVectorZCUDSVFCid25 "SeatComfortFunctions";
CM_ SG_ 800 VFCVectorZCUDSVFCid26 "Brake";
CM_ SG_ 800 VFCVectorZCUDSVFCid27 "InfotainmentPoll";
CM_ SG_ 800 VFCVectorZCUDSVFCid28 "HVEnergyStorage";
CM_ SG_ 800 VFCVectorZCUDSVFCid29 "VFC29";
CM_ SG_ 800 VFCVectorZCUDSVFCid3 "PowertrainParkingClimatization";
CM_ SG_ 800 VFCVectorZCUDSVFCid30 "TelematicsConnectivity";
CM_ SG_ 800 VFCVectorZCUDSVFCid31 "VFC31";
CM_ SG_ 800 VFCVectorZCUDSVFCid32 "VFC32";
CM_ SG_ 800 VFCVectorZCUDSVFCid33 "Diagnostics";
CM_ SG_ 800 VFCVectorZCUDSVFCid34 "VehicleModeManagement";
CM_ SG_ 800 VFCVectorZCUDSVFCid35 "TrailerCaravanFunctions";
CM_ SG_ 800 VFCVectorZCUDSVFCid36 "Immobilizer";
CM_ SG_ 800 VFCVectorZCUDSVFCid37 "Windows";
CM_ SG_ 800 VFCVectorZCUDSVFCid38 "Visibility";
CM_ SG_ 800 VFCVectorZCUDSVFCid39 "VFC39";
CM_ SG_ 800 VFCVectorZCUDSVFCid4 "VFC4";
CM_ SG_ 800 VFCVectorZCUDSVFCid40 "VFC40";
CM_ SG_ 800 VFCVectorZCUDSVFCid41 "InfotainmentPush";
CM_ SG_ 800 VFCVectorZCUDSVFCid42 "ChargingHV";
CM_ SG_ 800 VFCVectorZCUDSVFCid43 "BodyPreClimatisation";
CM_ SG_ 800 VFCVectorZCUDSVFCid44 "Crash";
CM_ SG_ 800 VFCVectorZCUDSVFCid45 "GlobalShortDuration";
CM_ SG_ 800 VFCVectorZCUDSVFCid46 "ExteriorLightsHazard";
CM_ SG_ 800 VFCVectorZCUDSVFCid47 "VFC47";
CM_ SG_ 800 VFCVectorZCUDSVFCid48 "DoorOpenWarning";
CM_ SG_ 800 VFCVectorZCUDSVFCid49 "ChargingLVInit";
CM_ SG_ 800 VFCVectorZCUDSVFCid5 "VFC5";
CM_ SG_ 800 VFCVectorZCUDSVFCid50 "VFC50";
CM_ SG_ 800 VFCVectorZCUDSVFCid51 "VFC51";
CM_ SG_ 800 VFCVectorZCUDSVFCid52 "HVBatteryThermalEventWarning";
CM_ SG_ 800 VFCVectorZCUDSVFCid53 "VisualAssist";
CM_ SG_ 800 VFCVectorZCUDSVFCid54 "PassiveSafety";
CM_ SG_ 800 VFCVectorZCUDSVFCid55 "LifeDetection";
CM_ SG_ 800 VFCVectorZCUDSVFCid56 "BackboneFlexray";
CM_ SG_ 800 VFCVectorZCUDSVFCid57 "Functionmarket";
CM_ SG_ 800 VFCVectorZCUDSVFCid58 "VFCid58";
CM_ SG_ 800 VFCVectorZCUDSVFCid59 "VFCid59";
CM_ SG_ 800 VFCVectorZCUDSVFCid6 "SettingsVehicle";
CM_ SG_ 800 VFCVectorZCUDSVFCid60 "VFCid60";
CM_ SG_ 800 VFCVectorZCUDSVFCid61 "VFCid61";
CM_ SG_ 800 VFCVectorZCUDSVFCid7 "VFC7";
CM_ SG_ 800 VFCVectorZCUDSVFCid8 "VFC8";
CM_ SG_ 800 VFCVectorZCUDSVFCid9 "IPWakeup";
CM_ SG_ 264 ChdPrtnLeftSwReq "Signal from the Driver door switchpack to the Driver Door module containing the status of the function LED for the left rear Power window disable-child lock switch";
CM_ SG_ 264 ChdPrtnRightSwReq "Signal from the Driver door switchpack to the Driver Door module containing the status of the function LED for the right rear Power window disable or child lock switch";
CM_ SG_ 264 DispBattEgyIn "Electric battery energy absorbed by the HV Battery. NB: Only power flowing into HV battery is integrated. Energy=integral( max( battery power flowing in , 0) ).";
CM_ SG_ 264 DispBattEgyOut "Electric battery energy delivered by the HV Battery. NB: Only power flowing out of the HV battery is integrated. Energy=integral( max( battery power flowing out , 0) ).";
CM_ SG_ 264 DrvrSeatSnsrSts "Informs if there is a fault on the driver seat sensor is detected through electrical measurements, or plausibility judgement. NotOk means sensor is judged as faulty. Di means that the sensor is not configured.";
CM_ SG_ 264 EngSpdDispd "Engine speed value for engine speed meter in the driver information display. Note that this speed value may differ from the real actual engine speed.";
CM_ SG_ 264 EngSpdMaxDispd "Maximum engine speed value for engine speed meter in the driver information display. Note that this maximum engine speed value may differ from the real maximum possible engine speed that the engine can be produced by the engine.";
CM_ SG_ 264 FrntSeatCmftCtrlReSeatLe "Signal to control Front Seat from Second Row Left Seat";
CM_ SG_ 264 FrntSeatCmftCtrlReSeatRi "Signal to control Front Seat from Second Row Right Seat";
CM_ SG_ 264 RowSecLeMassgRunng "second row left seat massage module running status";
CM_ SG_ 264 RowSecLeSeatActvSpplFct "Active Multifunction";
CM_ SG_ 264 RowSecRiMassgRunng "second row right seat massage module running status";
CM_ SG_ 264 RowSecRiSeatActvSpplFct "Active Multifunction";
CM_ SG_ 264 TCSCmprStrtFlt "TCSCmprStrtFlt";
CM_ SG_ 264 TCSFltSts "TCSFltSts";
CM_ SG_ 264 TCSModSwtSts "TCSModSwtSts";
CM_ SG_ 67 BookTrvlFltSts "ECM shall send fault status to TCAM ";
CM_ SG_ 67 BookTrvlSetResponse "ECM shall feedback status when receives the request to enter book charging mode";
CM_ SG_ 67 BookTrvlTiSetReqBookTrvlChrgnTi "The charging time to target SOC";
CM_ SG_ 67 BookTrvlTiSetReqBookTrvlTiSetReq "ECM shall send the request to calculate charging initial time to TCAM";
CM_ SG_ 67 CrashSts2 "Information if a crash has been detected by SRS.";
CM_ SG_ 67 DchaStopByTarDrvrIndcn "Driver indication signal of discharging function stopped due to remaining distance/SOC target reached.";
CM_ SG_ 67 PrpsnDataEvtACnt "Counter";
CM_ SG_ 67 PrpsnDataEvtAData1 "Data - Record data A by event trigger";
CM_ SG_ 67 PrpsnDataEvtAData2 "Data - Record data A by event trigger";
CM_ SG_ 67 PrpsnDataEvtAData3 "Data - Record data A by event trigger";
CM_ SG_ 67 PrpsnDataEvtAData4 "Data - Record data A by event trigger";
CM_ SG_ 67 PrpsnDataEvtAData5 "Data - Record data A by event trigger";
CM_ SG_ 67 PrpsnDataEvtAData6 "Data - Record data A by event trigger";
CM_ SG_ 67 PrpsnDataEvtAID "ID - Record data A by event trigger";
CM_ SG_ 67 PrpsnDataEvtBCnt "Counter";
CM_ SG_ 67 PrpsnDataEvtBData1 "Data - Record data B by event trigger";
CM_ SG_ 67 PrpsnDataEvtBData2 "Data - Record data B by event trigger";
CM_ SG_ 67 PrpsnDataEvtBData3 "Data - Record data B by event trigger";
CM_ SG_ 67 PrpsnDataEvtBData4 "Data - Record data B by event trigger";
CM_ SG_ 67 PrpsnDataEvtBData5 "Data - Record data B by event trigger";
CM_ SG_ 67 PrpsnDataEvtBData6 "Data - Record data B by event trigger";
CM_ SG_ 67 PrpsnDataEvtBID "ID - Record data B by event trigger";
BA_DEF_ BO_ "CANFD_BRS" ENUM "0","1";
BA_DEF_ BO_ "GenMsgCycleTime" INT 0 65536;
BA_DEF_ BO_ "GenMsgDelayTime" INT 0 65536;
BA_DEF_ BO_ "GenMsgSendType" ENUM "cyclic", "spontaneous", "not-used", "not-used", "not-used", "cyclicAndSpontaneous", "not-used", "cyclicIfActive", "NoMsgSendType";
BA_DEF_ BO_ "GenMsgStartDelayTime" INT 0 65536;
BA_DEF_ BO_ "VFrameFormat" ENUM "StandardCAN","ExtendedCAN","reserved","J1939PG","reserved","reserved","reserved","reserved","reserved","reserved","reserved","reserved","reserved","reserved","StandardCAN_FD","ExtendedCAN_FD";
BA_DEF_ SG_ "GenSigSendType" ENUM "Cyclic","OnWrite","OnWriteWithRepetition","OnChange","OnChangeWithRepetition","IfActive","IfActiveWithRepetition","NoSigSendType";
BA_DEF_ SG_ "GenSigStartValue" HEX 0 80000000;
BA_DEF_ BO_ "GenMsgILSupport" ENUM "No","Yes";
BA_DEF_ BO_ "NmAsrMessage" ENUM "No","Yes";
BA_DEF_ SG_ "GenSigFuncType" ENUM "NoFunction","n/a","n/a","n/a","n/a","n/a","n/a","n/a","n/a","n/a","n/a","n/a","n/a","n/a","n/a","CHK","CNTR","n/a","n/a","n/a","CNTR_AR_01","CRC_AR_01_BOTH","CRC_AR_01_ALT","CRC_AR_01_LOW","CRC_AR_01_NIBBLE","CNTR_AR_04","CRC_AR_04A","CNTR_AR_05","CRC_AR_05";
BA_DEF_ SG_ "GenSigDataID" STRING;
BA_DEF_DEF_ "CANFD_BRS" "1";
BA_DEF_DEF_ "GenSigStartValue" 0;
BA_DEF_DEF_ "VFrameFormat" "J1939PG";
BA_DEF_DEF_ "GenSigSendType" "NoSigSendType";
BA_DEF_DEF_ "GenMsgCycleTime" 0;
BA_DEF_DEF_ "GenMsgDelayTime" 0;
BA_DEF_DEF_ "GenMsgStartDelayTime" 0;
BA_DEF_DEF_ "GenMsgSendType" "NoMsgSendType";
BA_DEF_DEF_ "GenMsgILSupport" "Yes";
BA_DEF_DEF_ "NmAsrMessage" "No";
BA_DEF_DEF_ "GenSigFuncType" "NoFunction";
BA_DEF_DEF_ "GenSigDataID" "";

BA_ "GenMsgCycleTime" BO_ 565 300.000;
BA_ "GenMsgSendType" BO_ 565 0;
BA_ "VFrameFormat" BO_ 565 14;

BA_ "GenMsgCycleTime" BO_ 1154 900.000;
BA_ "GenMsgSendType" BO_ 1154 0;
BA_ "VFrameFormat" BO_ 1154 14;

BA_ "GenMsgCycleTime" BO_ 528 200.000;
BA_ "GenMsgSendType" BO_ 528 0;
BA_ "VFrameFormat" BO_ 528 14;

BA_ "GenMsgCycleTime" BO_ 880 700.000;
BA_ "GenMsgSendType" BO_ 880 0;
BA_ "VFrameFormat" BO_ 880 14;

BA_ "GenMsgCycleTime" BO_ 800 500.000;
BA_ "GenMsgSendType" BO_ 800 0;
BA_ "VFrameFormat" BO_ 800 14;

BA_ "GenMsgCycleTime" BO_ 264 20.000;
BA_ "GenMsgSendType" BO_ 264 0;
BA_ "VFrameFormat" BO_ 264 14;

BA_ "GenMsgDelayTime" BO_ 67 10.000;
BA_ "GenMsgSendType" BO_ 67 1;
BA_ "VFrameFormat" BO_ 67 14;
BA_ "GenSigSendType" SG_ 880 AccrPedlLnrAccrPedlRat 0;
BA_ "GenSigDataID" SG_ 880 AccrPedlLnrChks "0x2C3";
BA_ "GenSigFuncType" SG_ 880 AccrPedlLnrChks 15;
BA_ "GenSigSendType" SG_ 880 AccrPedlLnrChks 0;
BA_ "GenSigFuncType" SG_ 880 AccrPedlLnrCntr 16;
BA_ "GenSigSendType" SG_ 880 AccrPedlLnrCntr 0;
BA_ "GenSigSendType" SG_ 880 AccrPedlNotCmplPsd 0;
BA_ "GenSigDataID" SG_ 880 AccrPedlNotCmplPsdChks "0xCD";
BA_ "GenSigFuncType" SG_ 880 AccrPedlNotCmplPsdChks 15;
BA_ "GenSigSendType" SG_ 880 AccrPedlNotCmplPsdChks 0;
BA_ "GenSigStartValue" SG_ 880 AccrPedlNotCmplPsdChks 255;
BA_ "GenSigFuncType" SG_ 880 AccrPedlNotCmplPsdCntr 16;
BA_ "GenSigSendType" SG_ 880 AccrPedlNotCmplPsdCntr 0;
BA_ "GenSigSendType" SG_ 880 AccrPedlNotCmplPsdSts 0;
BA_ "GenSigSendType" SG_ 880 AccrPedlRatGrdt 0;
BA_ "GenSigSendType" SG_ 880 AmbTURaw 0;
BA_ "GenSigStartValue" SG_ 880 AmbTURaw 700;
BA_ "GenSigSendType" SG_ 1154 BattSnsrStReq 0;
BA_ "GenSigSendType" SG_ 67 BookTrvlFltSts 1;
BA_ "GenSigSendType" SG_ 67 BookTrvlSetResponse 1;
BA_ "GenSigSendType" SG_ 67 BookTrvlTiSetReqBookTrvlChrgnTi 1;
BA_ "GenSigStartValue" SG_ 67 BookTrvlTiSetReqBookTrvlChrgnTi 2047;
BA_ "GenSigSendType" SG_ 67 BookTrvlTiSetReqBookTrvlTiSetReq 1;
BA_ "GenSigDataID" SG_ 1154 BrkLiReqRegenChks "0x1B5F";
BA_ "GenSigFuncType" SG_ 1154 BrkLiReqRegenChks 15;
BA_ "GenSigSendType" SG_ 1154 BrkLiReqRegenChks 0;
BA_ "GenSigFuncType" SG_ 1154 BrkLiReqRegenCntr 16;
BA_ "GenSigSendType" SG_ 1154 BrkLiReqRegenCntr 0;
BA_ "GenSigSendType" SG_ 1154 BrkLiReqRegenOnOff 0;
BA_ "GenSigSendType" SG_ 565 BrkSysWarnIndcnReqSec 0;
BA_ "GenSigSendType" SG_ 565 CarLoctrActvnSts 0;
BA_ "GenSigSendType" SG_ 565 CcvVlvSts2PosSts 0;
BA_ "GenSigStartValue" SG_ 565 CcvVlvSts2PosSts 170.6666634;
BA_ "GenSigSendType" SG_ 565 CcvVlvStsARC 0;
BA_ "GenSigSendType" SG_ 565 CcvVlvStsIntFlt 0;
BA_ "GenSigSendType" SG_ 565 CcvVlvStsOprFlt 0;
BA_ "GenSigSendType" SG_ 565 CcvVlvStsTrqSts 0;
BA_ "GenSigSendType" SG_ 565 CcvmStsVlvBlkFlt 0;
BA_ "GenSigSendType" SG_ 565 CcvmStsVlvCalibSts 0;
BA_ "GenSigSendType" SG_ 565 CcvmStsVlvCmdPosnErr 0;
BA_ "GenSigSendType" SG_ 565 CcvmStsVlvLoTErr 0;
BA_ "GenSigSendType" SG_ 565 CcvmStsVlvMoveSts 0;
BA_ "GenSigSendType" SG_ 565 CcvmStsVlvNVMFlt 0;
BA_ "GenSigSendType" SG_ 565 CcvmStsVlvOpenCircFlt 0;
BA_ "GenSigSendType" SG_ 565 CcvmStsVlvOverTErr 0;
BA_ "GenSigSendType" SG_ 565 CcvmStsVlvOverTWarn 0;
BA_ "GenSigSendType" SG_ 565 CcvmStsVlvOverTrvlFlt 0;
BA_ "GenSigSendType" SG_ 565 CcvmStsVlvOverUErr 0;
BA_ "GenSigSendType" SG_ 565 CcvmStsVlvPosn 0;
BA_ "GenSigSendType" SG_ 565 CcvmStsVlvPosnCtrlTimeOutFlt 0;
BA_ "GenSigSendType" SG_ 565 CcvmStsVlvPosnUkwnFlt 0;
BA_ "GenSigSendType" SG_ 565 CcvmStsVlvPreHeatgSts 0;
BA_ "GenSigSendType" SG_ 565 CcvmStsVlvSelfLearnFlt 0;
BA_ "GenSigSendType" SG_ 565 CcvmStsVlvShoCircFlt 0;
BA_ "GenSigSendType" SG_ 565 CcvmStsVlvSpdLvlSts 0;
BA_ "GenSigSendType" SG_ 565 CcvmStsVlvUnderUErr 0;
BA_ "GenSigSendType" SG_ 565 ChdLockRightFailStsToHmi 0;
BA_ "GenSigStartValue" SG_ 565 ChdLockRightFailStsToHmi 2;
BA_ "GenSigSendType" SG_ 565 ChdPrtnLeftFailStsToHmi 0;
BA_ "GenSigStartValue" SG_ 565 ChdPrtnLeftFailStsToHmi 2;
BA_ "GenSigSendType" SG_ 264 ChdPrtnLeftSwReq 0;
BA_ "GenSigSendType" SG_ 264 ChdPrtnRightSwReq 0;
BA_ "GenSigSendType" SG_ 565 ChrgnSpd 0;
BA_ "GenSigSendType" SG_ 565 ClimaCmd 0;
BA_ "GenSigSendType" SG_ 565 CmprFbCmprI 0;
BA_ "GenSigSendType" SG_ 565 CmprFbCmprIPha 0;
BA_ "GenSigSendType" SG_ 565 CmprFbCmprSpd 0;
BA_ "GenSigSendType" SG_ 565 CmprFbCmprSts1 0;
BA_ "GenSigSendType" SG_ 565 CmprFbCmprSts2 0;
BA_ "GenSigSendType" SG_ 565 CmprFbCmprT1 0;
BA_ "GenSigStartValue" SG_ 565 CmprFbCmprT1 50;
BA_ "GenSigSendType" SG_ 565 CmprFbCmprT2 0;
BA_ "GenSigStartValue" SG_ 565 CmprFbCmprT2 50;
BA_ "GenSigSendType" SG_ 565 CmprFbCmprU 0;
BA_ "GenSigSendType" SG_ 800 CmprSpdAct 0;
BA_ "GenSigSendType" SG_ 67 CrashSts2 1;
BA_ "GenSigSendType" SG_ 565 CrashUnlckFailrSts 0;
BA_ "GenSigStartValue" SG_ 565 CrashUnlckFailrSts 2;
BA_ "GenSigSendType" SG_ 880 CrsCtrlrActvnOk 0;
BA_ "GenSigSendType" SG_ 67 DchaStopByTarDrvrIndcn 1;
BA_ "GenSigSendType" SG_ 880 DeactvtTestCom 0;
BA_ "GenSigSendType" SG_ 264 DispBattEgyIn 0;
BA_ "GenSigSendType" SG_ 264 DispBattEgyOut 0;
BA_ "GenSigSendType" SG_ 880 DrvrPrpsnTqReq 0;
BA_ "GenSigSendType" SG_ 528 DrvrSeatHeatgActlPwrCns 0;
BA_ "GenSigSendType" SG_ 565 DrvrSeatHeatgAutoSts 0;
BA_ "GenSigSendType" SG_ 528 DrvrSeatHeatgDesPwrCns 0;
BA_ "GenSigSendType" SG_ 264 DrvrSeatSnsrSts 0;
BA_ "GenSigSendType" SG_ 528 DrvrSeatVentnActlPwrCns 0;
BA_ "GenSigSendType" SG_ 565 DrvrSeatVentnAutoSts 0;
BA_ "GenSigSendType" SG_ 528 DrvrSeatVentnDesPwrCns 0;
BA_ "GenSigSendType" SG_ 528 DstEstimdToEmptyForDrvgElecPredTyp2 0;
BA_ "GenSigSendType" SG_ 1154 DtEngdStDtEngdFrnt 0;
BA_ "GenSigSendType" SG_ 1154 DtEngdStDtEngdRe 0;
BA_ "GenSigSendType" SG_ 1154 DtEngdStDtNotEngdFrnt 0;
BA_ "GenSigSendType" SG_ 1154 DtEngdStDtNotEngdRe 0;
BA_ "GenSigSendType" SG_ 528 EPedlDrvrIndcnMsg 0;
BA_ "GenSigSendType" SG_ 528 EPedlInhbnSts 0;
BA_ "GenSigSendType" SG_ 565 Edcp2PmpStsCooltPmpDryErr 0;
BA_ "GenSigSendType" SG_ 565 Edcp2PmpStsCooltPmpEmgyModSts 0;
BA_ "GenSigSendType" SG_ 565 Edcp2PmpStsCooltPmpErrSts 0;
BA_ "GenSigSendType" SG_ 565 Edcp2PmpStsCooltPmpI 0;
BA_ "GenSigSendType" SG_ 565 Edcp2PmpStsCooltPmpIErr 0;
BA_ "GenSigSendType" SG_ 565 Edcp2PmpStsCooltPmpMonrSpd 0;
BA_ "GenSigSendType" SG_ 565 Edcp2PmpStsCooltPmpPostRunSts 0;
BA_ "GenSigSendType" SG_ 565 Edcp2PmpStsCooltPmpSetPostRunReq 0;
BA_ "GenSigSendType" SG_ 565 Edcp2PmpStsCooltPmpSetSpdReq 0;
BA_ "GenSigSendType" SG_ 565 Edcp2PmpStsCooltPmpSpd 0;
BA_ "GenSigSendType" SG_ 565 Edcp2PmpStsCooltPmpT 0;
BA_ "GenSigStartValue" SG_ 565 Edcp2PmpStsCooltPmpT 100;
BA_ "GenSigSendType" SG_ 565 Edcp2PmpStsCooltPmpTErr 0;
BA_ "GenSigSendType" SG_ 565 Edcp2PmpStsCooltPmpU 0;
BA_ "GenSigSendType" SG_ 565 Edcp2PmpStsCooltPmpUErr 0;
BA_ "GenSigSendType" SG_ 565 Edcp2PmpStsCooltPmpUnstallSts 0;
BA_ "GenSigSendType" SG_ 565 EngForbidRespFromVMM 0;
BA_ "GenSigSendType" SG_ 565 EpbApplyEnaSec 0;
BA_ "GenSigSendType" SG_ 565 EpbRelsEnaSec 0;
BA_ "GenSigSendType" SG_ 565 ErsCmdByKey 0;
BA_ "GenSigSendType" SG_ 528 ErsDelayTiCfm 0;
BA_ "GenSigSendType" SG_ 528 ErsStrtRes 0;
BA_ "GenSigSendType" SG_ 565 HctvStsVlvBlkFlt 0;
BA_ "GenSigSendType" SG_ 565 HctvStsVlvCalibSts 0;
BA_ "GenSigSendType" SG_ 565 HctvStsVlvCmdPosnErr 0;
BA_ "GenSigSendType" SG_ 565 HctvStsVlvLoTErr 0;
BA_ "GenSigSendType" SG_ 565 HctvStsVlvMoveSts 0;
BA_ "GenSigSendType" SG_ 565 HctvStsVlvNVMFlt 0;
BA_ "GenSigSendType" SG_ 565 HctvStsVlvOpenCircFlt 0;
BA_ "GenSigSendType" SG_ 565 HctvStsVlvOverTErr 0;
BA_ "GenSigSendType" SG_ 565 HctvStsVlvOverTWarn 0;
BA_ "GenSigSendType" SG_ 565 HctvStsVlvOverTrvlFlt 0;
BA_ "GenSigSendType" SG_ 565 HctvStsVlvOverUErr 0;
BA_ "GenSigSendType" SG_ 565 HctvStsVlvPosn 0;
BA_ "GenSigSendType" SG_ 565 HctvStsVlvPosnCtrlTimeOutFlt 0;
BA_ "GenSigSendType" SG_ 565 HctvStsVlvPosnUkwnFlt 0;
BA_ "GenSigSendType" SG_ 565 HctvStsVlvPreHeatgSts 0;
BA_ "GenSigSendType" SG_ 565 HctvStsVlvSelfLearnFlt 0;
BA_ "GenSigSendType" SG_ 565 HctvStsVlvShoCircFlt 0;
BA_ "GenSigSendType" SG_ 565 HctvStsVlvSpdLvlSts 0;
BA_ "GenSigSendType" SG_ 565 HctvStsVlvUnderUErr 0;
BA_ "GenSigStartValue" SG_ 528 HealthOfEngOil 100;
BA_ "GenSigSendType" SG_ 565 HmiDefrstrElecStsFrnt 0;
BA_ "GenSigSendType" SG_ 565 HmiDefrstrElecStsMirrr 0;
BA_ "GenSigSendType" SG_ 565 HmiDefrstrElecStsRe 0;
BA_ "GenSigSendType" SG_ 528 HpcDeiceReq 0;
BA_ "GenSigSendType" SG_ 528 HpcHpCoolgPwrSts 0;
BA_ "GenSigSendType" SG_ 528 HpcHpHeatgPwrSts 0;
BA_ "GenSigSendType" SG_ 528 HpcHpModReq 0;
BA_ "GenSigSendType" SG_ 565 HvBattPmpStatCooltPmpDryErr 0;
BA_ "GenSigSendType" SG_ 565 HvBattPmpStatCooltPmpEmgyModSts 0;
BA_ "GenSigSendType" SG_ 565 HvBattPmpStatCooltPmpErrSts 0;
BA_ "GenSigSendType" SG_ 565 HvBattPmpStatCooltPmpI 0;
BA_ "GenSigSendType" SG_ 565 HvBattPmpStatCooltPmpIErr 0;
BA_ "GenSigSendType" SG_ 565 HvBattPmpStatCooltPmpMonrSpd 0;
BA_ "GenSigSendType" SG_ 565 HvBattPmpStatCooltPmpPostRunSts 0;
BA_ "GenSigSendType" SG_ 565 HvBattPmpStatCooltPmpSetPostRunReq 0;
BA_ "GenSigSendType" SG_ 565 HvBattPmpStatCooltPmpSetSpdReq 0;
BA_ "GenSigSendType" SG_ 565 HvBattPmpStatCooltPmpSpd 0;
BA_ "GenSigSendType" SG_ 565 HvBattPmpStatCooltPmpT 0;
BA_ "GenSigStartValue" SG_ 565 HvBattPmpStatCooltPmpT 100;
BA_ "GenSigSendType" SG_ 565 HvBattPmpStatCooltPmpTErr 0;
BA_ "GenSigSendType" SG_ 565 HvBattPmpStatCooltPmpU 0;
BA_ "GenSigSendType" SG_ 565 HvBattPmpStatCooltPmpUErr 0;
BA_ "GenSigSendType" SG_ 565 HvBattPmpStatCooltPmpUnstallSts 0;
BA_ "GenSigSendType" SG_ 528 HvBattThermPwrCns 0;
BA_ "GenSigSendType" SG_ 528 HvCabinThermPwrCns 0;
BA_ "GenSigSendType" SG_ 528 HvCooltHeatrEnad 0;
BA_ "GenSigSendType" SG_ 800 HvCooltHeatrEnadWhE2EChks 0;
BA_ "GenSigSendType" SG_ 800 HvCooltHeatrEnadWhE2ECntr 0;
BA_ "GenSigSendType" SG_ 800 HvCooltHeatrEnadWhE2EHvchEnad 0;
BA_ "GenSigSendType" SG_ 565 HvCooltHeatrICnsSig 0;
BA_ "GenSigSendType" SG_ 528 HvCooltHeatrStsSig 0;
BA_ "GenSigSendType" SG_ 565 HvHeatrPwrCnsDes 0;
BA_ "GenSigDataID" SG_ 528 HvSysRlyStsChks "0x15";
BA_ "GenSigFuncType" SG_ 528 HvSysRlyStsChks 15;
BA_ "GenSigSendType" SG_ 528 HvSysRlyStsChks 0;
BA_ "GenSigFuncType" SG_ 528 HvSysRlyStsCntr 16;
BA_ "GenSigSendType" SG_ 528 HvSysRlyStsCntr 0;
BA_ "GenSigSendType" SG_ 528 HvSysRlyStsHvSysRlySts 0;
BA_ "GenSigStartValue" SG_ 528 HvSysRlyStsHvSysRlySts 2;
BA_ "GenSigSendType" SG_ 528 HvacCooltFlowAct 0;
BA_ "GenSigSendType" SG_ 880 ImobBrkNrSerlReq 0;
BA_ "GenSigSendType" SG_ 880 ImobEngSts1 0;
BA_ "GenSigSendType" SG_ 880 ImobEngSts3 0;
BA_ "GenSigSendType" SG_ 565 ImobMgrWarnIndcn 0;
BA_ "GenSigSendType" SG_ 1154 IsgActvDampgModReq 0;
BA_ "GenSigStartValue" SG_ 1154 IsgActvDampgModReq 2;
BA_ "GenSigSendType" SG_ 1154 IsgModReq 0;
BA_ "GenSigSendType" SG_ 1154 IsgPwrLimMax 0;
BA_ "GenSigSendType" SG_ 1154 IsgPwrLimMin 0;
BA_ "GenSigStartValue" SG_ 1154 IsgPwrLimMin 1022;
BA_ "GenSigSendType" SG_ 1154 IsgSpdReq 0;
BA_ "GenSigDataID" SG_ 1154 IsgTqAllwdChks "0x50";
BA_ "GenSigFuncType" SG_ 1154 IsgTqAllwdChks 15;
BA_ "GenSigSendType" SG_ 1154 IsgTqAllwdChks 0;
BA_ "GenSigFuncType" SG_ 1154 IsgTqAllwdCntr 16;
BA_ "GenSigSendType" SG_ 1154 IsgTqAllwdCntr 0;
BA_ "GenSigSendType" SG_ 1154 IsgTqAllwdIsgTqAllwd 0;
BA_ "GenSigSendType" SG_ 565 KeyNotPrsntMsgToDrvr 0;
BA_ "GenSigSendType" SG_ 565 MotConsDrvCyc 0;
BA_ "GenSigDataID" SG_ 1154 OvrdDecelByDrvrChks "0x6E";
BA_ "GenSigFuncType" SG_ 1154 OvrdDecelByDrvrChks 15;
BA_ "GenSigSendType" SG_ 1154 OvrdDecelByDrvrChks 0;
BA_ "GenSigStartValue" SG_ 1154 OvrdDecelByDrvrChks 255;
BA_ "GenSigFuncType" SG_ 1154 OvrdDecelByDrvrCntr 16;
BA_ "GenSigSendType" SG_ 1154 OvrdDecelByDrvrCntr 0;
BA_ "GenSigSendType" SG_ 1154 OvrdDecelByDrvrOvrdDecelByDrvr 0;
BA_ "GenSigSendType" SG_ 528 PEMState 0;
BA_ "GenSigDataID" SG_ 1154 ParkByDrvrWhlsFrntSafeChks "0xA5";
BA_ "GenSigFuncType" SG_ 1154 ParkByDrvrWhlsFrntSafeChks 15;
BA_ "GenSigSendType" SG_ 1154 ParkByDrvrWhlsFrntSafeChks 0;
BA_ "GenSigFuncType" SG_ 1154 ParkByDrvrWhlsFrntSafeCntr 16;
BA_ "GenSigSendType" SG_ 1154 ParkByDrvrWhlsFrntSafeCntr 0;
BA_ "GenSigSendType" SG_ 1154 ParkByDrvrWhlsFrntSafeSts 0;
BA_ "GenSigDataID" SG_ 1154 PropLgtCtrlModCfmdChks "0x1E";
BA_ "GenSigFuncType" SG_ 1154 PropLgtCtrlModCfmdChks 15;
BA_ "GenSigSendType" SG_ 1154 PropLgtCtrlModCfmdChks 0;
BA_ "GenSigFuncType" SG_ 1154 PropLgtCtrlModCfmdCntr 16;
BA_ "GenSigSendType" SG_ 1154 PropLgtCtrlModCfmdCntr 0;
BA_ "GenSigSendType" SG_ 1154 PropLgtCtrlModCfmdLgtDegradation 0;
BA_ "GenSigSendType" SG_ 1154 PropLgtCtrlModCfmdPropLgtCtrlModCfmd 0;
BA_ "GenSigStartValue" SG_ 565 PrpsnErrIndcnReq 1;
BA_ "GenSigSendType" SG_ 1154 PrpsnTqFrntReq 0;
BA_ "GenSigSendType" SG_ 1154 PrpsnTqReReq 0;
BA_ "GenSigDataID" SG_ 1154 PtAllwdToTrsmActrSafeChks "0x3F";
BA_ "GenSigFuncType" SG_ 1154 PtAllwdToTrsmActrSafeChks 15;
BA_ "GenSigSendType" SG_ 1154 PtAllwdToTrsmActrSafeChks 0;
BA_ "GenSigFuncType" SG_ 1154 PtAllwdToTrsmActrSafeCntr 16;
BA_ "GenSigSendType" SG_ 1154 PtAllwdToTrsmActrSafeCntr 0;
BA_ "GenSigSendType" SG_ 1154 PtAllwdToTrsmActrSafePtAllwdToTrsmActr 0;
BA_ "GenSigSendType" SG_ 1154 PtBrkTqCpTot1 0;
BA_ "GenSigSendType" SG_ 1154 PtBrkTqCpTotQf 0;
BA_ "GenSigSendType" SG_ 1154 PtGearRatFrntAct 0;
BA_ "GenSigSendType" SG_ 1154 PtGearTar 0;
BA_ "GenSigSendType" SG_ 1154 PtJTotAtTrsmAxleOutp 0;
BA_ "GenSigDataID" SG_ 1154 PtJTotChks "0x110";
BA_ "GenSigFuncType" SG_ 1154 PtJTotChks 15;
BA_ "GenSigSendType" SG_ 1154 PtJTotChks 0;
BA_ "GenSigFuncType" SG_ 1154 PtJTotCntr 16;
BA_ "GenSigSendType" SG_ 1154 PtJTotCntr 0;
BA_ "GenSigStartValue" SG_ 880 PtReqToTrsmActr 4;
BA_ "GenSigSendType" SG_ 1154 PtRgnTarTqAtReAxleAtReAxle 0;
BA_ "GenSigSendType" SG_ 1154 PtRgnTarTqAtReAxleQf 0;
BA_ "GenSigSendType" SG_ 1154 PtTotRgnTarTq1 0;
BA_ "GenSigSendType" SG_ 1154 PtTotRgnTarTqQf 0;
BA_ "GenSigSendType" SG_ 1154 PtTqAtAxleAvlFrntMax 0;
BA_ "GenSigSendType" SG_ 1154 PtTqAtAxleAvlFrntMin 0;
BA_ "GenSigSendType" SG_ 1154 PtTqAtAxleAvlReMax 0;
BA_ "GenSigSendType" SG_ 1154 PtTqAtAxleAvlReMin 0;
BA_ "GenSigSendType" SG_ 880 PtTqTotDrgAtWhls 0;
BA_ "GenSigStartValue" SG_ 1154 PtWhlTqTar 6383;
BA_ "GenSigSendType" SG_ 528 RainSnsrStsToHMI 0;
BA_ "GenSigSendType" SG_ 1154 RlyCrashForHvsysReq 0;
BA_ "GenSigSendType" SG_ 565 RlyPwrDistbnCmd1WdIgnRlyExtCmd 0;
BA_ "GenSigSendType" SG_ 800 SafetyCrashFb 0;
BA_ "GenSigSendType" SG_ 528 SeatOccptAtRowSecMid2 0;
BA_ "GenSigStartValue" SG_ 528 SeatOccptAtRowSecMid2 1;
BA_ "GenSigSendType" SG_ 528 SeatOccptAtRowSecMidSnsSts2 0;
BA_ "GenSigSendType" SG_ 528 SlopReducEngCoeffSlopEqu12 0;
BA_ "GenSigSendType" SG_ 528 SlopReducEngCoeffSlopEqu2 0;
BA_ "GenSigSendType" SG_ 528 SlopReducEngCoeffSlopEqu4 0;
BA_ "GenSigSendType" SG_ 528 SlopReducEngCoeffSlopEqu6 0;
BA_ "GenSigSendType" SG_ 528 SlopReducEngCoeffSlopEqu9 0;
BA_ "GenSigSendType" SG_ 528 SlopRiseEngCoeffSlopEqu12 0;
BA_ "GenSigSendType" SG_ 528 SlopRiseEngCoeffSlopEqu2 0;
BA_ "GenSigSendType" SG_ 528 SlopRiseEngCoeffSlopEqu4 0;
BA_ "GenSigSendType" SG_ 528 SlopRiseEngCoeffSlopEqu6 0;
BA_ "GenSigSendType" SG_ 528 SlopRiseEngCoeffSlopEqu9 0;
BA_ "GenSigSendType" SG_ 528 SpdRelatWghtSpdEqu10 0;
BA_ "GenSigSendType" SG_ 528 SpdRelatWghtSpdEqu100 0;
BA_ "GenSigSendType" SG_ 528 SpdRelatWghtSpdEqu120 0;
BA_ "GenSigSendType" SG_ 528 SpdRelatWghtSpdEqu140 0;
BA_ "GenSigSendType" SG_ 528 SpdRelatWghtSpdEqu20 0;
BA_ "GenSigSendType" SG_ 528 SpdRelatWghtSpdEqu40 0;
BA_ "GenSigSendType" SG_ 528 SpdRelatWghtSpdEqu60 0;
BA_ "GenSigSendType" SG_ 528 SpdRelatWghtSpdEqu80 0;
BA_ "GenSigSendType" SG_ 565 SteerWhlHeatgAvlSts 0;
BA_ "GenSigSendType" SG_ 565 SteerWhlHeatgStrtAutCdnOk 0;
BA_ "GenSigSendType" SG_ 565 StrtInProgs 0;
BA_ "GenSigSendType" SG_ 565 StrtMsgToDrvr 0;
BA_ "GenSigSendType" SG_ 528 SwtStrt3 0;
BA_ "GenSigSendType" SG_ 528 SwtStrt4 0;
BA_ "GenSigSendType" SG_ 880 SwtTrClsSts 0;
BA_ "GenSigSendType" SG_ 565 SysDirIndcnFailr 0;
BA_ "GenSigSendType" SG_ 565 TInCooltAtStrtOfClima 0;
BA_ "GenSigStartValue" SG_ 565 TInCooltAtStrtOfClima 40;
BA_ "GenSigSendType" SG_ 880 ThermFctReq 0;
BA_ "GenSigSendType" SG_ 565 TrAntiPnch 0;
BA_ "GenSigSendType" SG_ 565 TrObstclDetn 0;
BA_ "GenSigSendType" SG_ 528 TrOpenerByFootOperCmd 0;
BA_ "GenSigStartValue" SG_ 1154 TrsmActrPosn2TrsmActrPosn 7;
BA_ "GenSigStartValue" SG_ 880 TrsmCluTEstimdOfClu0 32;
BA_ "GenSigSendType" SG_ 800 VFCVectorPOTBlockID 0;
BA_ "GenSigSendType" SG_ 800 VFCVectorPOTVFCid0 0;
BA_ "GenSigSendType" SG_ 800 VFCVectorPOTVFCid1 0;
BA_ "GenSigSendType" SG_ 800 VFCVectorPOTVFCid10 0;
BA_ "GenSigSendType" SG_ 800 VFCVectorPOTVFCid11 0;
BA_ "GenSigSendType" SG_ 800 VFCVectorPOTVFCid12 0;
BA_ "GenSigSendType" SG_ 800 VFCVectorPOTVFCid13 0;
BA_ "GenSigSendType" SG_ 800 VFCVectorPOTVFCid14 0;
BA_ "GenSigSendType" SG_ 800 VFCVectorPOTVFCid15 0;
BA_ "GenSigSendType" SG_ 800 VFCVectorPOTVFCid16 0;
BA_ "GenSigSendType" SG_ 800 VFCVectorPOTVFCid17 0;
BA_ "GenSigSendType" SG_ 800 VFCVectorPOTVFCid18 0;
BA_ "GenSigSendType" SG_ 800 VFCVectorPOTVFCid19 0;
BA_ "GenSigSendType" SG_ 800 VFCVectorPOTVFCid2 0;
BA_ "GenSigSendType" SG_ 800 VFCVectorPOTVFCid20 0;
BA_ "GenSigSendType" SG_ 800 VFCVectorPOTVFCid21 0;
BA_ "GenSigSendType" SG_ 800 VFCVectorPOTVFCid22 0;
BA_ "GenSigSendType" SG_ 800 VFCVectorPOTVFCid23 0;
BA_ "GenSigSendType" SG_ 800 VFCVectorPOTVFCid24 0;
BA_ "GenSigSendType" SG_ 800 VFCVectorPOTVFCid25 0;
BA_ "GenSigSendType" SG_ 800 VFCVectorPOTVFCid26 0;
BA_ "GenSigSendType" SG_ 800 VFCVectorPOTVFCid27 0;
BA_ "GenSigSendType" SG_ 800 VFCVectorPOTVFCid28 0;
BA_ "GenSigSendType" SG_ 800 VFCVectorPOTVFCid29 0;
BA_ "GenSigSendType" SG_ 800 VFCVectorPOTVFCid3 0;
BA_ "GenSigSendType" SG_ 800 VFCVectorPOTVFCid30 0;
BA_ "GenSigSendType" SG_ 800 VFCVectorPOTVFCid31 0;
BA_ "GenSigSendType" SG_ 800 VFCVectorPOTVFCid32 0;
BA_ "GenSigSendType" SG_ 800 VFCVectorPOTVFCid33 0;
BA_ "GenSigSendType" SG_ 800 VFCVectorPOTVFCid34 0;
BA_ "GenSigSendType" SG_ 800 VFCVectorPOTVFCid35 0;
BA_ "GenSigSendType" SG_ 800 VFCVectorPOTVFCid36 0;
BA_ "GenSigSendType" SG_ 800 VFCVectorPOTVFCid37 0;
BA_ "GenSigSendType" SG_ 800 VFCVectorPOTVFCid38 0;
BA_ "GenSigSendType" SG_ 800 VFCVectorPOTVFCid39 0;
BA_ "GenSigSendType" SG_ 800 VFCVectorPOTVFCid4 0;
BA_ "GenSigSendType" SG_ 800 VFCVectorPOTVFCid40 0;
BA_ "GenSigSendType" SG_ 800 VFCVectorPOTVFCid41 0;
BA_ "GenSigSendType" SG_ 800 VFCVectorPOTVFCid42 0;
BA_ "GenSigSendType" SG_ 800 VFCVectorPOTVFCid43 0;
BA_ "GenSigSendType" SG_ 800 VFCVectorPOTVFCid44 0;
BA_ "GenSigSendType" SG_ 800 VFCVectorPOTVFCid45 0;
BA_ "GenSigSendType" SG_ 800 VFCVectorPOTVFCid46 0;
BA_ "GenSigSendType" SG_ 800 VFCVectorPOTVFCid47 0;
BA_ "GenSigSendType" SG_ 800 VFCVectorPOTVFCid48 0;
BA_ "GenSigSendType" SG_ 800 VFCVectorPOTVFCid49 0;
BA_ "GenSigSendType" SG_ 800 VFCVectorPOTVFCid5 0;
BA_ "GenSigSendType" SG_ 800 VFCVectorPOTVFCid50 0;
BA_ "GenSigSendType" SG_ 800 VFCVectorPOTVFCid51 0;
BA_ "GenSigSendType" SG_ 800 VFCVectorPOTVFCid52 0;
BA_ "GenSigSendType" SG_ 800 VFCVectorPOTVFCid53 0;
BA_ "GenSigSendType" SG_ 800 VFCVectorPOTVFCid54 0;
BA_ "GenSigSendType" SG_ 800 VFCVectorPOTVFCid55 0;
BA_ "GenSigSendType" SG_ 800 VFCVectorPOTVFCid56 0;
BA_ "GenSigSendType" SG_ 800 VFCVectorPOTVFCid57 0;
BA_ "GenSigSendType" SG_ 800 VFCVectorPOTVFCid58 0;
BA_ "GenSigSendType" SG_ 800 VFCVectorPOTVFCid59 0;
BA_ "GenSigSendType" SG_ 800 VFCVectorPOTVFCid6 0;
BA_ "GenSigSendType" SG_ 800 VFCVectorPOTVFCid60 0;
BA_ "GenSigSendType" SG_ 800 VFCVectorPOTVFCid61 0;
BA_ "GenSigSendType" SG_ 800 VFCVectorPOTVFCid7 0;
BA_ "GenSigSendType" SG_ 800 VFCVectorPOTVFCid8 0;
BA_ "GenSigSendType" SG_ 800 VFCVectorPOTVFCid9 0;
BA_ "GenSigSendType" SG_ 800 VFCVectorSRSBlockID 0;
BA_ "GenSigSendType" SG_ 800 VFCVectorSRSVFCid0 0;
BA_ "GenSigSendType" SG_ 800 VFCVectorSRSVFCid1 0;
BA_ "GenSigSendType" SG_ 800 VFCVectorSRSVFCid10 0;
BA_ "GenSigSendType" SG_ 800 VFCVectorSRSVFCid11 0;
BA_ "GenSigSendType" SG_ 800 VFCVectorSRSVFCid12 0;
BA_ "GenSigSendType" SG_ 800 VFCVectorSRSVFCid13 0;
BA_ "GenSigSendType" SG_ 800 VFCVectorSRSVFCid14 0;
BA_ "GenSigSendType" SG_ 800 VFCVectorSRSVFCid15 0;
BA_ "GenSigSendType" SG_ 800 VFCVectorSRSVFCid16 0;
BA_ "GenSigSendType" SG_ 800 VFCVectorSRSVFCid17 0;
BA_ "GenSigSendType" SG_ 800 VFCVectorSRSVFCid18 0;
BA_ "GenSigSendType" SG_ 800 VFCVectorSRSVFCid19 0;
BA_ "GenSigSendType" SG_ 800 VFCVectorSRSVFCid2 0;
BA_ "GenSigSendType" SG_ 800 VFCVectorSRSVFCid20 0;
BA_ "GenSigSendType" SG_ 800 VFCVectorSRSVFCid21 0;
BA_ "GenSigSendType" SG_ 800 VFCVectorSRSVFCid22 0;
BA_ "GenSigSendType" SG_ 800 VFCVectorSRSVFCid23 0;
BA_ "GenSigSendType" SG_ 800 VFCVectorSRSVFCid24 0;
BA_ "GenSigSendType" SG_ 800 VFCVectorSRSVFCid25 0;
BA_ "GenSigSendType" SG_ 800 VFCVectorSRSVFCid26 0;
BA_ "GenSigSendType" SG_ 800 VFCVectorSRSVFCid27 0;
BA_ "GenSigSendType" SG_ 800 VFCVectorSRSVFCid28 0;
BA_ "GenSigSendType" SG_ 800 VFCVectorSRSVFCid29 0;
BA_ "GenSigSendType" SG_ 800 VFCVectorSRSVFCid3 0;
BA_ "GenSigSendType" SG_ 800 VFCVectorSRSVFCid30 0;
BA_ "GenSigSendType" SG_ 800 VFCVectorSRSVFCid31 0;
BA_ "GenSigSendType" SG_ 800 VFCVectorSRSVFCid32 0;
BA_ "GenSigSendType" SG_ 800 VFCVectorSRSVFCid33 0;
BA_ "GenSigSendType" SG_ 800 VFCVectorSRSVFCid34 0;
BA_ "GenSigSendType" SG_ 800 VFCVectorSRSVFCid35 0;
BA_ "GenSigSendType" SG_ 800 VFCVectorSRSVFCid36 0;
BA_ "GenSigSendType" SG_ 800 VFCVectorSRSVFCid37 0;
BA_ "GenSigSendType" SG_ 800 VFCVectorSRSVFCid38 0;
BA_ "GenSigSendType" SG_ 800 VFCVectorSRSVFCid39 0;
BA_ "GenSigSendType" SG_ 800 VFCVectorSRSVFCid4 0;
BA_ "GenSigSendType" SG_ 800 VFCVectorSRSVFCid40 0;
BA_ "GenSigSendType" SG_ 800 VFCVectorSRSVFCid41 0;
BA_ "GenSigSendType" SG_ 800 VFCVectorSRSVFCid42 0;
BA_ "GenSigSendType" SG_ 800 VFCVectorSRSVFCid43 0;
BA_ "GenSigSendType" SG_ 800 VFCVectorSRSVFCid44 0;
BA_ "GenSigSendType" SG_ 800 VFCVectorSRSVFCid45 0;
BA_ "GenSigSendType" SG_ 800 VFCVectorSRSVFCid46 0;
BA_ "GenSigSendType" SG_ 800 VFCVectorSRSVFCid47 0;
BA_ "GenSigSendType" SG_ 800 VFCVectorSRSVFCid48 0;
BA_ "GenSigSendType" SG_ 800 VFCVectorSRSVFCid49 0;
BA_ "GenSigSendType" SG_ 800 VFCVectorSRSVFCid5 0;
BA_ "GenSigSendType" SG_ 800 VFCVectorSRSVFCid50 0;
BA_ "GenSigSendType" SG_ 800 VFCVectorSRSVFCid51 0;
BA_ "GenSigSendType" SG_ 800 VFCVectorSRSVFCid52 0;
BA_ "GenSigSendType" SG_ 800 VFCVectorSRSVFCid53 0;
BA_ "GenSigSendType" SG_ 800 VFCVectorSRSVFCid54 0;
BA_ "GenSigSendType" SG_ 800 VFCVectorSRSVFCid55 0;
BA_ "GenSigSendType" SG_ 800 VFCVectorSRSVFCid56 0;
BA_ "GenSigSendType" SG_ 800 VFCVectorSRSVFCid57 0;
BA_ "GenSigSendType" SG_ 800 VFCVectorSRSVFCid58 0;
BA_ "GenSigSendType" SG_ 800 VFCVectorSRSVFCid59 0;
BA_ "GenSigSendType" SG_ 800 VFCVectorSRSVFCid6 0;
BA_ "GenSigSendType" SG_ 800 VFCVectorSRSVFCid60 0;
BA_ "GenSigSendType" SG_ 800 VFCVectorSRSVFCid61 0;
BA_ "GenSigSendType" SG_ 800 VFCVectorSRSVFCid7 0;
BA_ "GenSigSendType" SG_ 800 VFCVectorSRSVFCid8 0;
BA_ "GenSigSendType" SG_ 800 VFCVectorSRSVFCid9 0;
BA_ "GenSigSendType" SG_ 800 VFCVectorZCUDSBlockID 0;
BA_ "GenSigSendType" SG_ 800 VFCVectorZCUDSVFCid0 0;
BA_ "GenSigSendType" SG_ 800 VFCVectorZCUDSVFCid1 0;
BA_ "GenSigSendType" SG_ 800 VFCVectorZCUDSVFCid10 0;
BA_ "GenSigSendType" SG_ 800 VFCVectorZCUDSVFCid11 0;
BA_ "GenSigSendType" SG_ 800 VFCVectorZCUDSVFCid12 0;
BA_ "GenSigSendType" SG_ 800 VFCVectorZCUDSVFCid13 0;
BA_ "GenSigSendType" SG_ 800 VFCVectorZCUDSVFCid14 0;
BA_ "GenSigSendType" SG_ 800 VFCVectorZCUDSVFCid15 0;
BA_ "GenSigSendType" SG_ 800 VFCVectorZCUDSVFCid16 0;
BA_ "GenSigSendType" SG_ 800 VFCVectorZCUDSVFCid17 0;
BA_ "GenSigSendType" SG_ 800 VFCVectorZCUDSVFCid18 0;
BA_ "GenSigSendType" SG_ 800 VFCVectorZCUDSVFCid19 0;
BA_ "GenSigSendType" SG_ 800 VFCVectorZCUDSVFCid2 0;
BA_ "GenSigSendType" SG_ 800 VFCVectorZCUDSVFCid20 0;
BA_ "GenSigSendType" SG_ 800 VFCVectorZCUDSVFCid21 0;
BA_ "GenSigSendType" SG_ 800 VFCVectorZCUDSVFCid22 0;
BA_ "GenSigSendType" SG_ 800 VFCVectorZCUDSVFCid23 0;
BA_ "GenSigSendType" SG_ 800 VFCVectorZCUDSVFCid24 0;
BA_ "GenSigSendType" SG_ 800 VFCVectorZCUDSVFCid25 0;
BA_ "GenSigSendType" SG_ 800 VFCVectorZCUDSVFCid26 0;
BA_ "GenSigSendType" SG_ 800 VFCVectorZCUDSVFCid27 0;
BA_ "GenSigSendType" SG_ 800 VFCVectorZCUDSVFCid28 0;
BA_ "GenSigSendType" SG_ 800 VFCVectorZCUDSVFCid29 0;
BA_ "GenSigSendType" SG_ 800 VFCVectorZCUDSVFCid3 0;
BA_ "GenSigSendType" SG_ 800 VFCVectorZCUDSVFCid30 0;
BA_ "GenSigSendType" SG_ 800 VFCVectorZCUDSVFCid31 0;
BA_ "GenSigSendType" SG_ 800 VFCVectorZCUDSVFCid32 0;
BA_ "GenSigSendType" SG_ 800 VFCVectorZCUDSVFCid33 0;
BA_ "GenSigSendType" SG_ 800 VFCVectorZCUDSVFCid34 0;
BA_ "GenSigSendType" SG_ 800 VFCVectorZCUDSVFCid35 0;
BA_ "GenSigSendType" SG_ 800 VFCVectorZCUDSVFCid36 0;
BA_ "GenSigSendType" SG_ 800 VFCVectorZCUDSVFCid37 0;
BA_ "GenSigSendType" SG_ 800 VFCVectorZCUDSVFCid38 0;
BA_ "GenSigSendType" SG_ 800 VFCVectorZCUDSVFCid39 0;
BA_ "GenSigSendType" SG_ 800 VFCVectorZCUDSVFCid4 0;
BA_ "GenSigSendType" SG_ 800 VFCVectorZCUDSVFCid40 0;
BA_ "GenSigSendType" SG_ 800 VFCVectorZCUDSVFCid41 0;
BA_ "GenSigSendType" SG_ 800 VFCVectorZCUDSVFCid42 0;
BA_ "GenSigSendType" SG_ 800 VFCVectorZCUDSVFCid43 0;
BA_ "GenSigSendType" SG_ 800 VFCVectorZCUDSVFCid44 0;
BA_ "GenSigSendType" SG_ 800 VFCVectorZCUDSVFCid45 0;
BA_ "GenSigSendType" SG_ 800 VFCVectorZCUDSVFCid46 0;
BA_ "GenSigSendType" SG_ 800 VFCVectorZCUDSVFCid47 0;
BA_ "GenSigSendType" SG_ 800 VFCVectorZCUDSVFCid48 0;
BA_ "GenSigSendType" SG_ 800 VFCVectorZCUDSVFCid49 0;
BA_ "GenSigSendType" SG_ 800 VFCVectorZCUDSVFCid5 0;
BA_ "GenSigSendType" SG_ 800 VFCVectorZCUDSVFCid50 0;
BA_ "GenSigSendType" SG_ 800 VFCVectorZCUDSVFCid51 0;
BA_ "GenSigSendType" SG_ 800 VFCVectorZCUDSVFCid52 0;
BA_ "GenSigSendType" SG_ 800 VFCVectorZCUDSVFCid53 0;
BA_ "GenSigSendType" SG_ 800 VFCVectorZCUDSVFCid54 0;
BA_ "GenSigSendType" SG_ 800 VFCVectorZCUDSVFCid55 0;
BA_ "GenSigSendType" SG_ 800 VFCVectorZCUDSVFCid56 0;
BA_ "GenSigSendType" SG_ 800 VFCVectorZCUDSVFCid57 0;
BA_ "GenSigSendType" SG_ 800 VFCVectorZCUDSVFCid58 0;
BA_ "GenSigSendType" SG_ 800 VFCVectorZCUDSVFCid59 0;
BA_ "GenSigSendType" SG_ 800 VFCVectorZCUDSVFCid6 0;
BA_ "GenSigSendType" SG_ 800 VFCVectorZCUDSVFCid60 0;
BA_ "GenSigSendType" SG_ 800 VFCVectorZCUDSVFCid61 0;
BA_ "GenSigSendType" SG_ 800 VFCVectorZCUDSVFCid7 0;
BA_ "GenSigSendType" SG_ 800 VFCVectorZCUDSVFCid8 0;
BA_ "GenSigSendType" SG_ 800 VFCVectorZCUDSVFCid9 0;
VAL_ 565 BrkSysWarnIndcnReqSec 0 "OnOff2_On" 1 "OnOff2_Off";
VAL_ 565 CarLoctrActvnSts 0 "ActvnWithMsg_Idle" 1 "ActvnWithMsg_Activation_Successful" 2 "ActvnWithMsg_Activation_Fail";
VAL_ 565 CcvmStsVlvBlkFlt 0 "Boolean_FALSE" 1 "Boolean_TRUE";
VAL_ 565 CcvmStsVlvCalibSts 0 "VlvCalibSts_NotInitialized" 1 "VlvCalibSts_Initializing" 2 "VlvCalibSts_Initialized" 3 "VlvCalibSts_Reserved";
VAL_ 565 CcvmStsVlvCmdPosnErr 0 "Boolean_FALSE" 1 "Boolean_TRUE";
VAL_ 565 CcvmStsVlvLoTErr 0 "Boolean_FALSE" 1 "Boolean_TRUE";
VAL_ 565 CcvmStsVlvMoveSts 0 "Boolean_FALSE" 1 "Boolean_TRUE";
VAL_ 565 CcvmStsVlvNVMFlt 0 "Boolean_FALSE" 1 "Boolean_TRUE";
VAL_ 565 CcvmStsVlvOpenCircFlt 0 "Boolean_FALSE" 1 "Boolean_TRUE";
VAL_ 565 CcvmStsVlvOverTErr 0 "Boolean_FALSE" 1 "Boolean_TRUE";
VAL_ 565 CcvmStsVlvOverTrvlFlt 0 "Boolean_FALSE" 1 "Boolean_TRUE";
VAL_ 565 CcvmStsVlvOverTWarn 0 "Boolean_FALSE" 1 "Boolean_TRUE";
VAL_ 565 CcvmStsVlvOverUErr 0 "Boolean_FALSE" 1 "Boolean_TRUE";
VAL_ 565 CcvmStsVlvPosnCtrlTimeOutFlt 0 "Boolean_FALSE" 1 "Boolean_TRUE";
VAL_ 565 CcvmStsVlvPosnUkwnFlt 0 "Boolean_FALSE" 1 "Boolean_TRUE";
VAL_ 565 CcvmStsVlvPreHeatgSts 0 "Boolean_FALSE" 1 "Boolean_TRUE";
VAL_ 565 CcvmStsVlvSelfLearnFlt 0 "Boolean_FALSE" 1 "Boolean_TRUE";
VAL_ 565 CcvmStsVlvShoCircFlt 0 "Boolean_FALSE" 1 "Boolean_TRUE";
VAL_ 565 CcvmStsVlvSpdLvlSts 0 "VlvSpdLvlReq_Invalid" 1 "VlvSpdLvlReq_Level1" 2 "VlvSpdLvlReq_Level2" 3 "VlvSpdLvlReq_Reserved";
VAL_ 565 CcvmStsVlvUnderUErr 0 "Boolean_FALSE" 1 "Boolean_TRUE";
VAL_ 565 CcvVlvStsIntFlt 0 "Boolean_FALSE" 1 "Boolean_TRUE";
VAL_ 565 CcvVlvStsOprFlt 0 "Boolean_FALSE" 1 "Boolean_TRUE";
VAL_ 565 CcvVlvStsTrqSts 0 "VlvTqSts_NoTorque" 1 "VlvTqSts_NominalTorque" 2 "VlvTqSts_Boost20perc" 3 "VlvTqSts_Boost40perc" 4 "VlvTqSts_Boost60perc" 5 "VlvTqSts_Boost80perc" 6 "VlvTqSts_Boost100perc";
VAL_ 565 ChdLockRightFailStsToHmi 0 "OnOffSafe1_OnOffSafeInvld1" 1 "OnOffSafe1_OnOffSafeOn" 2 "OnOffSafe1_OnOffSafeOff" 3 "OnOffSafe1_OnOffSafeInvld2";
VAL_ 565 ChdPrtnLeftFailStsToHmi 0 "OnOffSafe1_OnOffSafeInvld1" 1 "OnOffSafe1_OnOffSafeOn" 2 "OnOffSafe1_OnOffSafeOff" 3 "OnOffSafe1_OnOffSafeInvld2";
VAL_ 565 ClimaCmd 0 "OkNotOk_NotOk" 1 "OkNotOk_Ok";
VAL_ 565 CmprFbCmprSts1 0 "CmprSts_CmprOff" 1 "CmprSts_CmprOn" 2 "CmprSts_CmprPwrLimd" 3 "CmprSts_CmprPreHeat" 4 "CmprSts_Reserved1" 5 "CmprSts_Reserved2" 6 "CmprSts_Reserved3" 7 "CmprSts_SigNotAvl";
VAL_ 565 CmprFbCmprSts2 0 "CompStat_NormalOperation" 1 "CompStat_DegradedOperation" 2 "CompStat_Inoperative";
VAL_ 565 CrashUnlckFailrSts 0 "OnOffSafe1_OnOffSafeInvld1" 1 "OnOffSafe1_OnOffSafeOn" 2 "OnOffSafe1_OnOffSafeOff" 3 "OnOffSafe1_OnOffSafeInvld2";
VAL_ 565 DrvrSeatHeatgAutoSts 0 "OffOnErrInvalid_Off" 1 "OffOnErrInvalid_On" 2 "OffOnErrInvalid_Err" 3 "OffOnErrInvalid_Invalid";
VAL_ 565 DrvrSeatVentnAutoSts 0 "OffOnErrInvalid_Off" 1 "OffOnErrInvalid_On" 2 "OffOnErrInvalid_Err" 3 "OffOnErrInvalid_Invalid";
VAL_ 565 Edcp2PmpStsCooltPmpDryErr 0 "CooltPmpDryErr_RunDryNotDetd" 1 "CooltPmpDryErr_RunDryDetd" 2 "CooltPmpDryErr_Resd1" 3 "CooltPmpDryErr_Resd2";
VAL_ 565 Edcp2PmpStsCooltPmpEmgyModSts 0 "CooltPmpEmgyModSts_EmgyRunNotActv" 1 "CooltPmpEmgyModSts_EmgyRunActv" 2 "CooltPmpEmgyModSts_Resd1" 3 "CooltPmpEmgyModSts_Resd2";
VAL_ 565 Edcp2PmpStsCooltPmpErrSts 0 "CooltPmpErrSts_StNoErr" 1 "CooltPmpErrSts_StErr" 2 "CooltPmpErrSts_StNewErr" 3 "CooltPmpErrSts_Resd";
VAL_ 565 Edcp2PmpStsCooltPmpIErr 0 "CooltPmpIErr_INoErr" 1 "CooltPmpIErr_IErr" 2 "CooltPmpIErr_Resd1" 3 "CooltPmpIErr_Resd2";
VAL_ 565 Edcp2PmpStsCooltPmpMonrSpd 0 "CooltPmpMonrSpd_MonrSpdActv" 1 "CooltPmpMonrSpd_MonrSpdNoActv" 2 "CooltPmpMonrSpd_Resd1" 3 "CooltPmpMonrSpd_Resd2";
VAL_ 565 Edcp2PmpStsCooltPmpPostRunSts 0 "CooltPmpPostRunSts_CooltPmpPostRunFinshd" 1 "CooltPmpPostRunSts_CooltPmpPostRunCncld" 2 "CooltPmpPostRunSts_Resd1" 3 "CooltPmpPostRunSts_Resd2";
VAL_ 565 Edcp2PmpStsCooltPmpSetPostRunReq 0 "CooltPmpSetPostRunReq_CooltPmpSetNoPostRun" 1 "CooltPmpSetPostRunReq_CooltPmpSetPostRun1" 2 "CooltPmpSetPostRunReq_CooltPmpSetPostRun2" 3 "CooltPmpSetPostRunReq_CooltPmpSetPostRun3" 4 "CooltPmpSetPostRunReq_CooltPmpSetPostRun4" 5 "CooltPmpSetPostRunReq_CooltPmpSetPostRun5" 6 "CooltPmpSetPostRunReq_Resd1" 7 "CooltPmpSetPostRunReq_Resd2";
VAL_ 565 Edcp2PmpStsCooltPmpTErr 0 "CooltPmpTErr_CooltPmpNoTErr" 1 "CooltPmpTErr_CooltPmpTErr" 2 "CooltPmpTErr_Resd1" 3 "CooltPmpTErr_Resd2";
VAL_ 565 Edcp2PmpStsCooltPmpUErr 0 "CooltPmpUErr_CooltPmpNoUErr" 1 "CooltPmpUErr_CooltPmpUErr" 2 "CooltPmpUErr_Resd1" 3 "CooltPmpUErr_Resd2";
VAL_ 565 Edcp2PmpStsCooltPmpUnstallSts 0 "CooltPmpUnstallSts_CooltPmpUnstallNotActv" 1 "CooltPmpUnstallSts_CooltPmpUnstallActv" 2 "CooltPmpUnstallSts_Resd1" 3 "CooltPmpUnstallSts_Resd2";
VAL_ 565 EngForbidRespFromVMM 0 "NoYes1_No" 1 "NoYes1_Yes";
VAL_ 565 EpbApplyEnaSec 0 "YesNo2_No" 1 "YesNo2_Yes";
VAL_ 565 EpbRelsEnaSec 0 "YesNo2_No" 1 "YesNo2_Yes";
VAL_ 565 ErsCmdByKey 0 "ErsCmd_ErsCmdNotSet" 1 "ErsCmd_ErsCmdOn" 2 "ErsCmd_ErsCmdOff";
VAL_ 565 HctvStsVlvBlkFlt 0 "Boolean_FALSE" 1 "Boolean_TRUE";
VAL_ 565 HctvStsVlvCalibSts 0 "VlvCalibSts_NotInitialized" 1 "VlvCalibSts_Initializing" 2 "VlvCalibSts_Initialized" 3 "VlvCalibSts_Reserved";
VAL_ 565 HctvStsVlvCmdPosnErr 0 "Boolean_FALSE" 1 "Boolean_TRUE";
VAL_ 565 HctvStsVlvLoTErr 0 "Boolean_FALSE" 1 "Boolean_TRUE";
VAL_ 565 HctvStsVlvMoveSts 0 "Boolean_FALSE" 1 "Boolean_TRUE";
VAL_ 565 HctvStsVlvNVMFlt 0 "Boolean_FALSE" 1 "Boolean_TRUE";
VAL_ 565 HctvStsVlvOpenCircFlt 0 "Boolean_FALSE" 1 "Boolean_TRUE";
VAL_ 565 HctvStsVlvOverTErr 0 "Boolean_FALSE" 1 "Boolean_TRUE";
VAL_ 565 HctvStsVlvOverTrvlFlt 0 "Boolean_FALSE" 1 "Boolean_TRUE";
VAL_ 565 HctvStsVlvOverTWarn 0 "Boolean_FALSE" 1 "Boolean_TRUE";
VAL_ 565 HctvStsVlvOverUErr 0 "Boolean_FALSE" 1 "Boolean_TRUE";
VAL_ 565 HctvStsVlvPosnCtrlTimeOutFlt 0 "Boolean_FALSE" 1 "Boolean_TRUE";
VAL_ 565 HctvStsVlvPosnUkwnFlt 0 "Boolean_FALSE" 1 "Boolean_TRUE";
VAL_ 565 HctvStsVlvPreHeatgSts 0 "Boolean_FALSE" 1 "Boolean_TRUE";
VAL_ 565 HctvStsVlvSelfLearnFlt 0 "Boolean_FALSE" 1 "Boolean_TRUE";
VAL_ 565 HctvStsVlvShoCircFlt 0 "Boolean_FALSE" 1 "Boolean_TRUE";
VAL_ 565 HctvStsVlvSpdLvlSts 0 "VlvSpdLvlReq_Invalid" 1 "VlvSpdLvlReq_Level1" 2 "VlvSpdLvlReq_Level2" 3 "VlvSpdLvlReq_Reserved";
VAL_ 565 HctvStsVlvUnderUErr 0 "Boolean_FALSE" 1 "Boolean_TRUE";
VAL_ 565 HmiDefrstrElecStsFrnt 0 "ActrDefrstSts_Off" 1 "ActrDefrstSts_On" 2 "ActrDefrstSts_Limited" 3 "ActrDefrstSts_NotAvailable" 4 "ActrDefrstSts_TmrOff" 5 "ActrDefrstSts_AutoCdn";
VAL_ 565 HmiDefrstrElecStsMirrr 0 "ActrDefrstSts_Off" 1 "ActrDefrstSts_On" 2 "ActrDefrstSts_Limited" 3 "ActrDefrstSts_NotAvailable" 4 "ActrDefrstSts_TmrOff" 5 "ActrDefrstSts_AutoCdn";
VAL_ 565 HmiDefrstrElecStsRe 0 "ActrDefrstSts_Off" 1 "ActrDefrstSts_On" 2 "ActrDefrstSts_Limited" 3 "ActrDefrstSts_NotAvailable" 4 "ActrDefrstSts_TmrOff" 5 "ActrDefrstSts_AutoCdn";
VAL_ 565 HvBattPmpStatCooltPmpDryErr 0 "CooltPmpDryErr_RunDryNotDetd" 1 "CooltPmpDryErr_RunDryDetd" 2 "CooltPmpDryErr_Resd1" 3 "CooltPmpDryErr_Resd2";
VAL_ 565 HvBattPmpStatCooltPmpEmgyModSts 0 "CooltPmpEmgyModSts_EmgyRunNotActv" 1 "CooltPmpEmgyModSts_EmgyRunActv" 2 "CooltPmpEmgyModSts_Resd1" 3 "CooltPmpEmgyModSts_Resd2";
VAL_ 565 HvBattPmpStatCooltPmpErrSts 0 "CooltPmpErrSts_StNoErr" 1 "CooltPmpErrSts_StErr" 2 "CooltPmpErrSts_StNewErr" 3 "CooltPmpErrSts_Resd";
VAL_ 565 HvBattPmpStatCooltPmpIErr 0 "CooltPmpIErr_INoErr" 1 "CooltPmpIErr_IErr" 2 "CooltPmpIErr_Resd1" 3 "CooltPmpIErr_Resd2";
VAL_ 565 HvBattPmpStatCooltPmpMonrSpd 0 "CooltPmpMonrSpd_MonrSpdActv" 1 "CooltPmpMonrSpd_MonrSpdNoActv" 2 "CooltPmpMonrSpd_Resd1" 3 "CooltPmpMonrSpd_Resd2";
VAL_ 565 HvBattPmpStatCooltPmpPostRunSts 0 "CooltPmpPostRunSts_CooltPmpPostRunFinshd" 1 "CooltPmpPostRunSts_CooltPmpPostRunCncld" 2 "CooltPmpPostRunSts_Resd1" 3 "CooltPmpPostRunSts_Resd2";
VAL_ 565 HvBattPmpStatCooltPmpSetPostRunReq 0 "CooltPmpSetPostRunReq_CooltPmpSetNoPostRun" 1 "CooltPmpSetPostRunReq_CooltPmpSetPostRun1" 2 "CooltPmpSetPostRunReq_CooltPmpSetPostRun2" 3 "CooltPmpSetPostRunReq_CooltPmpSetPostRun3" 4 "CooltPmpSetPostRunReq_CooltPmpSetPostRun4" 5 "CooltPmpSetPostRunReq_CooltPmpSetPostRun5" 6 "CooltPmpSetPostRunReq_Resd1" 7 "CooltPmpSetPostRunReq_Resd2";
VAL_ 565 HvBattPmpStatCooltPmpTErr 0 "CooltPmpTErr_CooltPmpNoTErr" 1 "CooltPmpTErr_CooltPmpTErr" 2 "CooltPmpTErr_Resd1" 3 "CooltPmpTErr_Resd2";
VAL_ 565 HvBattPmpStatCooltPmpUErr 0 "CooltPmpUErr_CooltPmpNoUErr" 1 "CooltPmpUErr_CooltPmpUErr" 2 "CooltPmpUErr_Resd1" 3 "CooltPmpUErr_Resd2";
VAL_ 565 HvBattPmpStatCooltPmpUnstallSts 0 "CooltPmpUnstallSts_CooltPmpUnstallNotActv" 1 "CooltPmpUnstallSts_CooltPmpUnstallActv" 2 "CooltPmpUnstallSts_Resd1" 3 "CooltPmpUnstallSts_Resd2";
VAL_ 565 ImobMgrWarnIndcn 0 "ImobMgrWarnIndcn_ImobNoWarnIndcn" 1 "ImobMgrWarnIndcn_ImobVehImobnRem" 2 "ImobMgrWarnIndcn_Tbd";
VAL_ 565 KeyNotPrsntMsgToDrvr 0 "Boolean_FALSE" 1 "Boolean_TRUE";
VAL_ 565 PrpsnErrIndcnReq 1 "MilSt_Off" 2 "MilSt_On" 3 "MilSt_Blink";
VAL_ 565 RlyPwrDistbnCmd1WdIgnRlyExtCmd 0 "OnOff1_Off" 1 "OnOff1_On";
VAL_ 565 SteerWhlHeatgAvlSts 0 "StsFd_None" 1 "StsFd_On" 2 "StsFd_Off" 3 "StsFd_Error" 4 "StsFd_Functionallimit" 5 "StsFd_Energylimit" 6 "StsFd_Resvd1" 7 "StsFd_Resvd2";
VAL_ 565 SteerWhlHeatgStrtAutCdnOk 0 "OkNotOk_NotOk" 1 "OkNotOk_Ok";
VAL_ 565 StrtInProgs 0 "StrtInProgs1_StrtStsOff" 1 "StrtInProgs1_StrtStsImminent" 2 "StrtInProgs1_StrtStsStrtng" 3 "StrtInProgs1_StrtStsRunng";
VAL_ 565 StrtMsgToDrvr 0 "StrtMsg2_NoMsg" 1 "StrtMsg2_Msg1" 2 "StrtMsg2_Msg2" 3 "StrtMsg2_Msg3" 4 "StrtMsg2_Msg4" 5 "StrtMsg2_Msg5" 6 "StrtMsg2_Msg6" 7 "StrtMsg2_Msg7" 8 "StrtMsg2_Msg8" 9 "StrtMsg2_Msg9" 10 "StrtMsg2_Msg10" 11 "StrtMsg2_Msg11" 12 "StrtMsg2_Msg12" 13 "StrtMsg2_Msg13";
VAL_ 565 SysDirIndcnFailr 0 "DevErrSts2_NoFlt" 1 "DevErrSts2_Flt";
VAL_ 565 TrAntiPnch 0 "Boolean_FALSE" 1 "Boolean_TRUE";
VAL_ 565 TrObstclDetn 0 "Boolean_FALSE" 1 "Boolean_TRUE";
VAL_ 1154 BattSnsrStReq 0 "BattSnsrSt_Off" 1 "BattSnsrSt_Accessory" 2 "BattSnsrSt_IgnistionONOrDriving" 3 "BattSnsrSt_Cranking";
VAL_ 1154 BrkLiReqRegenOnOff 0 "OnOff1_Off" 1 "OnOff1_On";
VAL_ 1154 DHTStSafeSpdQf 0 "Qf1_DevOfDataUndefd" 1 "Qf1_DataTmpUndefdAndEvlnInProgs" 2 "Qf1_DevOfDataNotWithinRngAllwd" 3 "Qf1_DataCalcdWithDevDefd";
VAL_ 1154 DHTStSafeTqRtQf 0 "Qf1_DevOfDataUndefd" 1 "Qf1_DataTmpUndefdAndEvlnInProgs" 2 "Qf1_DevOfDataNotWithinRngAllwd" 3 "Qf1_DataCalcdWithDevDefd";
VAL_ 1154 DtEngdStDtEngdFrnt 0 "Flg1_Rst" 1 "Flg1_Set";
VAL_ 1154 DtEngdStDtEngdRe 0 "Flg1_Rst" 1 "Flg1_Set";
VAL_ 1154 DtEngdStDtNotEngdFrnt 0 "Flg1_Rst" 1 "Flg1_Set";
VAL_ 1154 DtEngdStDtNotEngdRe 0 "Flg1_Rst" 1 "Flg1_Set";
VAL_ 1154 ElecMot2ErrIndcnReq 0 "OnOff1_Off" 1 "OnOff1_On";
VAL_ 1154 EngRunngReqByTrsm 0 "EngRunngReq_Dft" 1 "EngRunngReq_StopInhb" 2 "EngRunngReq_RunReq" 3 "EngRunngReq_Resd";
VAL_ 1154 IsgActvDampgModReq 0 "WhlMotSysActvDampgModCodSts_NoDampg" 1 "WhlMotSysActvDampgModCodSts_LoDampg" 2 "WhlMotSysActvDampgModCodSts_MedDampg" 3 "WhlMotSysActvDampgModCodSts_HiDampg";
VAL_ 1154 IsgModReq 0 "IsgModTyp1_Inin" 1 "IsgModTyp1_Stb" 2 "IsgModTyp1_TqCtrl" 3 "IsgModTyp1_SpdCtrl" 4 "IsgModTyp1_UDcCtrl" 5 "IsgModTyp1_PreChrg" 6 "IsgModTyp1_PwrDwn" 7 "IsgModTyp1_Flt" 8 "IsgModTyp1_TcsCtrl" 9 "IsgModTyp1_Reserved1" 10 "IsgModTyp1_Reserved2" 11 "IsgModTyp1_Reserved3" 12 "IsgModTyp1_Reserved4" 13 "IsgModTyp1_Reserved5" 14 "IsgModTyp1_Reserved6" 15 "IsgModTyp1_Reserved7";
VAL_ 1154 OvrdDecelByDrvrOvrdDecelByDrvr 0 "NoYes1_No" 1 "NoYes1_Yes";
VAL_ 1154 ParkByDrvrWhlsFrntSafeSts 0 "Flg1_Rst" 1 "Flg1_Set";
VAL_ 1154 PropLgtCtrlModCfmdLgtDegradation 0 "LgtDegrad_NoDegradation" 1 "LgtDegrad_TorqueLimitation" 2 "LgtDegrad_TotallyFault" 3 "LgtDegrad_Reserved1" 4 "LgtDegrad_Reserved2" 5 "LgtDegrad_Reserved3" 6 "LgtDegrad_Reserved4" 7 "LgtDegrad_Reserved5";
VAL_ 1154 PropLgtCtrlModCfmdPropLgtCtrlModCfmd 0 "LgtCtrlModCfmd_NotRequest" 1 "LgtCtrlModCfmd_TJP_HWC" 2 "LgtCtrlModCfmd_APA" 3 "LgtCtrlModCfmd_RPA" 4 "LgtCtrlModCfmd_HPA" 5 "LgtCtrlModCfmd_NOP" 6 "LgtCtrlModCfmd_E2E" 7 "LgtCtrlModCfmd_Reserved3";
VAL_ 1154 PtAllwdToTrsmActrSafePtAllwdToTrsmActr 0 "PtAllwdToTrsmActr1_NotAllwd1" 1 "PtAllwdToTrsmActr1_RvsAllwd" 2 "PtAllwdToTrsmActr1_RvsNotAllwd" 3 "PtAllwdToTrsmActr1_NotAllwd2" 4 "PtAllwdToTrsmActr1_ParkRelsAllwd" 5 "PtAllwdToTrsmActr1_RvsAllwdAndParkRelsAllwd" 6 "PtAllwdToTrsmActr1_RvsNotAllwdAndParkRelsAllwd" 7 "PtAllwdToTrsmActr1_NotAllwd3" 8 "PtAllwdToTrsmActr1_ParkRelsNotAllwd" 9 "PtAllwdToTrsmActr1_RvsAllwdAndParkRelsNotAllwd" 10 "PtAllwdToTrsmActr1_RvsNotAllwdAndParkRelsNotAllwd" 11 "PtAllwdToTrsmActr1_NotAllwd4" 12 "PtAllwdToTrsmActr1_NotAllwd5" 13 "PtAllwdToTrsmActr1_NotAllwd6" 14 "PtAllwdToTrsmActr1_NotAllwd7" 15 "PtAllwdToTrsmActr1_NotAllwd8";
VAL_ 1154 PtBrkTqCpTotQf 0 "Qf1_DevOfDataUndefd" 1 "Qf1_DataTmpUndefdAndEvlnInProgs" 2 "Qf1_DevOfDataNotWithinRngAllwd" 3 "Qf1_DataCalcdWithDevDefd";
VAL_ 1154 PtGearTar 0 "PtGearAct1_Neut" 1 "PtGearAct1_Gear1" 2 "PtGearAct1_Gear2" 3 "PtGearAct1_Gear3" 4 "PtGearAct1_Gear4" 5 "PtGearAct1_Gear5" 6 "PtGearAct1_Gear6" 7 "PtGearAct1_Gear7" 8 "PtGearAct1_Gear8" 9 "PtGearAct1_Gear9" 10 "PtGearAct1_Gear10" 11 "PtGearAct1_Gear11" 12 "PtGearAct1_Gear12" 13 "PtGearAct1_Drv" 14 "PtGearAct1_Ukwn" 15 "PtGearAct1_Rvs";
VAL_ 1154 PtRgnTarTqAtReAxleQf 0 "Qf1_DevOfDataUndefd" 1 "Qf1_DataTmpUndefdAndEvlnInProgs" 2 "Qf1_DevOfDataNotWithinRngAllwd" 3 "Qf1_DataCalcdWithDevDefd";
VAL_ 1154 PtTotRgnTarTqQf 0 "Qf1_DevOfDataUndefd" 1 "Qf1_DataTmpUndefdAndEvlnInProgs" 2 "Qf1_DevOfDataNotWithinRngAllwd" 3 "Qf1_DataCalcdWithDevDefd";
VAL_ 1154 RlyCrashForHvsysReq 0 "OnOff1_Off" 1 "OnOff1_On";
VAL_ 1154 TrsmActrPosn2TrsmActrPosn 0 "TrsmActrPosn1_Park" 1 "TrsmActrPosn1_ParkRvs" 2 "TrsmActrPosn1_Rvs" 3 "TrsmActrPosn1_RvsNeut" 4 "TrsmActrPosn1_Neut" 5 "TrsmActrPosn1_NeutDrv" 6 "TrsmActrPosn1_Drv" 7 "TrsmActrPosn1_Undefd";
VAL_ 1154 TrsmGearAct 0 "PtGearAct1_Neut" 1 "PtGearAct1_Gear1" 2 "PtGearAct1_Gear2" 3 "PtGearAct1_Gear3" 4 "PtGearAct1_Gear4" 5 "PtGearAct1_Gear5" 6 "PtGearAct1_Gear6" 7 "PtGearAct1_Gear7" 8 "PtGearAct1_Gear8" 9 "PtGearAct1_Gear9" 10 "PtGearAct1_Gear10" 11 "PtGearAct1_Gear11" 12 "PtGearAct1_Gear12" 13 "PtGearAct1_Drv" 14 "PtGearAct1_Ukwn" 15 "PtGearAct1_Rvs";
VAL_ 1154 TrsmGearChgProgs 0 "TrsmGearChgProgs1_GearShiftChgNotActv" 1 "TrsmGearChgProgs1_StrtPha" 2 "TrsmGearChgProgs1_TqPha" 3 "TrsmGearChgProgs1_JPha" 4 "TrsmGearChgProgs1_EndPha";
VAL_ 1154 TrsmGearTar 0 "PtGearAct1_Neut" 1 "PtGearAct1_Gear1" 2 "PtGearAct1_Gear2" 3 "PtGearAct1_Gear3" 4 "PtGearAct1_Gear4" 5 "PtGearAct1_Gear5" 6 "PtGearAct1_Gear6" 7 "PtGearAct1_Gear7" 8 "PtGearAct1_Gear8" 9 "PtGearAct1_Gear9" 10 "PtGearAct1_Gear10" 11 "PtGearAct1_Gear11" 12 "PtGearAct1_Gear12" 13 "PtGearAct1_Drv" 14 "PtGearAct1_Ukwn" 15 "PtGearAct1_Rvs";
VAL_ 528 EPedlDrvrIndcnMsg 0 "IndcnMsg_NoIndcn" 1 "IndcnMsg_NoBrkPedlPsd" 2 "IndcnMsg_Flt" 3 "IndcnMsg_LowPrio";
VAL_ 528 EPedlInhbnSts 0 "Boolean_FALSE" 1 "Boolean_TRUE";
VAL_ 528 ErsDelayTiCfm 0 "NoYes1_No" 1 "NoYes1_Yes";
VAL_ 528 ErsStrtRes 0 "ErsStrtRes_ErsStrtNotSet" 1 "ErsStrtRes_ErsStrtSuccess" 2 "ErsStrtRes_ErsStrtInhMaxNoStart" 3 "ErsStrtRes_ErsStrtInhCarUnlocked" 4 "ErsStrtRes_ErsStrtInhKeyInCar" 5 "ErsStrtRes_ErsStrtInhDoorOpen" 6 "ErsStrtRes_ErsStrtInhHoodOpen" 7 "ErsStrtRes_ErsStrtInhGearNotP" 8 "ErsStrtRes_ErsStrtInhUserInCar" 9 "ErsStrtRes_ErsStrtInhPedalPressed" 10 "ErsStrtRes_ErsStrtInhLoFuel" 11 "ErsStrtRes_ErsStrtInhLoBatt" 12 "ErsStrtRes_ErsStrtInhEngCoolant" 13 "ErsStrtRes_ErsStrtInhEngFault" 14 "ErsStrtRes_ErsStrtInhOther" 15 "ErsStrtRes_ErsStrtAbrtEngFault" 16 "ErsStrtRes_ErsStrtAbrtEngCoolant" 17 "ErsStrtRes_ErsStrtAbrtLoFuel" 18 "ErsStrtRes_ErsStrtAbrtLoBatt" 19 "ErsStrtRes_ErsStrtAbrtOther";
VAL_ 528 HpcDeiceReq 0 "DeiceReq_NoReq" 1 "DeiceReq_DeiceChecking" 2 "DeiceReq_Deicing" 3 "DeiceReq_Reserved";
VAL_ 528 HpcHpCoolgPwrSts 0 "Boolean_FALSE" 1 "Boolean_TRUE";
VAL_ 528 HpcHpHeatgPwrSts 0 "Boolean_FALSE" 1 "Boolean_TRUE";
VAL_ 528 HpcHpModReq 0 "HeatPmpModCmd_Initialization" 1 "HeatPmpModCmd_Mode1" 2 "HeatPmpModCmd_Mode2" 3 "HeatPmpModCmd_Mode3" 4 "HeatPmpModCmd_Mode4" 5 "HeatPmpModCmd_Mode5" 6 "HeatPmpModCmd_Mode6" 7 "HeatPmpModCmd_Mode7" 8 "HeatPmpModCmd_Mode8" 9 "HeatPmpModCmd_Mode9" 10 "HeatPmpModCmd_Mode10" 11 "HeatPmpModCmd_Mode11" 12 "HeatPmpModCmd_Mode12" 13 "HeatPmpModCmd_Mode13" 14 "HeatPmpModCmd_Mode14" 15 "HeatPmpModCmd_Mode15" 16 "HeatPmpModCmd_Mode16" 17 "HeatPmpModCmd_Mode17" 18 "HeatPmpModCmd_Mode18" 19 "HeatPmpModCmd_Mode19" 20 "HeatPmpModCmd_Mode20" 21 "HeatPmpModCmd_Reserved";
VAL_ 528 HvacCooltVlvStsSig 0 "HvacCooltVlvSts_VlvReqdToClsd" 1 "HvacCooltVlvSts_VlvReqdToOpen" 2 "HvacCooltVlvSts_ElecErrByCircOpen" 3 "HvacCooltVlvSts_ElecErrShoToGnd" 4 "HvacCooltVlvSts_ElecErrShoToPwrSply" 5 "HvacCooltVlvSts_Resd";
VAL_ 528 HvCooltHeatrEnad 0 "Boolean_FALSE" 1 "Boolean_TRUE";
VAL_ 528 HvCooltHeatrStsSig 0 "HvCooltHeatrSts_Off" 1 "HvCooltHeatrSts_LockedUntilNextStart" 2 "HvCooltHeatrSts_LockedUntilService" 3 "HvCooltHeatrSts_LockedPermanent" 4 "HvCooltHeatrSts_Operation" 5 "HvCooltHeatrSts_Reserved1" 6 "HvCooltHeatrSts_Reserved2" 7 "HvCooltHeatrSts_Reserved3";
VAL_ 528 HvSysRlyStsHvSysRlySts 0 "HvActvnSts_Open" 1 "HvActvnSts_Clsd" 2 "HvActvnSts_KeepSt" 3 "HvActvnSts_OpenAndReqActvDcha";
VAL_ 528 OilHealthIfDisp 0 "Boolean_FALSE" 1 "Boolean_TRUE";
VAL_ 528 PEMState 0 "PEMState_invalid" 1 "PEMState_inactive" 2 "PEMState_temporary_inactive" 3 "PEMState_active";
VAL_ 528 RainSnsrStsToHMI 0 "OnOff1_Off" 1 "OnOff1_On";
VAL_ 528 RemindChrgn 0 "Boolean_FALSE" 1 "Boolean_TRUE";
VAL_ 528 RoadInFor 0 "RoadInFor_Invalid" 1 "RoadInFor_City" 2 "RoadInFor_County" 3 "RoadInFor_FerryWay";
VAL_ 528 SeatOccptAtRowSecMid2 0 "OccptPresSt1_Undefd1" 1 "OccptPresSt1_OccptNotPrsnt" 2 "OccptPresSt1_OccptPrsnt" 3 "OccptPresSt1_Undefd2";
VAL_ 528 SeatOccptAtRowSecMidSnsSts2 0 "OkNokDi_Ok" 1 "OkNokDi_NotOk" 2 "OkNokDi_Disabled" 3 "OkNokDi_Reserved";
VAL_ 528 SwtStrt3 0 "PsdNotPsd2_NoInfo1" 1 "PsdNotPsd2_NotPsd" 2 "PsdNotPsd2_Psd" 3 "PsdNotPsd2_NoInfo2";
VAL_ 528 SwtStrt4 0 "PsdNotPsd2_NoInfo1" 1 "PsdNotPsd2_NotPsd" 2 "PsdNotPsd2_Psd" 3 "PsdNotPsd2_NoInfo2";
VAL_ 528 TrOpenerByFootOperCmd 0 "OnOff1_Off" 1 "OnOff1_On";
VAL_ 528 WiprActvFromWMM 0 "OnOff1_Off" 1 "OnOff1_On";
VAL_ 880 AccrPedlNotCmplPsd 0 "NoYes1_No" 1 "NoYes1_Yes";
VAL_ 880 AccrPedlNotCmplPsdSts 0 "NoYes1_No" 1 "NoYes1_Yes";
VAL_ 880 CrsCtrlrActvnOk 0 "OnOff1_Off" 1 "OnOff1_On";
VAL_ 880 DeactvtTestCom 0 "OnOff2_On" 1 "OnOff2_Off";
VAL_ 880 ImobBrkNrSerlReq 0 "OnOff1_Off" 1 "OnOff1_On";
VAL_ 880 ImobEngSts1 0 "ImobSts_ImobUndefd" 1 "ImobSts_ImobImobn" 2 "ImobSts_ImobMtn" 3 "ImobSts_ImobNoMtn";
VAL_ 880 ImobEngSts3 0 "ImobSts_ImobUndefd" 1 "ImobSts_ImobImobn" 2 "ImobSts_ImobMtn" 3 "ImobSts_ImobNoMtn";
VAL_ 880 PtDtModReq 0 "PtModReq_Ev" 1 "PtModReq_Serial" 2 "PtModReq_Parallel" 3 "PtModReq_P2Gen" 4 "PtModReq_ParallelLaunch";
VAL_ 880 PtReqToTrsmActr 0 "PtReqToTrsmActr2_ParkReq" 1 "PtReqToTrsmActr2_RvsReq" 2 "PtReqToTrsmActr2_NeutReq" 3 "PtReqToTrsmActr2_DrvReq" 4 "PtReqToTrsmActr2_NoMoveReq" 5 "PtReqToTrsmActr2_Resd1" 6 "PtReqToTrsmActr2_Resd2" 7 "PtReqToTrsmActr2_Resd3";
VAL_ 880 SwtTrClsSts 0 "PsdNotPsd_NotPsd" 1 "PsdNotPsd_Psd";
VAL_ 880 ThermFctReq 0 "Boolean_FALSE" 1 "Boolean_TRUE";
VAL_ 880 TrsmErrIndcnReq 0 "OnOff1_Off" 1 "OnOff1_On";
VAL_ 880 TrsmHotSt 0 "TrsmHotSt1_HotStNotActv" 1 "TrsmHotSt1_LvlHotSt1" 2 "TrsmHotSt1_LvlHotSt2";
VAL_ 880 TrsmShiftInhb 0 "TrsmShiftInhb1_TrsmShiftInhbNotActv" 1 "TrsmShiftInhb1_TrsmShiftInhbActv";
VAL_ 800 EngCrashFb 0 "CrashFb_Idle" 1 "CrashFb_Evln" 2 "CrashFb_Nok" 3 "CrashFb_Ok";
VAL_ 800 HvCooltHeatrEnadWhE2EHvchEnad 0 "Boolean_FALSE" 1 "Boolean_TRUE";
VAL_ 800 SafetyCrashFb 0 "CrashFb_Idle" 1 "CrashFb_Evln" 2 "CrashFb_Nok" 3 "CrashFb_Ok";
VAL_ 800 VFCVectorPCMVFCid0 0 "VFCOnOff_Off" 1 "VFCOnOff_On";
VAL_ 800 VFCVectorPCMVFCid1 0 "VFCOnOff_Off" 1 "VFCOnOff_On";
VAL_ 800 VFCVectorPCMVFCid10 0 "VFCOnOff_Off" 1 "VFCOnOff_On";
VAL_ 800 VFCVectorPCMVFCid11 0 "VFCOnOff_Off" 1 "VFCOnOff_On";
VAL_ 800 VFCVectorPCMVFCid12 0 "VFCOnOff_Off" 1 "VFCOnOff_On";
VAL_ 800 VFCVectorPCMVFCid13 0 "VFCOnOff_Off" 1 "VFCOnOff_On";
VAL_ 800 VFCVectorPCMVFCid14 0 "VFCOnOff_Off" 1 "VFCOnOff_On";
VAL_ 800 VFCVectorPCMVFCid15 0 "VFCOnOff_Off" 1 "VFCOnOff_On";
VAL_ 800 VFCVectorPCMVFCid16 0 "VFCOnOff_Off" 1 "VFCOnOff_On";
VAL_ 800 VFCVectorPCMVFCid17 0 "VFCOnOff_Off" 1 "VFCOnOff_On";
VAL_ 800 VFCVectorPCMVFCid18 0 "VFCOnOff_Off" 1 "VFCOnOff_On";
VAL_ 800 VFCVectorPCMVFCid19 0 "VFCOnOff_Off" 1 "VFCOnOff_On";
VAL_ 800 VFCVectorPCMVFCid2 0 "VFCOnOff_Off" 1 "VFCOnOff_On";
VAL_ 800 VFCVectorPCMVFCid20 0 "VFCOnOff_Off" 1 "VFCOnOff_On";
VAL_ 800 VFCVectorPCMVFCid21 0 "VFCOnOff_Off" 1 "VFCOnOff_On";
VAL_ 800 VFCVectorPCMVFCid22 0 "VFCOnOff_Off" 1 "VFCOnOff_On";
VAL_ 800 VFCVectorPCMVFCid23 0 "VFCOnOff_Off" 1 "VFCOnOff_On";
VAL_ 800 VFCVectorPCMVFCid24 0 "VFCOnOff_Off" 1 "VFCOnOff_On";
VAL_ 800 VFCVectorPCMVFCid25 0 "VFCOnOff_Off" 1 "VFCOnOff_On";
VAL_ 800 VFCVectorPCMVFCid26 0 "VFCOnOff_Off" 1 "VFCOnOff_On";
VAL_ 800 VFCVectorPCMVFCid27 0 "VFCOnOff_Off" 1 "VFCOnOff_On";
VAL_ 800 VFCVectorPCMVFCid28 0 "VFCOnOff_Off" 1 "VFCOnOff_On";
VAL_ 800 VFCVectorPCMVFCid29 0 "VFCOnOff_Off" 1 "VFCOnOff_On";
VAL_ 800 VFCVectorPCMVFCid3 0 "VFCOnOff_Off" 1 "VFCOnOff_On";
VAL_ 800 VFCVectorPCMVFCid30 0 "VFCOnOff_Off" 1 "VFCOnOff_On";
VAL_ 800 VFCVectorPCMVFCid31 0 "VFCOnOff_Off" 1 "VFCOnOff_On";
VAL_ 800 VFCVectorPCMVFCid32 0 "VFCOnOff_Off" 1 "VFCOnOff_On";
VAL_ 800 VFCVectorPCMVFCid33 0 "VFCOnOff_Off" 1 "VFCOnOff_On";
VAL_ 800 VFCVectorPCMVFCid34 0 "VFCOnOff_Off" 1 "VFCOnOff_On";
VAL_ 800 VFCVectorPCMVFCid35 0 "VFCOnOff_Off" 1 "VFCOnOff_On";
VAL_ 800 VFCVectorPCMVFCid36 0 "VFCOnOff_Off" 1 "VFCOnOff_On";
VAL_ 800 VFCVectorPCMVFCid37 0 "VFCOnOff_Off" 1 "VFCOnOff_On";
VAL_ 800 VFCVectorPCMVFCid38 0 "VFCOnOff_Off" 1 "VFCOnOff_On";
VAL_ 800 VFCVectorPCMVFCid39 0 "VFCOnOff_Off" 1 "VFCOnOff_On";
VAL_ 800 VFCVectorPCMVFCid4 0 "VFCOnOff_Off" 1 "VFCOnOff_On";
VAL_ 800 VFCVectorPCMVFCid40 0 "VFCOnOff_Off" 1 "VFCOnOff_On";
VAL_ 800 VFCVectorPCMVFCid41 0 "VFCOnOff_Off" 1 "VFCOnOff_On";
VAL_ 800 VFCVectorPCMVFCid42 0 "VFCOnOff_Off" 1 "VFCOnOff_On";
VAL_ 800 VFCVectorPCMVFCid43 0 "VFCOnOff_Off" 1 "VFCOnOff_On";
VAL_ 800 VFCVectorPCMVFCid44 0 "VFCOnOff_Off" 1 "VFCOnOff_On";
VAL_ 800 VFCVectorPCMVFCid45 0 "VFCOnOff_Off" 1 "VFCOnOff_On";
VAL_ 800 VFCVectorPCMVFCid46 0 "VFCOnOff_Off" 1 "VFCOnOff_On";
VAL_ 800 VFCVectorPCMVFCid47 0 "VFCOnOff_Off" 1 "VFCOnOff_On";
VAL_ 800 VFCVectorPCMVFCid48 0 "VFCOnOff_Off" 1 "VFCOnOff_On";
VAL_ 800 VFCVectorPCMVFCid49 0 "VFCOnOff_Off" 1 "VFCOnOff_On";
VAL_ 800 VFCVectorPCMVFCid5 0 "VFCOnOff_Off" 1 "VFCOnOff_On";
VAL_ 800 VFCVectorPCMVFCid50 0 "VFCOnOff_Off" 1 "VFCOnOff_On";
VAL_ 800 VFCVectorPCMVFCid51 0 "VFCOnOff_Off" 1 "VFCOnOff_On";
VAL_ 800 VFCVectorPCMVFCid52 0 "VFCOnOff_Off" 1 "VFCOnOff_On";
VAL_ 800 VFCVectorPCMVFCid53 0 "VFCOnOff_Off" 1 "VFCOnOff_On";
VAL_ 800 VFCVectorPCMVFCid54 0 "VFCOnOff_Off" 1 "VFCOnOff_On";
VAL_ 800 VFCVectorPCMVFCid55 0 "VFCOnOff_Off" 1 "VFCOnOff_On";
VAL_ 800 VFCVectorPCMVFCid56 0 "VFCOnOff_Off" 1 "VFCOnOff_On";
VAL_ 800 VFCVectorPCMVFCid57 0 "VFCOnOff_Off" 1 "VFCOnOff_On";
VAL_ 800 VFCVectorPCMVFCid58 0 "VFCOnOff_Off" 1 "VFCOnOff_On";
VAL_ 800 VFCVectorPCMVFCid59 0 "VFCOnOff_Off" 1 "VFCOnOff_On";
VAL_ 800 VFCVectorPCMVFCid6 0 "VFCOnOff_Off" 1 "VFCOnOff_On";
VAL_ 800 VFCVectorPCMVFCid60 0 "VFCOnOff_Off" 1 "VFCOnOff_On";
VAL_ 800 VFCVectorPCMVFCid61 0 "VFCOnOff_Off" 1 "VFCOnOff_On";
VAL_ 800 VFCVectorPCMVFCid7 0 "VFCOnOff_Off" 1 "VFCOnOff_On";
VAL_ 800 VFCVectorPCMVFCid8 0 "VFCOnOff_Off" 1 "VFCOnOff_On";
VAL_ 800 VFCVectorPCMVFCid9 0 "VFCOnOff_Off" 1 "VFCOnOff_On";
VAL_ 800 VFCVectorPOTVFCid0 0 "VFCOnOff_Off" 1 "VFCOnOff_On";
VAL_ 800 VFCVectorPOTVFCid1 0 "VFCOnOff_Off" 1 "VFCOnOff_On";
VAL_ 800 VFCVectorPOTVFCid10 0 "VFCOnOff_Off" 1 "VFCOnOff_On";
VAL_ 800 VFCVectorPOTVFCid11 0 "VFCOnOff_Off" 1 "VFCOnOff_On";
VAL_ 800 VFCVectorPOTVFCid12 0 "VFCOnOff_Off" 1 "VFCOnOff_On";
VAL_ 800 VFCVectorPOTVFCid13 0 "VFCOnOff_Off" 1 "VFCOnOff_On";
VAL_ 800 VFCVectorPOTVFCid14 0 "VFCOnOff_Off" 1 "VFCOnOff_On";
VAL_ 800 VFCVectorPOTVFCid15 0 "VFCOnOff_Off" 1 "VFCOnOff_On";
VAL_ 800 VFCVectorPOTVFCid16 0 "VFCOnOff_Off" 1 "VFCOnOff_On";
VAL_ 800 VFCVectorPOTVFCid17 0 "VFCOnOff_Off" 1 "VFCOnOff_On";
VAL_ 800 VFCVectorPOTVFCid18 0 "VFCOnOff_Off" 1 "VFCOnOff_On";
VAL_ 800 VFCVectorPOTVFCid19 0 "VFCOnOff_Off" 1 "VFCOnOff_On";
VAL_ 800 VFCVectorPOTVFCid2 0 "VFCOnOff_Off" 1 "VFCOnOff_On";
VAL_ 800 VFCVectorPOTVFCid20 0 "VFCOnOff_Off" 1 "VFCOnOff_On";
VAL_ 800 VFCVectorPOTVFCid21 0 "VFCOnOff_Off" 1 "VFCOnOff_On";
VAL_ 800 VFCVectorPOTVFCid22 0 "VFCOnOff_Off" 1 "VFCOnOff_On";
VAL_ 800 VFCVectorPOTVFCid23 0 "VFCOnOff_Off" 1 "VFCOnOff_On";
VAL_ 800 VFCVectorPOTVFCid24 0 "VFCOnOff_Off" 1 "VFCOnOff_On";
VAL_ 800 VFCVectorPOTVFCid25 0 "VFCOnOff_Off" 1 "VFCOnOff_On";
VAL_ 800 VFCVectorPOTVFCid26 0 "VFCOnOff_Off" 1 "VFCOnOff_On";
VAL_ 800 VFCVectorPOTVFCid27 0 "VFCOnOff_Off" 1 "VFCOnOff_On";
VAL_ 800 VFCVectorPOTVFCid28 0 "VFCOnOff_Off" 1 "VFCOnOff_On";
VAL_ 800 VFCVectorPOTVFCid29 0 "VFCOnOff_Off" 1 "VFCOnOff_On";
VAL_ 800 VFCVectorPOTVFCid3 0 "VFCOnOff_Off" 1 "VFCOnOff_On";
VAL_ 800 VFCVectorPOTVFCid30 0 "VFCOnOff_Off" 1 "VFCOnOff_On";
VAL_ 800 VFCVectorPOTVFCid31 0 "VFCOnOff_Off" 1 "VFCOnOff_On";
VAL_ 800 VFCVectorPOTVFCid32 0 "VFCOnOff_Off" 1 "VFCOnOff_On";
VAL_ 800 VFCVectorPOTVFCid33 0 "VFCOnOff_Off" 1 "VFCOnOff_On";
VAL_ 800 VFCVectorPOTVFCid34 0 "VFCOnOff_Off" 1 "VFCOnOff_On";
VAL_ 800 VFCVectorPOTVFCid35 0 "VFCOnOff_Off" 1 "VFCOnOff_On";
VAL_ 800 VFCVectorPOTVFCid36 0 "VFCOnOff_Off" 1 "VFCOnOff_On";
VAL_ 800 VFCVectorPOTVFCid37 0 "VFCOnOff_Off" 1 "VFCOnOff_On";
VAL_ 800 VFCVectorPOTVFCid38 0 "VFCOnOff_Off" 1 "VFCOnOff_On";
VAL_ 800 VFCVectorPOTVFCid39 0 "VFCOnOff_Off" 1 "VFCOnOff_On";
VAL_ 800 VFCVectorPOTVFCid4 0 "VFCOnOff_Off" 1 "VFCOnOff_On";
VAL_ 800 VFCVectorPOTVFCid40 0 "VFCOnOff_Off" 1 "VFCOnOff_On";
VAL_ 800 VFCVectorPOTVFCid41 0 "VFCOnOff_Off" 1 "VFCOnOff_On";
VAL_ 800 VFCVectorPOTVFCid42 0 "VFCOnOff_Off" 1 "VFCOnOff_On";
VAL_ 800 VFCVectorPOTVFCid43 0 "VFCOnOff_Off" 1 "VFCOnOff_On";
VAL_ 800 VFCVectorPOTVFCid44 0 "VFCOnOff_Off" 1 "VFCOnOff_On";
VAL_ 800 VFCVectorPOTVFCid45 0 "VFCOnOff_Off" 1 "VFCOnOff_On";
VAL_ 800 VFCVectorPOTVFCid46 0 "VFCOnOff_Off" 1 "VFCOnOff_On";
VAL_ 800 VFCVectorPOTVFCid47 0 "VFCOnOff_Off" 1 "VFCOnOff_On";
VAL_ 800 VFCVectorPOTVFCid48 0 "VFCOnOff_Off" 1 "VFCOnOff_On";
VAL_ 800 VFCVectorPOTVFCid49 0 "VFCOnOff_Off" 1 "VFCOnOff_On";
VAL_ 800 VFCVectorPOTVFCid5 0 "VFCOnOff_Off" 1 "VFCOnOff_On";
VAL_ 800 VFCVectorPOTVFCid50 0 "VFCOnOff_Off" 1 "VFCOnOff_On";
VAL_ 800 VFCVectorPOTVFCid51 0 "VFCOnOff_Off" 1 "VFCOnOff_On";
VAL_ 800 VFCVectorPOTVFCid52 0 "VFCOnOff_Off" 1 "VFCOnOff_On";
VAL_ 800 VFCVectorPOTVFCid53 0 "VFCOnOff_Off" 1 "VFCOnOff_On";
VAL_ 800 VFCVectorPOTVFCid54 0 "VFCOnOff_Off" 1 "VFCOnOff_On";
VAL_ 800 VFCVectorPOTVFCid55 0 "VFCOnOff_Off" 1 "VFCOnOff_On";
VAL_ 800 VFCVectorPOTVFCid56 0 "VFCOnOff_Off" 1 "VFCOnOff_On";
VAL_ 800 VFCVectorPOTVFCid57 0 "VFCOnOff_Off" 1 "VFCOnOff_On";
VAL_ 800 VFCVectorPOTVFCid58 0 "VFCOnOff_Off" 1 "VFCOnOff_On";
VAL_ 800 VFCVectorPOTVFCid59 0 "VFCOnOff_Off" 1 "VFCOnOff_On";
VAL_ 800 VFCVectorPOTVFCid6 0 "VFCOnOff_Off" 1 "VFCOnOff_On";
VAL_ 800 VFCVectorPOTVFCid60 0 "VFCOnOff_Off" 1 "VFCOnOff_On";
VAL_ 800 VFCVectorPOTVFCid61 0 "VFCOnOff_Off" 1 "VFCOnOff_On";
VAL_ 800 VFCVectorPOTVFCid7 0 "VFCOnOff_Off" 1 "VFCOnOff_On";
VAL_ 800 VFCVectorPOTVFCid8 0 "VFCOnOff_Off" 1 "VFCOnOff_On";
VAL_ 800 VFCVectorPOTVFCid9 0 "VFCOnOff_Off" 1 "VFCOnOff_On";
VAL_ 800 VFCVectorSRSVFCid0 0 "VFCOnOff_Off" 1 "VFCOnOff_On";
VAL_ 800 VFCVectorSRSVFCid1 0 "VFCOnOff_Off" 1 "VFCOnOff_On";
VAL_ 800 VFCVectorSRSVFCid10 0 "VFCOnOff_Off" 1 "VFCOnOff_On";
VAL_ 800 VFCVectorSRSVFCid11 0 "VFCOnOff_Off" 1 "VFCOnOff_On";
VAL_ 800 VFCVectorSRSVFCid12 0 "VFCOnOff_Off" 1 "VFCOnOff_On";
VAL_ 800 VFCVectorSRSVFCid13 0 "VFCOnOff_Off" 1 "VFCOnOff_On";
VAL_ 800 VFCVectorSRSVFCid14 0 "VFCOnOff_Off" 1 "VFCOnOff_On";
VAL_ 800 VFCVectorSRSVFCid15 0 "VFCOnOff_Off" 1 "VFCOnOff_On";
VAL_ 800 VFCVectorSRSVFCid16 0 "VFCOnOff_Off" 1 "VFCOnOff_On";
VAL_ 800 VFCVectorSRSVFCid17 0 "VFCOnOff_Off" 1 "VFCOnOff_On";
VAL_ 800 VFCVectorSRSVFCid18 0 "VFCOnOff_Off" 1 "VFCOnOff_On";
VAL_ 800 VFCVectorSRSVFCid19 0 "VFCOnOff_Off" 1 "VFCOnOff_On";
VAL_ 800 VFCVectorSRSVFCid2 0 "VFCOnOff_Off" 1 "VFCOnOff_On";
VAL_ 800 VFCVectorSRSVFCid20 0 "VFCOnOff_Off" 1 "VFCOnOff_On";
VAL_ 800 VFCVectorSRSVFCid21 0 "VFCOnOff_Off" 1 "VFCOnOff_On";
VAL_ 800 VFCVectorSRSVFCid22 0 "VFCOnOff_Off" 1 "VFCOnOff_On";
VAL_ 800 VFCVectorSRSVFCid23 0 "VFCOnOff_Off" 1 "VFCOnOff_On";
VAL_ 800 VFCVectorSRSVFCid24 0 "VFCOnOff_Off" 1 "VFCOnOff_On";
VAL_ 800 VFCVectorSRSVFCid25 0 "VFCOnOff_Off" 1 "VFCOnOff_On";
VAL_ 800 VFCVectorSRSVFCid26 0 "VFCOnOff_Off" 1 "VFCOnOff_On";
VAL_ 800 VFCVectorSRSVFCid27 0 "VFCOnOff_Off" 1 "VFCOnOff_On";
VAL_ 800 VFCVectorSRSVFCid28 0 "VFCOnOff_Off" 1 "VFCOnOff_On";
VAL_ 800 VFCVectorSRSVFCid29 0 "VFCOnOff_Off" 1 "VFCOnOff_On";
VAL_ 800 VFCVectorSRSVFCid3 0 "VFCOnOff_Off" 1 "VFCOnOff_On";
VAL_ 800 VFCVectorSRSVFCid30 0 "VFCOnOff_Off" 1 "VFCOnOff_On";
VAL_ 800 VFCVectorSRSVFCid31 0 "VFCOnOff_Off" 1 "VFCOnOff_On";
VAL_ 800 VFCVectorSRSVFCid32 0 "VFCOnOff_Off" 1 "VFCOnOff_On";
VAL_ 800 VFCVectorSRSVFCid33 0 "VFCOnOff_Off" 1 "VFCOnOff_On";
VAL_ 800 VFCVectorSRSVFCid34 0 "VFCOnOff_Off" 1 "VFCOnOff_On";
VAL_ 800 VFCVectorSRSVFCid35 0 "VFCOnOff_Off" 1 "VFCOnOff_On";
VAL_ 800 VFCVectorSRSVFCid36 0 "VFCOnOff_Off" 1 "VFCOnOff_On";
VAL_ 800 VFCVectorSRSVFCid37 0 "VFCOnOff_Off" 1 "VFCOnOff_On";
VAL_ 800 VFCVectorSRSVFCid38 0 "VFCOnOff_Off" 1 "VFCOnOff_On";
VAL_ 800 VFCVectorSRSVFCid39 0 "VFCOnOff_Off" 1 "VFCOnOff_On";
VAL_ 800 VFCVectorSRSVFCid4 0 "VFCOnOff_Off" 1 "VFCOnOff_On";
VAL_ 800 VFCVectorSRSVFCid40 0 "VFCOnOff_Off" 1 "VFCOnOff_On";
VAL_ 800 VFCVectorSRSVFCid41 0 "VFCOnOff_Off" 1 "VFCOnOff_On";
VAL_ 800 VFCVectorSRSVFCid42 0 "VFCOnOff_Off" 1 "VFCOnOff_On";
VAL_ 800 VFCVectorSRSVFCid43 0 "VFCOnOff_Off" 1 "VFCOnOff_On";
VAL_ 800 VFCVectorSRSVFCid44 0 "VFCOnOff_Off" 1 "VFCOnOff_On";
VAL_ 800 VFCVectorSRSVFCid45 0 "VFCOnOff_Off" 1 "VFCOnOff_On";
VAL_ 800 VFCVectorSRSVFCid46 0 "VFCOnOff_Off" 1 "VFCOnOff_On";
VAL_ 800 VFCVectorSRSVFCid47 0 "VFCOnOff_Off" 1 "VFCOnOff_On";
VAL_ 800 VFCVectorSRSVFCid48 0 "VFCOnOff_Off" 1 "VFCOnOff_On";
VAL_ 800 VFCVectorSRSVFCid49 0 "VFCOnOff_Off" 1 "VFCOnOff_On";
VAL_ 800 VFCVectorSRSVFCid5 0 "VFCOnOff_Off" 1 "VFCOnOff_On";
VAL_ 800 VFCVectorSRSVFCid50 0 "VFCOnOff_Off" 1 "VFCOnOff_On";
VAL_ 800 VFCVectorSRSVFCid51 0 "VFCOnOff_Off" 1 "VFCOnOff_On";
VAL_ 800 VFCVectorSRSVFCid52 0 "VFCOnOff_Off" 1 "VFCOnOff_On";
VAL_ 800 VFCVectorSRSVFCid53 0 "VFCOnOff_Off" 1 "VFCOnOff_On";
VAL_ 800 VFCVectorSRSVFCid54 0 "VFCOnOff_Off" 1 "VFCOnOff_On";
VAL_ 800 VFCVectorSRSVFCid55 0 "VFCOnOff_Off" 1 "VFCOnOff_On";
VAL_ 800 VFCVectorSRSVFCid56 0 "VFCOnOff_Off" 1 "VFCOnOff_On";
VAL_ 800 VFCVectorSRSVFCid57 0 "VFCOnOff_Off" 1 "VFCOnOff_On";
VAL_ 800 VFCVectorSRSVFCid58 0 "VFCOnOff_Off" 1 "VFCOnOff_On";
VAL_ 800 VFCVectorSRSVFCid59 0 "VFCOnOff_Off" 1 "VFCOnOff_On";
VAL_ 800 VFCVectorSRSVFCid6 0 "VFCOnOff_Off" 1 "VFCOnOff_On";
VAL_ 800 VFCVectorSRSVFCid60 0 "VFCOnOff_Off" 1 "VFCOnOff_On";
VAL_ 800 VFCVectorSRSVFCid61 0 "VFCOnOff_Off" 1 "VFCOnOff_On";
VAL_ 800 VFCVectorSRSVFCid7 0 "VFCOnOff_Off" 1 "VFCOnOff_On";
VAL_ 800 VFCVectorSRSVFCid8 0 "VFCOnOff_Off" 1 "VFCOnOff_On";
VAL_ 800 VFCVectorSRSVFCid9 0 "VFCOnOff_Off" 1 "VFCOnOff_On";
VAL_ 800 VFCVectorSUMVFCid0 0 "VFCOnOff_Off" 1 "VFCOnOff_On";
VAL_ 800 VFCVectorSUMVFCid1 0 "VFCOnOff_Off" 1 "VFCOnOff_On";
VAL_ 800 VFCVectorSUMVFCid10 0 "VFCOnOff_Off" 1 "VFCOnOff_On";
VAL_ 800 VFCVectorSUMVFCid11 0 "VFCOnOff_Off" 1 "VFCOnOff_On";
VAL_ 800 VFCVectorSUMVFCid12 0 "VFCOnOff_Off" 1 "VFCOnOff_On";
VAL_ 800 VFCVectorSUMVFCid13 0 "VFCOnOff_Off" 1 "VFCOnOff_On";
VAL_ 800 VFCVectorSUMVFCid14 0 "VFCOnOff_Off" 1 "VFCOnOff_On";
VAL_ 800 VFCVectorSUMVFCid15 0 "VFCOnOff_Off" 1 "VFCOnOff_On";
VAL_ 800 VFCVectorSUMVFCid16 0 "VFCOnOff_Off" 1 "VFCOnOff_On";
VAL_ 800 VFCVectorSUMVFCid17 0 "VFCOnOff_Off" 1 "VFCOnOff_On";
VAL_ 800 VFCVectorSUMVFCid18 0 "VFCOnOff_Off" 1 "VFCOnOff_On";
VAL_ 800 VFCVectorSUMVFCid19 0 "VFCOnOff_Off" 1 "VFCOnOff_On";
VAL_ 800 VFCVectorSUMVFCid2 0 "VFCOnOff_Off" 1 "VFCOnOff_On";
VAL_ 800 VFCVectorSUMVFCid20 0 "VFCOnOff_Off" 1 "VFCOnOff_On";
VAL_ 800 VFCVectorSUMVFCid21 0 "VFCOnOff_Off" 1 "VFCOnOff_On";
VAL_ 800 VFCVectorSUMVFCid22 0 "VFCOnOff_Off" 1 "VFCOnOff_On";
VAL_ 800 VFCVectorSUMVFCid23 0 "VFCOnOff_Off" 1 "VFCOnOff_On";
VAL_ 800 VFCVectorSUMVFCid24 0 "VFCOnOff_Off" 1 "VFCOnOff_On";
VAL_ 800 VFCVectorSUMVFCid25 0 "VFCOnOff_Off" 1 "VFCOnOff_On";
VAL_ 800 VFCVectorSUMVFCid26 0 "VFCOnOff_Off" 1 "VFCOnOff_On";
VAL_ 800 VFCVectorSUMVFCid27 0 "VFCOnOff_Off" 1 "VFCOnOff_On";
VAL_ 800 VFCVectorSUMVFCid28 0 "VFCOnOff_Off" 1 "VFCOnOff_On";
VAL_ 800 VFCVectorSUMVFCid29 0 "VFCOnOff_Off" 1 "VFCOnOff_On";
VAL_ 800 VFCVectorSUMVFCid3 0 "VFCOnOff_Off" 1 "VFCOnOff_On";
VAL_ 800 VFCVectorSUMVFCid30 0 "VFCOnOff_Off" 1 "VFCOnOff_On";
VAL_ 800 VFCVectorSUMVFCid31 0 "VFCOnOff_Off" 1 "VFCOnOff_On";
VAL_ 800 VFCVectorSUMVFCid32 0 "VFCOnOff_Off" 1 "VFCOnOff_On";
VAL_ 800 VFCVectorSUMVFCid33 0 "VFCOnOff_Off" 1 "VFCOnOff_On";
VAL_ 800 VFCVectorSUMVFCid34 0 "VFCOnOff_Off" 1 "VFCOnOff_On";
VAL_ 800 VFCVectorSUMVFCid35 0 "VFCOnOff_Off" 1 "VFCOnOff_On";
VAL_ 800 VFCVectorSUMVFCid36 0 "VFCOnOff_Off" 1 "VFCOnOff_On";
VAL_ 800 VFCVectorSUMVFCid37 0 "VFCOnOff_Off" 1 "VFCOnOff_On";
VAL_ 800 VFCVectorSUMVFCid38 0 "VFCOnOff_Off" 1 "VFCOnOff_On";
VAL_ 800 VFCVectorSUMVFCid39 0 "VFCOnOff_Off" 1 "VFCOnOff_On";
VAL_ 800 VFCVectorSUMVFCid4 0 "VFCOnOff_Off" 1 "VFCOnOff_On";
VAL_ 800 VFCVectorSUMVFCid40 0 "VFCOnOff_Off" 1 "VFCOnOff_On";
VAL_ 800 VFCVectorSUMVFCid41 0 "VFCOnOff_Off" 1 "VFCOnOff_On";
VAL_ 800 VFCVectorSUMVFCid42 0 "VFCOnOff_Off" 1 "VFCOnOff_On";
VAL_ 800 VFCVectorSUMVFCid43 0 "VFCOnOff_Off" 1 "VFCOnOff_On";
VAL_ 800 VFCVectorSUMVFCid44 0 "VFCOnOff_Off" 1 "VFCOnOff_On";
VAL_ 800 VFCVectorSUMVFCid45 0 "VFCOnOff_Off" 1 "VFCOnOff_On";
VAL_ 800 VFCVectorSUMVFCid46 0 "VFCOnOff_Off" 1 "VFCOnOff_On";
VAL_ 800 VFCVectorSUMVFCid47 0 "VFCOnOff_Off" 1 "VFCOnOff_On";
VAL_ 800 VFCVectorSUMVFCid48 0 "VFCOnOff_Off" 1 "VFCOnOff_On";
VAL_ 800 VFCVectorSUMVFCid49 0 "VFCOnOff_Off" 1 "VFCOnOff_On";
VAL_ 800 VFCVectorSUMVFCid5 0 "VFCOnOff_Off" 1 "VFCOnOff_On";
VAL_ 800 VFCVectorSUMVFCid50 0 "VFCOnOff_Off" 1 "VFCOnOff_On";
VAL_ 800 VFCVectorSUMVFCid51 0 "VFCOnOff_Off" 1 "VFCOnOff_On";
VAL_ 800 VFCVectorSUMVFCid52 0 "VFCOnOff_Off" 1 "VFCOnOff_On";
VAL_ 800 VFCVectorSUMVFCid53 0 "VFCOnOff_Off" 1 "VFCOnOff_On";
VAL_ 800 VFCVectorSUMVFCid54 0 "VFCOnOff_Off" 1 "VFCOnOff_On";
VAL_ 800 VFCVectorSUMVFCid55 0 "VFCOnOff_Off" 1 "VFCOnOff_On";
VAL_ 800 VFCVectorSUMVFCid56 0 "VFCOnOff_Off" 1 "VFCOnOff_On";
VAL_ 800 VFCVectorSUMVFCid57 0 "VFCOnOff_Off" 1 "VFCOnOff_On";
VAL_ 800 VFCVectorSUMVFCid58 0 "VFCOnOff_Off" 1 "VFCOnOff_On";
VAL_ 800 VFCVectorSUMVFCid59 0 "VFCOnOff_Off" 1 "VFCOnOff_On";
VAL_ 800 VFCVectorSUMVFCid6 0 "VFCOnOff_Off" 1 "VFCOnOff_On";
VAL_ 800 VFCVectorSUMVFCid60 0 "VFCOnOff_Off" 1 "VFCOnOff_On";
VAL_ 800 VFCVectorSUMVFCid61 0 "VFCOnOff_Off" 1 "VFCOnOff_On";
VAL_ 800 VFCVectorSUMVFCid7 0 "VFCOnOff_Off" 1 "VFCOnOff_On";
VAL_ 800 VFCVectorSUMVFCid8 0 "VFCOnOff_Off" 1 "VFCOnOff_On";
VAL_ 800 VFCVectorSUMVFCid9 0 "VFCOnOff_Off" 1 "VFCOnOff_On";
VAL_ 800 VFCVectorZCUDSVFCid0 0 "VFCOnOff_Off" 1 "VFCOnOff_On";
VAL_ 800 VFCVectorZCUDSVFCid1 0 "VFCOnOff_Off" 1 "VFCOnOff_On";
VAL_ 800 VFCVectorZCUDSVFCid10 0 "VFCOnOff_Off" 1 "VFCOnOff_On";
VAL_ 800 VFCVectorZCUDSVFCid11 0 "VFCOnOff_Off" 1 "VFCOnOff_On";
VAL_ 800 VFCVectorZCUDSVFCid12 0 "VFCOnOff_Off" 1 "VFCOnOff_On";
VAL_ 800 VFCVectorZCUDSVFCid13 0 "VFCOnOff_Off" 1 "VFCOnOff_On";
VAL_ 800 VFCVectorZCUDSVFCid14 0 "VFCOnOff_Off" 1 "VFCOnOff_On";
VAL_ 800 VFCVectorZCUDSVFCid15 0 "VFCOnOff_Off" 1 "VFCOnOff_On";
VAL_ 800 VFCVectorZCUDSVFCid16 0 "VFCOnOff_Off" 1 "VFCOnOff_On";
VAL_ 800 VFCVectorZCUDSVFCid17 0 "VFCOnOff_Off" 1 "VFCOnOff_On";
VAL_ 800 VFCVectorZCUDSVFCid18 0 "VFCOnOff_Off" 1 "VFCOnOff_On";
VAL_ 800 VFCVectorZCUDSVFCid19 0 "VFCOnOff_Off" 1 "VFCOnOff_On";
VAL_ 800 VFCVectorZCUDSVFCid2 0 "VFCOnOff_Off" 1 "VFCOnOff_On";
VAL_ 800 VFCVectorZCUDSVFCid20 0 "VFCOnOff_Off" 1 "VFCOnOff_On";
VAL_ 800 VFCVectorZCUDSVFCid21 0 "VFCOnOff_Off" 1 "VFCOnOff_On";
VAL_ 800 VFCVectorZCUDSVFCid22 0 "VFCOnOff_Off" 1 "VFCOnOff_On";
VAL_ 800 VFCVectorZCUDSVFCid23 0 "VFCOnOff_Off" 1 "VFCOnOff_On";
VAL_ 800 VFCVectorZCUDSVFCid24 0 "VFCOnOff_Off" 1 "VFCOnOff_On";
VAL_ 800 VFCVectorZCUDSVFCid25 0 "VFCOnOff_Off" 1 "VFCOnOff_On";
VAL_ 800 VFCVectorZCUDSVFCid26 0 "VFCOnOff_Off" 1 "VFCOnOff_On";
VAL_ 800 VFCVectorZCUDSVFCid27 0 "VFCOnOff_Off" 1 "VFCOnOff_On";
VAL_ 800 VFCVectorZCUDSVFCid28 0 "VFCOnOff_Off" 1 "VFCOnOff_On";
VAL_ 800 VFCVectorZCUDSVFCid29 0 "VFCOnOff_Off" 1 "VFCOnOff_On";
VAL_ 800 VFCVectorZCUDSVFCid3 0 "VFCOnOff_Off" 1 "VFCOnOff_On";
VAL_ 800 VFCVectorZCUDSVFCid30 0 "VFCOnOff_Off" 1 "VFCOnOff_On";
VAL_ 800 VFCVectorZCUDSVFCid31 0 "VFCOnOff_Off" 1 "VFCOnOff_On";
VAL_ 800 VFCVectorZCUDSVFCid32 0 "VFCOnOff_Off" 1 "VFCOnOff_On";
VAL_ 800 VFCVectorZCUDSVFCid33 0 "VFCOnOff_Off" 1 "VFCOnOff_On";
VAL_ 800 VFCVectorZCUDSVFCid34 0 "VFCOnOff_Off" 1 "VFCOnOff_On";
VAL_ 800 VFCVectorZCUDSVFCid35 0 "VFCOnOff_Off" 1 "VFCOnOff_On";
VAL_ 800 VFCVectorZCUDSVFCid36 0 "VFCOnOff_Off" 1 "VFCOnOff_On";
VAL_ 800 VFCVectorZCUDSVFCid37 0 "VFCOnOff_Off" 1 "VFCOnOff_On";
VAL_ 800 VFCVectorZCUDSVFCid38 0 "VFCOnOff_Off" 1 "VFCOnOff_On";
VAL_ 800 VFCVectorZCUDSVFCid39 0 "VFCOnOff_Off" 1 "VFCOnOff_On";
VAL_ 800 VFCVectorZCUDSVFCid4 0 "VFCOnOff_Off" 1 "VFCOnOff_On";
VAL_ 800 VFCVectorZCUDSVFCid40 0 "VFCOnOff_Off" 1 "VFCOnOff_On";
VAL_ 800 VFCVectorZCUDSVFCid41 0 "VFCOnOff_Off" 1 "VFCOnOff_On";
VAL_ 800 VFCVectorZCUDSVFCid42 0 "VFCOnOff_Off" 1 "VFCOnOff_On";
VAL_ 800 VFCVectorZCUDSVFCid43 0 "VFCOnOff_Off" 1 "VFCOnOff_On";
VAL_ 800 VFCVectorZCUDSVFCid44 0 "VFCOnOff_Off" 1 "VFCOnOff_On";
VAL_ 800 VFCVectorZCUDSVFCid45 0 "VFCOnOff_Off" 1 "VFCOnOff_On";
VAL_ 800 VFCVectorZCUDSVFCid46 0 "VFCOnOff_Off" 1 "VFCOnOff_On";
VAL_ 800 VFCVectorZCUDSVFCid47 0 "VFCOnOff_Off" 1 "VFCOnOff_On";
VAL_ 800 VFCVectorZCUDSVFCid48 0 "VFCOnOff_Off" 1 "VFCOnOff_On";
VAL_ 800 VFCVectorZCUDSVFCid49 0 "VFCOnOff_Off" 1 "VFCOnOff_On";
VAL_ 800 VFCVectorZCUDSVFCid5 0 "VFCOnOff_Off" 1 "VFCOnOff_On";
VAL_ 800 VFCVectorZCUDSVFCid50 0 "VFCOnOff_Off" 1 "VFCOnOff_On";
VAL_ 800 VFCVectorZCUDSVFCid51 0 "VFCOnOff_Off" 1 "VFCOnOff_On";
VAL_ 800 VFCVectorZCUDSVFCid52 0 "VFCOnOff_Off" 1 "VFCOnOff_On";
VAL_ 800 VFCVectorZCUDSVFCid53 0 "VFCOnOff_Off" 1 "VFCOnOff_On";
VAL_ 800 VFCVectorZCUDSVFCid54 0 "VFCOnOff_Off" 1 "VFCOnOff_On";
VAL_ 800 VFCVectorZCUDSVFCid55 0 "VFCOnOff_Off" 1 "VFCOnOff_On";
VAL_ 800 VFCVectorZCUDSVFCid56 0 "VFCOnOff_Off" 1 "VFCOnOff_On";
VAL_ 800 VFCVectorZCUDSVFCid57 0 "VFCOnOff_Off" 1 "VFCOnOff_On";
VAL_ 800 VFCVectorZCUDSVFCid58 0 "VFCOnOff_Off" 1 "VFCOnOff_On";
VAL_ 800 VFCVectorZCUDSVFCid59 0 "VFCOnOff_Off" 1 "VFCOnOff_On";
VAL_ 800 VFCVectorZCUDSVFCid6 0 "VFCOnOff_Off" 1 "VFCOnOff_On";
VAL_ 800 VFCVectorZCUDSVFCid60 0 "VFCOnOff_Off" 1 "VFCOnOff_On";
VAL_ 800 VFCVectorZCUDSVFCid61 0 "VFCOnOff_Off" 1 "VFCOnOff_On";
VAL_ 800 VFCVectorZCUDSVFCid7 0 "VFCOnOff_Off" 1 "VFCOnOff_On";
VAL_ 800 VFCVectorZCUDSVFCid8 0 "VFCOnOff_Off" 1 "VFCOnOff_On";
VAL_ 800 VFCVectorZCUDSVFCid9 0 "VFCOnOff_Off" 1 "VFCOnOff_On";
VAL_ 264 ChdPrtnLeftSwReq 0 "Boolean_FALSE" 1 "Boolean_TRUE";
VAL_ 264 ChdPrtnRightSwReq 0 "Boolean_FALSE" 1 "Boolean_TRUE";
VAL_ 264 DrvrSeatSnsrSts 0 "OkNokDi_Ok" 1 "OkNokDi_NotOk" 2 "OkNokDi_Disabled" 3 "OkNokDi_Reserved";
VAL_ 264 FrntSeatCmftCtrlReSeatLe 0 "CmftSet_NoReq" 1 "CmftSet_ComfortReq" 2 "CmftSet_ReturnReq";
VAL_ 264 FrntSeatCmftCtrlReSeatRi 0 "CmftSet_NoReq" 1 "CmftSet_ComfortReq" 2 "CmftSet_ReturnReq";
VAL_ 264 RowSecLeMassgRunng 0 "OnOff1_Off" 1 "OnOff1_On";
VAL_ 264 RowSecLeSeatActvSpplFct 0 "SeatActvSpplFct1_NotAvl" 1 "SeatActvSpplFct1_LumExtnAndLumHei" 2 "SeatActvSpplFct1_BackBlster" 3 "SeatActvSpplFct1_CushExtn" 4 "SeatActvSpplFct1_HdrestHeiAndHdrestTilt" 5 "SeatActvSpplFct1_MassgFct" 6 "SeatActvSpplFct1_ShoulderFct" 7 "SeatActvSpplFct1_LegrestFct";
VAL_ 264 RowSecRiMassgRunng 0 "OnOff1_Off" 1 "OnOff1_On";
VAL_ 264 RowSecRiSeatActvSpplFct 0 "SeatActvSpplFct1_NotAvl" 1 "SeatActvSpplFct1_LumExtnAndLumHei" 2 "SeatActvSpplFct1_BackBlster" 3 "SeatActvSpplFct1_CushExtn" 4 "SeatActvSpplFct1_HdrestHeiAndHdrestTilt" 5 "SeatActvSpplFct1_MassgFct" 6 "SeatActvSpplFct1_ShoulderFct" 7 "SeatActvSpplFct1_LegrestFct";
VAL_ 264 TCSCmprStrtFlt 0 "OnOff1_Off" 1 "OnOff1_On";
VAL_ 264 TCSModSwtSts 0 "Req_NoReq" 1 "Req_off" 2 "Req_Coolg" 3 "Req_Heatlg";
VAL_ 67 BookTrvlFltSts 0 "Boolean_FALSE" 1 "Boolean_TRUE";
VAL_ 67 BookTrvlSetResponse 0 "BookChargeSetResponse_Default" 1 "BookChargeSetResponse_Success" 2 "BookChargeSetResponse_Cancelled" 3 "BookChargeSetResponse_Fail";
VAL_ 67 BookTrvlTiSetReqBookTrvlTiSetReq 0 "ReqSts1_NotReqd" 1 "ReqSts1_Reqd";
VAL_ 67 CrashSts2 0 "CrashSts3_Resd1" 1 "CrashSts3_NoCrash" 2 "CrashSts3_Crash" 3 "CrashSts3_Resd2";
VAL_ 67 DchaStopByTarDrvrIndcn 0 "ReqSts1_NotReqd" 1 "ReqSts1_Reqd";
SIG_GROUP_ 880 AccrPedlLnr 1 : AccrPedlLnrAccrPedlRat AccrPedlLnrChks AccrPedlLnrCntr;
SIG_GROUP_ 880 AccrPedlNotCmpl 1 : AccrPedlNotCmplPsd AccrPedlNotCmplPsdChks AccrPedlNotCmplPsdCntr AccrPedlNotCmplPsdSts;
SIG_GROUP_ 67 BookTrvlTiSetReq 1 : BookTrvlTiSetReqBookTrvlChrgnTi BookTrvlTiSetReqBookTrvlTiSetReq;
SIG_GROUP_ 1154 BrkLiReqRegen 1 : BrkLiReqRegenChks BrkLiReqRegenCntr BrkLiReqRegenOnOff;
SIG_GROUP_ 565 CcvmSts 1 : CcvmStsVlvBlkFlt CcvmStsVlvCalibSts CcvmStsVlvCmdPosnErr CcvmStsVlvLoTErr CcvmStsVlvMoveSts CcvmStsVlvNVMFlt CcvmStsVlvOpenCircFlt CcvmStsVlvOverTErr CcvmStsVlvOverTrvlFlt CcvmStsVlvOverTWarn CcvmStsVlvOverUErr CcvmStsVlvPosn CcvmStsVlvPosnCtrlTimeOutFlt CcvmStsVlvPosnUkwnFlt CcvmStsVlvPreHeatgSts CcvmStsVlvSelfLearnFlt CcvmStsVlvShoCircFlt CcvmStsVlvSpdLvlSts CcvmStsVlvUnderUErr;
SIG_GROUP_ 565 CcvVlvSts 1 : CcvVlvStsARC CcvVlvStsIntFlt CcvVlvStsOprFlt CcvVlvStsTrqSts;
SIG_GROUP_ 565 CmprFb 1 : CmprFbCmprI CmprFbCmprIPha CmprFbCmprSpd CmprFbCmprSts1 CmprFbCmprSts2 CmprFbCmprT1 CmprFbCmprT2 CmprFbCmprU;
SIG_GROUP_ 1154 DHTStSafe 1 : DHTStSafeChks DHTStSafeCntr DHTStSafeRsv DHTStSafeSpd DHTStSafeSpdQf DHTStSafeTqRt DHTStSafeTqRtQf;
SIG_GROUP_ 1154 DtEngdSt 1 : DtEngdStDtEngdFrnt DtEngdStDtEngdRe DtEngdStDtNotEngdFrnt DtEngdStDtNotEngdRe;
SIG_GROUP_ 565 Edcp2PmpSts 1 : Edcp2PmpStsCooltPmpDryErr Edcp2PmpStsCooltPmpEmgyModSts Edcp2PmpStsCooltPmpErrSts Edcp2PmpStsCooltPmpI Edcp2PmpStsCooltPmpIErr Edcp2PmpStsCooltPmpMonrSpd Edcp2PmpStsCooltPmpPostRunSts Edcp2PmpStsCooltPmpSetPostRunReq Edcp2PmpStsCooltPmpSetSpdReq Edcp2PmpStsCooltPmpSpd Edcp2PmpStsCooltPmpT Edcp2PmpStsCooltPmpTErr Edcp2PmpStsCooltPmpU Edcp2PmpStsCooltPmpUErr Edcp2PmpStsCooltPmpUnstallSts;
SIG_GROUP_ 565 HctvSts 1 : HctvStsVlvBlkFlt HctvStsVlvCalibSts HctvStsVlvCmdPosnErr HctvStsVlvLoTErr HctvStsVlvMoveSts HctvStsVlvNVMFlt HctvStsVlvOpenCircFlt HctvStsVlvOverTErr HctvStsVlvOverTrvlFlt HctvStsVlvOverTWarn HctvStsVlvOverUErr HctvStsVlvPosn HctvStsVlvPosnCtrlTimeOutFlt HctvStsVlvPosnUkwnFlt HctvStsVlvPreHeatgSts HctvStsVlvSelfLearnFlt HctvStsVlvShoCircFlt HctvStsVlvSpdLvlSts HctvStsVlvUnderUErr;
SIG_GROUP_ 565 HmiDefrstrElecSts 1 : HmiDefrstrElecStsFrnt HmiDefrstrElecStsMirrr HmiDefrstrElecStsRe;
SIG_GROUP_ 565 HvBattPmpStat 1 : HvBattPmpStatCooltPmpDryErr HvBattPmpStatCooltPmpEmgyModSts HvBattPmpStatCooltPmpErrSts HvBattPmpStatCooltPmpI HvBattPmpStatCooltPmpIErr HvBattPmpStatCooltPmpMonrSpd HvBattPmpStatCooltPmpPostRunSts HvBattPmpStatCooltPmpSetPostRunReq HvBattPmpStatCooltPmpSetSpdReq HvBattPmpStatCooltPmpSpd HvBattPmpStatCooltPmpT HvBattPmpStatCooltPmpTErr HvBattPmpStatCooltPmpU HvBattPmpStatCooltPmpUErr HvBattPmpStatCooltPmpUnstallSts;
SIG_GROUP_ 800 HvCooltHeatrEnadWhE2E 1 : HvCooltHeatrEnadWhE2EChks HvCooltHeatrEnadWhE2ECntr HvCooltHeatrEnadWhE2EHvchEnad;
SIG_GROUP_ 528 HvSysRlySts 1 : HvSysRlyStsChks HvSysRlyStsCntr HvSysRlyStsHvSysRlySts;
SIG_GROUP_ 1154 IsgTqAllwd 1 : IsgTqAllwdChks IsgTqAllwdCntr IsgTqAllwdIsgTqAllwd;
SIG_GROUP_ 1154 OvrdDecelByDrvr 1 : OvrdDecelByDrvrChks OvrdDecelByDrvrCntr OvrdDecelByDrvrOvrdDecelByDrvr;
SIG_GROUP_ 1154 ParkByDrvrWhlsFrntSafe 1 : ParkByDrvrWhlsFrntSafeChks ParkByDrvrWhlsFrntSafeCntr ParkByDrvrWhlsFrntSafeSts;
SIG_GROUP_ 1154 PropLgtCtrlModCfmd 1 : PropLgtCtrlModCfmdChks PropLgtCtrlModCfmdCntr PropLgtCtrlModCfmdLgtDegradation PropLgtCtrlModCfmdPropLgtCtrlModCfmd;
SIG_GROUP_ 67 PrpsnDataEvtA 1 : PrpsnDataEvtACnt PrpsnDataEvtAData1 PrpsnDataEvtAData2 PrpsnDataEvtAData3 PrpsnDataEvtAData4 PrpsnDataEvtAData5 PrpsnDataEvtAData6 PrpsnDataEvtAID;
SIG_GROUP_ 67 PrpsnDataEvtB 1 : PrpsnDataEvtBCnt PrpsnDataEvtBData1 PrpsnDataEvtBData2 PrpsnDataEvtBData3 PrpsnDataEvtBData4 PrpsnDataEvtBData5 PrpsnDataEvtBData6 PrpsnDataEvtBID;
SIG_GROUP_ 1154 PtAllwdToTrsmActrSafe 1 : PtAllwdToTrsmActrSafeChks PtAllwdToTrsmActrSafeCntr PtAllwdToTrsmActrSafePtAllwdToTrsmActr;
SIG_GROUP_ 1154 PtBrkTqCpTot 1 : PtBrkTqCpTot1 PtBrkTqCpTotQf;
SIG_GROUP_ 1154 PtJTot 1 : PtJTotAtTrsmAxleOutp PtJTotChks PtJTotCntr;
SIG_GROUP_ 1154 PtRgnTarTqAtReAxle 1 : PtRgnTarTqAtReAxleAtReAxle PtRgnTarTqAtReAxleQf;
SIG_GROUP_ 1154 PtTotRgnTarTq 1 : PtTotRgnTarTq1 PtTotRgnTarTqQf;
SIG_GROUP_ 528 SlopReducEngCoeff 1 : SlopReducEngCoeffSlopEqu12 SlopReducEngCoeffSlopEqu2 SlopReducEngCoeffSlopEqu4 SlopReducEngCoeffSlopEqu6 SlopReducEngCoeffSlopEqu9;
SIG_GROUP_ 528 SlopRiseEngCoeff 1 : SlopRiseEngCoeffSlopEqu12 SlopRiseEngCoeffSlopEqu2 SlopRiseEngCoeffSlopEqu4 SlopRiseEngCoeffSlopEqu6 SlopRiseEngCoeffSlopEqu9;
SIG_GROUP_ 528 SpdRelatWght 1 : SpdRelatWghtSpdEqu10 SpdRelatWghtSpdEqu100 SpdRelatWghtSpdEqu120 SpdRelatWghtSpdEqu140 SpdRelatWghtSpdEqu20 SpdRelatWghtSpdEqu40 SpdRelatWghtSpdEqu60 SpdRelatWghtSpdEqu80;
SIG_GROUP_ 1154 TrsmActrPosn2 1 : TrsmActrPosn2TrsmActrPosn TrsmActrPosn2TrsmActrPosnChks TrsmActrPosn2TrsmActrPosnCntr;
SIG_GROUP_ 800 VFCVectorPCM 1 : VFCVectorPCMBlockID VFCVectorPCMVFCid0 VFCVectorPCMVFCid1 VFCVectorPCMVFCid10 VFCVectorPCMVFCid11 VFCVectorPCMVFCid12 VFCVectorPCMVFCid13 VFCVectorPCMVFCid14 VFCVectorPCMVFCid15 VFCVectorPCMVFCid16 VFCVectorPCMVFCid17 VFCVectorPCMVFCid18 VFCVectorPCMVFCid19 VFCVectorPCMVFCid2 VFCVectorPCMVFCid20 VFCVectorPCMVFCid21 VFCVectorPCMVFCid22 VFCVectorPCMVFCid23 VFCVectorPCMVFCid24 VFCVectorPCMVFCid25 VFCVectorPCMVFCid26 VFCVectorPCMVFCid27 VFCVectorPCMVFCid28 VFCVectorPCMVFCid29 VFCVectorPCMVFCid3 VFCVectorPCMVFCid30 VFCVectorPCMVFCid31 VFCVectorPCMVFCid32 VFCVectorPCMVFCid33 VFCVectorPCMVFCid34 VFCVectorPCMVFCid35 VFCVectorPCMVFCid36 VFCVectorPCMVFCid37 VFCVectorPCMVFCid38 VFCVectorPCMVFCid39 VFCVectorPCMVFCid4 VFCVectorPCMVFCid40 VFCVectorPCMVFCid41 VFCVectorPCMVFCid42 VFCVectorPCMVFCid43 VFCVectorPCMVFCid44 VFCVectorPCMVFCid45 VFCVectorPCMVFCid46 VFCVectorPCMVFCid47 VFCVectorPCMVFCid48 VFCVectorPCMVFCid49 VFCVectorPCMVFCid5 VFCVectorPCMVFCid50 VFCVectorPCMVFCid51 VFCVectorPCMVFCid52 VFCVectorPCMVFCid53 VFCVectorPCMVFCid54 VFCVectorPCMVFCid55 VFCVectorPCMVFCid56 VFCVectorPCMVFCid57 VFCVectorPCMVFCid58 VFCVectorPCMVFCid59 VFCVectorPCMVFCid6 VFCVectorPCMVFCid60 VFCVectorPCMVFCid61 VFCVectorPCMVFCid7 VFCVectorPCMVFCid8 VFCVectorPCMVFCid9;
SIG_GROUP_ 800 VFCVectorPOT 1 : VFCVectorPOTBlockID VFCVectorPOTVFCid0 VFCVectorPOTVFCid1 VFCVectorPOTVFCid10 VFCVectorPOTVFCid11 VFCVectorPOTVFCid12 VFCVectorPOTVFCid13 VFCVectorPOTVFCid14 VFCVectorPOTVFCid15 VFCVectorPOTVFCid16 VFCVectorPOTVFCid17 VFCVectorPOTVFCid18 VFCVectorPOTVFCid19 VFCVectorPOTVFCid2 VFCVectorPOTVFCid20 VFCVectorPOTVFCid21 VFCVectorPOTVFCid22 VFCVectorPOTVFCid23 VFCVectorPOTVFCid24 VFCVectorPOTVFCid25 VFCVectorPOTVFCid26 VFCVectorPOTVFCid27 VFCVectorPOTVFCid28 VFCVectorPOTVFCid29 VFCVectorPOTVFCid3 VFCVectorPOTVFCid30 VFCVectorPOTVFCid31 VFCVectorPOTVFCid32 VFCVectorPOTVFCid33 VFCVectorPOTVFCid34 VFCVectorPOTVFCid35 VFCVectorPOTVFCid36 VFCVectorPOTVFCid37 VFCVectorPOTVFCid38 VFCVectorPOTVFCid39 VFCVectorPOTVFCid4 VFCVectorPOTVFCid40 VFCVectorPOTVFCid41 VFCVectorPOTVFCid42 VFCVectorPOTVFCid43 VFCVectorPOTVFCid44 VFCVectorPOTVFCid45 VFCVectorPOTVFCid46 VFCVectorPOTVFCid47 VFCVectorPOTVFCid48 VFCVectorPOTVFCid49 VFCVectorPOTVFCid5 VFCVectorPOTVFCid50 VFCVectorPOTVFCid51 VFCVectorPOTVFCid52 VFCVectorPOTVFCid53 VFCVectorPOTVFCid54 VFCVectorPOTVFCid55 VFCVectorPOTVFCid56 VFCVectorPOTVFCid57 VFCVectorPOTVFCid58 VFCVectorPOTVFCid59 VFCVectorPOTVFCid6 VFCVectorPOTVFCid60 VFCVectorPOTVFCid61 VFCVectorPOTVFCid7 VFCVectorPOTVFCid8 VFCVectorPOTVFCid9;
SIG_GROUP_ 800 VFCVectorSRS 1 : VFCVectorSRSBlockID VFCVectorSRSVFCid0 VFCVectorSRSVFCid1 VFCVectorSRSVFCid10 VFCVectorSRSVFCid11 VFCVectorSRSVFCid12 VFCVectorSRSVFCid13 VFCVectorSRSVFCid14 VFCVectorSRSVFCid15 VFCVectorSRSVFCid16 VFCVectorSRSVFCid17 VFCVectorSRSVFCid18 VFCVectorSRSVFCid19 VFCVectorSRSVFCid2 VFCVectorSRSVFCid20 VFCVectorSRSVFCid21 VFCVectorSRSVFCid22 VFCVectorSRSVFCid23 VFCVectorSRSVFCid24 VFCVectorSRSVFCid25 VFCVectorSRSVFCid26 VFCVectorSRSVFCid27 VFCVectorSRSVFCid28 VFCVectorSRSVFCid29 VFCVectorSRSVFCid3 VFCVectorSRSVFCid30 VFCVectorSRSVFCid31 VFCVectorSRSVFCid32 VFCVectorSRSVFCid33 VFCVectorSRSVFCid34 VFCVectorSRSVFCid35 VFCVectorSRSVFCid36 VFCVectorSRSVFCid37 VFCVectorSRSVFCid38 VFCVectorSRSVFCid39 VFCVectorSRSVFCid4 VFCVectorSRSVFCid40 VFCVectorSRSVFCid41 VFCVectorSRSVFCid42 VFCVectorSRSVFCid43 VFCVectorSRSVFCid44 VFCVectorSRSVFCid45 VFCVectorSRSVFCid46 VFCVectorSRSVFCid47 VFCVectorSRSVFCid48 VFCVectorSRSVFCid49 VFCVectorSRSVFCid5 VFCVectorSRSVFCid50 VFCVectorSRSVFCid51 VFCVectorSRSVFCid52 VFCVectorSRSVFCid53 VFCVectorSRSVFCid54 VFCVectorSRSVFCid55 VFCVectorSRSVFCid56 VFCVectorSRSVFCid57 VFCVectorSRSVFCid58 VFCVectorSRSVFCid59 VFCVectorSRSVFCid6 VFCVectorSRSVFCid60 VFCVectorSRSVFCid61 VFCVectorSRSVFCid7 VFCVectorSRSVFCid8 VFCVectorSRSVFCid9;
SIG_GROUP_ 800 VFCVectorSUM 1 : VFCVectorSUMBlockID VFCVectorSUMVFCid0 VFCVectorSUMVFCid1 VFCVectorSUMVFCid10 VFCVectorSUMVFCid11 VFCVectorSUMVFCid12 VFCVectorSUMVFCid13 VFCVectorSUMVFCid14 VFCVectorSUMVFCid15 VFCVectorSUMVFCid16 VFCVectorSUMVFCid17 VFCVectorSUMVFCid18 VFCVectorSUMVFCid19 VFCVectorSUMVFCid2 VFCVectorSUMVFCid20 VFCVectorSUMVFCid21 VFCVectorSUMVFCid22 VFCVectorSUMVFCid23 VFCVectorSUMVFCid24 VFCVectorSUMVFCid25 VFCVectorSUMVFCid26 VFCVectorSUMVFCid27 VFCVectorSUMVFCid28 VFCVectorSUMVFCid29 VFCVectorSUMVFCid3 VFCVectorSUMVFCid30 VFCVectorSUMVFCid31 VFCVectorSUMVFCid32 VFCVectorSUMVFCid33 VFCVectorSUMVFCid34 VFCVectorSUMVFCid35 VFCVectorSUMVFCid36 VFCVectorSUMVFCid37 VFCVectorSUMVFCid38 VFCVectorSUMVFCid39 VFCVectorSUMVFCid4 VFCVectorSUMVFCid40 VFCVectorSUMVFCid41 VFCVectorSUMVFCid42 VFCVectorSUMVFCid43 VFCVectorSUMVFCid44 VFCVectorSUMVFCid45 VFCVectorSUMVFCid46 VFCVectorSUMVFCid47 VFCVectorSUMVFCid48 VFCVectorSUMVFCid49 VFCVectorSUMVFCid5 VFCVectorSUMVFCid50 VFCVectorSUMVFCid51 VFCVectorSUMVFCid52 VFCVectorSUMVFCid53 VFCVectorSUMVFCid54 VFCVectorSUMVFCid55 VFCVectorSUMVFCid56 VFCVectorSUMVFCid57 VFCVectorSUMVFCid58 VFCVectorSUMVFCid59 VFCVectorSUMVFCid6 VFCVectorSUMVFCid60 VFCVectorSUMVFCid61 VFCVectorSUMVFCid7 VFCVectorSUMVFCid8 VFCVectorSUMVFCid9;
SIG_GROUP_ 800 VFCVectorZCUDS 1 : VFCVectorZCUDSBlockID VFCVectorZCUDSVFCid0 VFCVectorZCUDSVFCid1 VFCVectorZCUDSVFCid10 VFCVectorZCUDSVFCid11 VFCVectorZCUDSVFCid12 VFCVectorZCUDSVFCid13 VFCVectorZCUDSVFCid14 VFCVectorZCUDSVFCid15 VFCVectorZCUDSVFCid16 VFCVectorZCUDSVFCid17 VFCVectorZCUDSVFCid18 VFCVectorZCUDSVFCid19 VFCVectorZCUDSVFCid2 VFCVectorZCUDSVFCid20 VFCVectorZCUDSVFCid21 VFCVectorZCUDSVFCid22 VFCVectorZCUDSVFCid23 VFCVectorZCUDSVFCid24 VFCVectorZCUDSVFCid25 VFCVectorZCUDSVFCid26 VFCVectorZCUDSVFCid27 VFCVectorZCUDSVFCid28 VFCVectorZCUDSVFCid29 VFCVectorZCUDSVFCid3 VFCVectorZCUDSVFCid30 VFCVectorZCUDSVFCid31 VFCVectorZCUDSVFCid32 VFCVectorZCUDSVFCid33 VFCVectorZCUDSVFCid34 VFCVectorZCUDSVFCid35 VFCVectorZCUDSVFCid36 VFCVectorZCUDSVFCid37 VFCVectorZCUDSVFCid38 VFCVectorZCUDSVFCid39 VFCVectorZCUDSVFCid4 VFCVectorZCUDSVFCid40 VFCVectorZCUDSVFCid41 VFCVectorZCUDSVFCid42 VFCVectorZCUDSVFCid43 VFCVectorZCUDSVFCid44 VFCVectorZCUDSVFCid45 VFCVectorZCUDSVFCid46 VFCVectorZCUDSVFCid47 VFCVectorZCUDSVFCid48 VFCVectorZCUDSVFCid49 VFCVectorZCUDSVFCid5 VFCVectorZCUDSVFCid50 VFCVectorZCUDSVFCid51 VFCVectorZCUDSVFCid52 VFCVectorZCUDSVFCid53 VFCVectorZCUDSVFCid54 VFCVectorZCUDSVFCid55 VFCVectorZCUDSVFCid56 VFCVectorZCUDSVFCid57 VFCVectorZCUDSVFCid58 VFCVectorZCUDSVFCid59 VFCVectorZCUDSVFCid6 VFCVectorZCUDSVFCid60 VFCVectorZCUDSVFCid61 VFCVectorZCUDSVFCid7 VFCVectorZCUDSVFCid8 VFCVectorZCUDSVFCid9;
