VERSION "ZCU_CANFD2"

NS_ :

BS_ :

BU_ :  ETC IHU ZCUD ZCUP

BO_ 99 DhuZCUCANFD2Fr06 : 64 IHU
 SG_ DwnLoadDynLtgPrmForFrntRIGrp1_UB : 36|1@0+ (1,0) [0|1] "" ZCUD
 SG_ DwnLoadDynLtgPrmForFrntRIGrp10_UB : 396|1@0+ (1,0) [0|1] "" ZCUD
 SG_ DwnLoadDynLtgPrmForFrntRIGrp10ContinueTime : 367|8@0+ (1.0,0.0) [0.0|255.0] "Unitless" ZCUD
 SG_ DwnLoadDynLtgPrmForFrntRIGrp10HighBrightness : 375|4@0+ (1.0,0.0) [0.0|10.0] "Unitless" ZCUD
 SG_ DwnLoadDynLtgPrmForFrntRIGrp10LowBrightness : 371|4@0+ (1.0,0.0) [0.0|10.0] "Unitless" ZCUD
 SG_ DwnLoadDynLtgPrmForFrntRIGrp10Mode1 : 383|6@0+ (1,0) [0|63] "" ZCUD
 SG_ DwnLoadDynLtgPrmForFrntRIGrp10OffsetTime : 391|6@0+ (1.0,0.0) [0.0|63.0] "Unitless" ZCUD
 SG_ DwnLoadDynLtgPrmForFrntRIGrp10Timestamp : 399|3@0+ (1.0,0.0) [0.0|7.0] "Unitless" ZCUD
 SG_ DwnLoadDynLtgPrmForFrntRIGrp11_UB : 436|1@0+ (1,0) [0|1] "" ZCUD
 SG_ DwnLoadDynLtgPrmForFrntRIGrp11ContinueTime : 407|8@0+ (1.0,0.0) [0.0|255.0] "Unitless" ZCUD
 SG_ DwnLoadDynLtgPrmForFrntRIGrp11HighBrightness : 415|4@0+ (1.0,0.0) [0.0|10.0] "Unitless" ZCUD
 SG_ DwnLoadDynLtgPrmForFrntRIGrp11LowBrightness : 411|4@0+ (1.0,0.0) [0.0|10.0] "Unitless" ZCUD
 SG_ DwnLoadDynLtgPrmForFrntRIGrp11Mode1 : 423|6@0+ (1,0) [0|63] "" ZCUD
 SG_ DwnLoadDynLtgPrmForFrntRIGrp11OffsetTime : 431|6@0+ (1.0,0.0) [0.0|63.0] "Unitless" ZCUD
 SG_ DwnLoadDynLtgPrmForFrntRIGrp11Timestamp : 439|3@0+ (1.0,0.0) [0.0|7.0] "Unitless" ZCUD
 SG_ DwnLoadDynLtgPrmForFrntRIGrp12_UB : 476|1@0+ (1,0) [0|1] "" ZCUD
 SG_ DwnLoadDynLtgPrmForFrntRIGrp12ContinueTime : 447|8@0+ (1.0,0.0) [0.0|255.0] "Unitless" ZCUD
 SG_ DwnLoadDynLtgPrmForFrntRIGrp12HighBrightness : 455|4@0+ (1.0,0.0) [0.0|10.0] "Unitless" ZCUD
 SG_ DwnLoadDynLtgPrmForFrntRIGrp12LowBrightness : 451|4@0+ (1.0,0.0) [0.0|10.0] "Unitless" ZCUD
 SG_ DwnLoadDynLtgPrmForFrntRIGrp12Mode1 : 463|6@0+ (1,0) [0|63] "" ZCUD
 SG_ DwnLoadDynLtgPrmForFrntRIGrp12OffsetTime : 471|6@0+ (1.0,0.0) [0.0|63.0] "Unitless" ZCUD
 SG_ DwnLoadDynLtgPrmForFrntRIGrp12Timestamp : 479|3@0+ (1.0,0.0) [0.0|7.0] "Unitless" ZCUD
 SG_ DwnLoadDynLtgPrmForFrntRIGrp1ContinueTime : 7|8@0+ (1.0,0.0) [0.0|255.0] "Unitless" ZCUD
 SG_ DwnLoadDynLtgPrmForFrntRIGrp1HighBrightness : 15|4@0+ (1.0,0.0) [0.0|10.0] "Unitless" ZCUD
 SG_ DwnLoadDynLtgPrmForFrntRIGrp1LowBrightness : 11|4@0+ (1.0,0.0) [0.0|10.0] "Unitless" ZCUD
 SG_ DwnLoadDynLtgPrmForFrntRIGrp1Mode1 : 23|6@0+ (1,0) [0|63] "" ZCUD
 SG_ DwnLoadDynLtgPrmForFrntRIGrp1OffsetTime : 31|6@0+ (1.0,0.0) [0.0|63.0] "Unitless" ZCUD
 SG_ DwnLoadDynLtgPrmForFrntRIGrp1Timestamp : 39|3@0+ (1.0,0.0) [0.0|7.0] "Unitless" ZCUD
 SG_ DwnLoadDynLtgPrmForFrntRIGrp2_UB : 76|1@0+ (1,0) [0|1] "" ZCUD
 SG_ DwnLoadDynLtgPrmForFrntRIGrp2ContinueTime : 47|8@0+ (1.0,0.0) [0.0|255.0] "Unitless" ZCUD
 SG_ DwnLoadDynLtgPrmForFrntRIGrp2HighBrightness : 55|4@0+ (1.0,0.0) [0.0|10.0] "Unitless" ZCUD
 SG_ DwnLoadDynLtgPrmForFrntRIGrp2LowBrightness : 51|4@0+ (1.0,0.0) [0.0|10.0] "Unitless" ZCUD
 SG_ DwnLoadDynLtgPrmForFrntRIGrp2Mode1 : 63|6@0+ (1,0) [0|63] "" ZCUD
 SG_ DwnLoadDynLtgPrmForFrntRIGrp2OffsetTime : 71|6@0+ (1.0,0.0) [0.0|63.0] "Unitless" ZCUD
 SG_ DwnLoadDynLtgPrmForFrntRIGrp2Timestamp : 79|3@0+ (1.0,0.0) [0.0|7.0] "Unitless" ZCUD
 SG_ DwnLoadDynLtgPrmForFrntRIGrp3_UB : 116|1@0+ (1,0) [0|1] "" ZCUD
 SG_ DwnLoadDynLtgPrmForFrntRIGrp3ContinueTime : 87|8@0+ (1.0,0.0) [0.0|255.0] "Unitless" ZCUD
 SG_ DwnLoadDynLtgPrmForFrntRIGrp3HighBrightness : 95|4@0+ (1.0,0.0) [0.0|10.0] "Unitless" ZCUD
 SG_ DwnLoadDynLtgPrmForFrntRIGrp3LowBrightness : 91|4@0+ (1.0,0.0) [0.0|10.0] "Unitless" ZCUD
 SG_ DwnLoadDynLtgPrmForFrntRIGrp3Mode1 : 103|6@0+ (1,0) [0|63] "" ZCUD
 SG_ DwnLoadDynLtgPrmForFrntRIGrp3OffsetTime : 111|6@0+ (1.0,0.0) [0.0|63.0] "Unitless" ZCUD
 SG_ DwnLoadDynLtgPrmForFrntRIGrp3Timestamp : 119|3@0+ (1.0,0.0) [0.0|7.0] "Unitless" ZCUD
 SG_ DwnLoadDynLtgPrmForFrntRIGrp4_UB : 156|1@0+ (1,0) [0|1] "" ZCUD
 SG_ DwnLoadDynLtgPrmForFrntRIGrp4ContinueTime : 127|8@0+ (1.0,0.0) [0.0|255.0] "Unitless" ZCUD
 SG_ DwnLoadDynLtgPrmForFrntRIGrp4HighBrightness : 135|4@0+ (1.0,0.0) [0.0|10.0] "Unitless" ZCUD
 SG_ DwnLoadDynLtgPrmForFrntRIGrp4LowBrightness : 131|4@0+ (1.0,0.0) [0.0|10.0] "Unitless" ZCUD
 SG_ DwnLoadDynLtgPrmForFrntRIGrp4Mode1 : 143|6@0+ (1,0) [0|63] "" ZCUD
 SG_ DwnLoadDynLtgPrmForFrntRIGrp4OffsetTime : 151|6@0+ (1.0,0.0) [0.0|63.0] "Unitless" ZCUD
 SG_ DwnLoadDynLtgPrmForFrntRIGrp4Timestamp : 159|3@0+ (1.0,0.0) [0.0|7.0] "Unitless" ZCUD
 SG_ DwnLoadDynLtgPrmForFrntRIGrp5_UB : 196|1@0+ (1,0) [0|1] "" ZCUD
 SG_ DwnLoadDynLtgPrmForFrntRIGrp5ContinueTime : 167|8@0+ (1.0,0.0) [0.0|255.0] "Unitless" ZCUD
 SG_ DwnLoadDynLtgPrmForFrntRIGrp5HighBrightness : 175|4@0+ (1.0,0.0) [0.0|10.0] "Unitless" ZCUD
 SG_ DwnLoadDynLtgPrmForFrntRIGrp5LowBrightness : 171|4@0+ (1.0,0.0) [0.0|10.0] "Unitless" ZCUD
 SG_ DwnLoadDynLtgPrmForFrntRIGrp5Mode1 : 183|6@0+ (1,0) [0|63] "" ZCUD
 SG_ DwnLoadDynLtgPrmForFrntRIGrp5OffsetTime : 191|6@0+ (1.0,0.0) [0.0|63.0] "Unitless" ZCUD
 SG_ DwnLoadDynLtgPrmForFrntRIGrp5Timestamp : 199|3@0+ (1.0,0.0) [0.0|7.0] "Unitless" ZCUD
 SG_ DwnLoadDynLtgPrmForFrntRIGrp6_UB : 236|1@0+ (1,0) [0|1] "" ZCUD
 SG_ DwnLoadDynLtgPrmForFrntRIGrp6ContinueTime : 207|8@0+ (1.0,0.0) [0.0|255.0] "Unitless" ZCUD
 SG_ DwnLoadDynLtgPrmForFrntRIGrp6HighBrightness : 215|4@0+ (1.0,0.0) [0.0|10.0] "Unitless" ZCUD
 SG_ DwnLoadDynLtgPrmForFrntRIGrp6LowBrightness : 211|4@0+ (1.0,0.0) [0.0|10.0] "Unitless" ZCUD
 SG_ DwnLoadDynLtgPrmForFrntRIGrp6Mode1 : 223|6@0+ (1,0) [0|63] "" ZCUD
 SG_ DwnLoadDynLtgPrmForFrntRIGrp6OffsetTime : 231|6@0+ (1.0,0.0) [0.0|63.0] "Unitless" ZCUD
 SG_ DwnLoadDynLtgPrmForFrntRIGrp6Timestamp : 239|3@0+ (1.0,0.0) [0.0|7.0] "Unitless" ZCUD
 SG_ DwnLoadDynLtgPrmForFrntRIGrp7_UB : 276|1@0+ (1,0) [0|1] "" ZCUD
 SG_ DwnLoadDynLtgPrmForFrntRIGrp7ContinueTime : 247|8@0+ (1.0,0.0) [0.0|255.0] "Unitless" ZCUD
 SG_ DwnLoadDynLtgPrmForFrntRIGrp7HighBrightness : 255|4@0+ (1.0,0.0) [0.0|10.0] "Unitless" ZCUD
 SG_ DwnLoadDynLtgPrmForFrntRIGrp7LowBrightness : 251|4@0+ (1.0,0.0) [0.0|10.0] "Unitless" ZCUD
 SG_ DwnLoadDynLtgPrmForFrntRIGrp7Mode1 : 263|6@0+ (1,0) [0|63] "" ZCUD
 SG_ DwnLoadDynLtgPrmForFrntRIGrp7OffsetTime : 271|6@0+ (1.0,0.0) [0.0|63.0] "Unitless" ZCUD
 SG_ DwnLoadDynLtgPrmForFrntRIGrp7Timestamp : 279|3@0+ (1.0,0.0) [0.0|7.0] "Unitless" ZCUD
 SG_ DwnLoadDynLtgPrmForFrntRIGrp8_UB : 316|1@0+ (1,0) [0|1] "" ZCUD
 SG_ DwnLoadDynLtgPrmForFrntRIGrp8ContinueTime : 287|8@0+ (1.0,0.0) [0.0|255.0] "Unitless" ZCUD
 SG_ DwnLoadDynLtgPrmForFrntRIGrp8HighBrightness : 295|4@0+ (1.0,0.0) [0.0|10.0] "Unitless" ZCUD
 SG_ DwnLoadDynLtgPrmForFrntRIGrp8LowBrightness : 291|4@0+ (1.0,0.0) [0.0|10.0] "Unitless" ZCUD
 SG_ DwnLoadDynLtgPrmForFrntRIGrp8Mode1 : 303|6@0+ (1,0) [0|63] "" ZCUD
 SG_ DwnLoadDynLtgPrmForFrntRIGrp8OffsetTime : 311|6@0+ (1.0,0.0) [0.0|63.0] "Unitless" ZCUD
 SG_ DwnLoadDynLtgPrmForFrntRIGrp8Timestamp : 319|3@0+ (1.0,0.0) [0.0|7.0] "Unitless" ZCUD
 SG_ DwnLoadDynLtgPrmForFrntRIGrp9_UB : 356|1@0+ (1,0) [0|1] "" ZCUD
 SG_ DwnLoadDynLtgPrmForFrntRIGrp9ContinueTime : 327|8@0+ (1.0,0.0) [0.0|255.0] "Unitless" ZCUD
 SG_ DwnLoadDynLtgPrmForFrntRIGrp9HighBrightness : 335|4@0+ (1.0,0.0) [0.0|10.0] "Unitless" ZCUD
 SG_ DwnLoadDynLtgPrmForFrntRIGrp9LowBrightness : 331|4@0+ (1.0,0.0) [0.0|10.0] "Unitless" ZCUD
 SG_ DwnLoadDynLtgPrmForFrntRIGrp9Mode1 : 343|6@0+ (1,0) [0|63] "" ZCUD
 SG_ DwnLoadDynLtgPrmForFrntRIGrp9OffsetTime : 351|6@0+ (1.0,0.0) [0.0|63.0] "Unitless" ZCUD
 SG_ DwnLoadDynLtgPrmForFrntRIGrp9Timestamp : 359|3@0+ (1.0,0.0) [0.0|7.0] "Unitless" ZCUD
 SG_ TelmBookSeatHeatClimalReq_UB : 475|1@0+ (1,0) [0|1] "" ZCUP
 SG_ TelmBookSeatHeatClimalReqDrvHeatClimaLvl : 487|2@0+ (1,0) [0|3] "" ZCUP
 SG_ TelmBookSeatHeatClimalReqPassHeatClimaLvl : 485|2@0+ (1,0) [0|3] "" ZCUP
 SG_ TelmBookSeatHeatClimalReqSecLeHeatClimaLvl : 483|2@0+ (1,0) [0|3] "" ZCUP
 SG_ TelmBookSeatHeatClimalReqSecRiHeatClimaLvl : 481|2@0+ (1,0) [0|3] "" ZCUP
 SG_ TelmBookSeatHeatClimalReqThrdLeHeatClimaLvl : 495|2@0+ (1,0) [0|3] "" ZCUP
 SG_ TelmBookSeatHeatClimalReqThrdRiHeatClimaLvl : 493|2@0+ (1,0) [0|3] "" ZCUP
 SG_ TelmBookSeatVentnClimalReq_UB : 474|1@0+ (1,0) [0|1] "" ZCUP
 SG_ TelmBookSeatVentnClimalReqDrvVentnClimaLvl : 491|2@0+ (1,0) [0|3] "" ZCUP
 SG_ TelmBookSeatVentnClimalReqPassVentnClimaLvl : 489|2@0+ (1,0) [0|3] "" ZCUP
 SG_ TelmBookSeatVentnClimalReqSecLeVentnClimaLvl : 503|2@0+ (1,0) [0|3] "" ZCUP
 SG_ TelmBookSeatVentnClimalReqSecRiVentnClimaLvl : 501|2@0+ (1,0) [0|3] "" ZCUP
 SG_ TelmBookSeatVentnClimalReqThrdLeVentnClimaLvl : 499|2@0+ (1,0) [0|3] "" ZCUP
 SG_ TelmBookSeatVentnClimalReqThrdRiVentnClimaL : 497|2@0+ (1,0) [0|3] "" ZCUP
 SG_ TelmClimaTSet_UB : 504|1@0+ (1,0) [0|1] "" ZCUP
 SG_ TelmClimaTSetHmiCmptmtTSpSpcl : 506|2@0+ (1,0) [0|3] "" ZCUP
 SG_ TelmClimaTSetTempRange : 511|5@0+ (0.5,15.5) [15.5|28.5] "degC" ZCUP
 SG_ TelmStrtEngForChrgnReq : 35|2@0+ (1,0) [0|3] "" ZCUD
 SG_ TelmStrtEngForChrgnReq_UB : 33|1@0+ (1,0) [0|1] "" ZCUD

BO_ 103 DhuZCUCANFD2Fr07 : 64 IHU
 SG_ DwnLoadDynLtgPrmForFrntRIGrp13_UB : 36|1@0+ (1,0) [0|1] "" ZCUD
 SG_ DwnLoadDynLtgPrmForFrntRIGrp13ContinueTime : 7|8@0+ (1.0,0.0) [0.0|255.0] "Unitless" ZCUD
 SG_ DwnLoadDynLtgPrmForFrntRIGrp13HighBrightness : 15|4@0+ (1.0,0.0) [0.0|10.0] "Unitless" ZCUD
 SG_ DwnLoadDynLtgPrmForFrntRIGrp13LowBrightness : 11|4@0+ (1.0,0.0) [0.0|10.0] "Unitless" ZCUD
 SG_ DwnLoadDynLtgPrmForFrntRIGrp13Mode1 : 23|6@0+ (1,0) [0|63] "" ZCUD
 SG_ DwnLoadDynLtgPrmForFrntRIGrp13OffsetTime : 31|6@0+ (1.0,0.0) [0.0|63.0] "Unitless" ZCUD
 SG_ DwnLoadDynLtgPrmForFrntRIGrp13Timestamp : 39|3@0+ (1.0,0.0) [0.0|7.0] "Unitless" ZCUD
 SG_ DwnLoadDynLtgPrmForFrntRIGrp14_UB : 76|1@0+ (1,0) [0|1] "" ZCUD
 SG_ DwnLoadDynLtgPrmForFrntRIGrp14ContinueTime : 47|8@0+ (1.0,0.0) [0.0|255.0] "Unitless" ZCUD
 SG_ DwnLoadDynLtgPrmForFrntRIGrp14HighBrightness : 55|4@0+ (1.0,0.0) [0.0|10.0] "Unitless" ZCUD
 SG_ DwnLoadDynLtgPrmForFrntRIGrp14LowBrightness : 51|4@0+ (1.0,0.0) [0.0|10.0] "Unitless" ZCUD
 SG_ DwnLoadDynLtgPrmForFrntRIGrp14Mode1 : 63|6@0+ (1,0) [0|63] "" ZCUD
 SG_ DwnLoadDynLtgPrmForFrntRIGrp14OffsetTime : 71|6@0+ (1.0,0.0) [0.0|63.0] "Unitless" ZCUD
 SG_ DwnLoadDynLtgPrmForFrntRIGrp14Timestamp : 79|3@0+ (1.0,0.0) [0.0|7.0] "Unitless" ZCUD
 SG_ DwnLoadDynLtgPrmForFrntRIGrp15_UB : 116|1@0+ (1,0) [0|1] "" ZCUD
 SG_ DwnLoadDynLtgPrmForFrntRIGrp15ContinueTime : 87|8@0+ (1.0,0.0) [0.0|255.0] "Unitless" ZCUD
 SG_ DwnLoadDynLtgPrmForFrntRIGrp15HighBrightness : 95|4@0+ (1.0,0.0) [0.0|10.0] "Unitless" ZCUD
 SG_ DwnLoadDynLtgPrmForFrntRIGrp15LowBrightness : 91|4@0+ (1.0,0.0) [0.0|10.0] "Unitless" ZCUD
 SG_ DwnLoadDynLtgPrmForFrntRIGrp15Mode1 : 103|6@0+ (1,0) [0|63] "" ZCUD
 SG_ DwnLoadDynLtgPrmForFrntRIGrp15OffsetTime : 111|6@0+ (1.0,0.0) [0.0|63.0] "Unitless" ZCUD
 SG_ DwnLoadDynLtgPrmForFrntRIGrp15Timestamp : 119|3@0+ (1.0,0.0) [0.0|7.0] "Unitless" ZCUD
 SG_ DwnLoadDynLtgPrmForFrntRIGrp16_UB : 156|1@0+ (1,0) [0|1] "" ZCUD
 SG_ DwnLoadDynLtgPrmForFrntRIGrp16ContinueTime : 127|8@0+ (1.0,0.0) [0.0|255.0] "Unitless" ZCUD
 SG_ DwnLoadDynLtgPrmForFrntRIGrp16HighBrightness : 135|4@0+ (1.0,0.0) [0.0|10.0] "Unitless" ZCUD
 SG_ DwnLoadDynLtgPrmForFrntRIGrp16LowBrightness : 131|4@0+ (1.0,0.0) [0.0|10.0] "Unitless" ZCUD
 SG_ DwnLoadDynLtgPrmForFrntRIGrp16Mode1 : 143|6@0+ (1,0) [0|63] "" ZCUD
 SG_ DwnLoadDynLtgPrmForFrntRIGrp16OffsetTime : 151|6@0+ (1.0,0.0) [0.0|63.0] "Unitless" ZCUD
 SG_ DwnLoadDynLtgPrmForFrntRIGrp16Timestamp : 159|3@0+ (1.0,0.0) [0.0|7.0] "Unitless" ZCUD
 SG_ DwnLoadDynLtgPrmForFrntRIGrp17_UB : 196|1@0+ (1,0) [0|1] "" ZCUD
 SG_ DwnLoadDynLtgPrmForFrntRIGrp17ContinueTime : 167|8@0+ (1.0,0.0) [0.0|255.0] "Unitless" ZCUD
 SG_ DwnLoadDynLtgPrmForFrntRIGrp17HighBrightness : 175|4@0+ (1.0,0.0) [0.0|10.0] "Unitless" ZCUD
 SG_ DwnLoadDynLtgPrmForFrntRIGrp17LowBrightness : 171|4@0+ (1.0,0.0) [0.0|10.0] "Unitless" ZCUD
 SG_ DwnLoadDynLtgPrmForFrntRIGrp17Mode1 : 183|6@0+ (1,0) [0|63] "" ZCUD
 SG_ DwnLoadDynLtgPrmForFrntRIGrp17OffsetTime : 191|6@0+ (1.0,0.0) [0.0|63.0] "Unitless" ZCUD
 SG_ DwnLoadDynLtgPrmForFrntRIGrp17Timestamp : 199|3@0+ (1.0,0.0) [0.0|7.0] "Unitless" ZCUD
 SG_ DwnLoadDynLtgPrmForFrntRIGrp18_UB : 236|1@0+ (1,0) [0|1] "" ZCUD
 SG_ DwnLoadDynLtgPrmForFrntRIGrp18ContinueTime : 207|8@0+ (1.0,0.0) [0.0|255.0] "Unitless" ZCUD
 SG_ DwnLoadDynLtgPrmForFrntRIGrp18HighBrightness : 215|4@0+ (1.0,0.0) [0.0|10.0] "Unitless" ZCUD
 SG_ DwnLoadDynLtgPrmForFrntRIGrp18LowBrightness : 211|4@0+ (1.0,0.0) [0.0|10.0] "Unitless" ZCUD
 SG_ DwnLoadDynLtgPrmForFrntRIGrp18Mode1 : 223|6@0+ (1,0) [0|63] "" ZCUD
 SG_ DwnLoadDynLtgPrmForFrntRIGrp18OffsetTime : 231|6@0+ (1.0,0.0) [0.0|63.0] "Unitless" ZCUD
 SG_ DwnLoadDynLtgPrmForFrntRIGrp18Timestamp : 239|3@0+ (1.0,0.0) [0.0|7.0] "Unitless" ZCUD
 SG_ DwnLoadDynLtgPrmForFrntRIGrp19_UB : 276|1@0+ (1,0) [0|1] "" ZCUD
 SG_ DwnLoadDynLtgPrmForFrntRIGrp19ContinueTime : 247|8@0+ (1.0,0.0) [0.0|255.0] "Unitless" ZCUD
 SG_ DwnLoadDynLtgPrmForFrntRIGrp19HighBrightness : 255|4@0+ (1.0,0.0) [0.0|10.0] "Unitless" ZCUD
 SG_ DwnLoadDynLtgPrmForFrntRIGrp19LowBrightness : 251|4@0+ (1.0,0.0) [0.0|10.0] "Unitless" ZCUD
 SG_ DwnLoadDynLtgPrmForFrntRIGrp19Mode1 : 263|6@0+ (1,0) [0|63] "" ZCUD
 SG_ DwnLoadDynLtgPrmForFrntRIGrp19OffsetTime : 271|6@0+ (1.0,0.0) [0.0|63.0] "Unitless" ZCUD
 SG_ DwnLoadDynLtgPrmForFrntRIGrp19Timestamp : 279|3@0+ (1.0,0.0) [0.0|7.0] "Unitless" ZCUD
 SG_ DwnLoadDynLtgPrmForFrntRIGrp20_UB : 316|1@0+ (1,0) [0|1] "" ZCUD
 SG_ DwnLoadDynLtgPrmForFrntRIGrp20ContinueTime : 287|8@0+ (1.0,0.0) [0.0|255.0] "Unitless" ZCUD
 SG_ DwnLoadDynLtgPrmForFrntRIGrp20HighBrightness : 295|4@0+ (1.0,0.0) [0.0|10.0] "Unitless" ZCUD
 SG_ DwnLoadDynLtgPrmForFrntRIGrp20LowBrightness : 291|4@0+ (1.0,0.0) [0.0|10.0] "Unitless" ZCUD
 SG_ DwnLoadDynLtgPrmForFrntRIGrp20Mode1 : 303|6@0+ (1,0) [0|63] "" ZCUD
 SG_ DwnLoadDynLtgPrmForFrntRIGrp20OffsetTime : 311|6@0+ (1.0,0.0) [0.0|63.0] "Unitless" ZCUD
 SG_ DwnLoadDynLtgPrmForFrntRIGrp20Timestamp : 319|3@0+ (1.0,0.0) [0.0|7.0] "Unitless" ZCUD
 SG_ DwnLoadDynLtgPrmForFrntRIGrp21_UB : 356|1@0+ (1,0) [0|1] "" ZCUD
 SG_ DwnLoadDynLtgPrmForFrntRIGrp21ContinueTime : 327|8@0+ (1.0,0.0) [0.0|255.0] "Unitless" ZCUD
 SG_ DwnLoadDynLtgPrmForFrntRIGrp21HighBrightness : 335|4@0+ (1.0,0.0) [0.0|10.0] "Unitless" ZCUD
 SG_ DwnLoadDynLtgPrmForFrntRIGrp21LowBrightness : 331|4@0+ (1.0,0.0) [0.0|10.0] "Unitless" ZCUD
 SG_ DwnLoadDynLtgPrmForFrntRIGrp21Mode1 : 343|6@0+ (1,0) [0|63] "" ZCUD
 SG_ DwnLoadDynLtgPrmForFrntRIGrp21OffsetTime : 351|6@0+ (1.0,0.0) [0.0|63.0] "Unitless" ZCUD
 SG_ DwnLoadDynLtgPrmForFrntRIGrp21Timestamp : 359|3@0+ (1.0,0.0) [0.0|7.0] "Unitless" ZCUD
 SG_ DwnLoadDynLtgPrmForFrntRIGrp22_UB : 396|1@0+ (1,0) [0|1] "" ZCUD
 SG_ DwnLoadDynLtgPrmForFrntRIGrp22ContinueTime : 367|8@0+ (1.0,0.0) [0.0|255.0] "Unitless" ZCUD
 SG_ DwnLoadDynLtgPrmForFrntRIGrp22HighBrightness : 375|4@0+ (1.0,0.0) [0.0|10.0] "Unitless" ZCUD
 SG_ DwnLoadDynLtgPrmForFrntRIGrp22LowBrightness : 371|4@0+ (1.0,0.0) [0.0|10.0] "Unitless" ZCUD
 SG_ DwnLoadDynLtgPrmForFrntRIGrp22Mode1 : 383|6@0+ (1,0) [0|63] "" ZCUD
 SG_ DwnLoadDynLtgPrmForFrntRIGrp22OffsetTime : 391|6@0+ (1.0,0.0) [0.0|63.0] "Unitless" ZCUD
 SG_ DwnLoadDynLtgPrmForFrntRIGrp22Timestamp : 399|3@0+ (1.0,0.0) [0.0|7.0] "Unitless" ZCUD
 SG_ DwnLoadDynLtgPrmForFrntRIGrp23_UB : 436|1@0+ (1,0) [0|1] "" ZCUD
 SG_ DwnLoadDynLtgPrmForFrntRIGrp23ContinueTime : 407|8@0+ (1.0,0.0) [0.0|255.0] "Unitless" ZCUD
 SG_ DwnLoadDynLtgPrmForFrntRIGrp23HighBrightness : 415|4@0+ (1.0,0.0) [0.0|10.0] "Unitless" ZCUD
 SG_ DwnLoadDynLtgPrmForFrntRIGrp23LowBrightness : 411|4@0+ (1.0,0.0) [0.0|10.0] "Unitless" ZCUD
 SG_ DwnLoadDynLtgPrmForFrntRIGrp23Mode1 : 423|6@0+ (1,0) [0|63] "" ZCUD
 SG_ DwnLoadDynLtgPrmForFrntRIGrp23OffsetTime : 431|6@0+ (1.0,0.0) [0.0|63.0] "Unitless" ZCUD
 SG_ DwnLoadDynLtgPrmForFrntRIGrp23Timestamp : 439|3@0+ (1.0,0.0) [0.0|7.0] "Unitless" ZCUD
 SG_ DwnLoadDynLtgPrmForFrntRIGrp24_UB : 476|1@0+ (1,0) [0|1] "" ZCUD
 SG_ DwnLoadDynLtgPrmForFrntRIGrp24ContinueTime : 447|8@0+ (1.0,0.0) [0.0|255.0] "Unitless" ZCUD
 SG_ DwnLoadDynLtgPrmForFrntRIGrp24HighBrightness : 455|4@0+ (1.0,0.0) [0.0|10.0] "Unitless" ZCUD
 SG_ DwnLoadDynLtgPrmForFrntRIGrp24LowBrightness : 451|4@0+ (1.0,0.0) [0.0|10.0] "Unitless" ZCUD
 SG_ DwnLoadDynLtgPrmForFrntRIGrp24Mode1 : 463|6@0+ (1,0) [0|63] "" ZCUD
 SG_ DwnLoadDynLtgPrmForFrntRIGrp24OffsetTime : 471|6@0+ (1.0,0.0) [0.0|63.0] "Unitless" ZCUD
 SG_ DwnLoadDynLtgPrmForFrntRIGrp24Timestamp : 479|3@0+ (1.0,0.0) [0.0|7.0] "Unitless" ZCUD
 SG_ TelmBookClimaReq_UB : 33|1@0+ (1,0) [0|1] "" ZCUP
 SG_ TelmBookClimaReqHmiCmptmtTSpSpcl : 475|2@0+ (1,0) [0|3] "" ZCUP
 SG_ TelmBookClimaReqOnOffNoReq : 473|2@0+ (1,0) [0|3] "" ZCUP
 SG_ TelmBookClimaReqTempRange : 487|5@0+ (0.5,15.5) [15.5|28.5] "degC" ZCUP
 SG_ TelmEngDelayTi : 503|6@0+ (1.0,0.0) [0.0|59.0] "Mins" ZCUD
 SG_ TelmEngDelayTi_UB : 34|1@0+ (1,0) [0|1] "" ZCUD
 SG_ WinOpenClsGlbReqFromTelm_UB : 35|1@0+ (1,0) [0|1] "" ZCUD,ZCUP
 SG_ WinOpenClsGlbReqFromTelmWindowOpenValue : 511|8@0+ (1.0,0.0) [0.0|100.0] "%" ZCUD,ZCUP
 SG_ WinOpenClsGlbReqFromTelmWinOpenClsGlbSts : 497|2@0+ (1,0) [0|3] "" ZCUD,ZCUP

BO_ 560 DhuZCUCANFD2Fr08 : 64 IHU
 SG_ AudWarnActv : 7|2@0+ (1,0) [0|3] "" ZCUD
 SG_ AudWarnActv_UB : 5|1@0+ (1,0) [0|1] "" ZCUD
 SG_ BevPwrCtrl : 319|1@0+ (1,0) [0|1] "" ZCUD
 SG_ BevPwrCtrl_UB : 318|1@0+ (1,0) [0|1] "" ZCUD
 SG_ CopilotSeatOccupySts : 42|2@0+ (1,0) [0|3] "" ZCUP
 SG_ CopilotSeatOccupySts_UB : 40|1@0+ (1,0) [0|1] "" ZCUP
 SG_ DrvrHdPosnDetn_UB : 52|1@0+ (1,0) [0|1] "" ZCUP
 SG_ DrvrHdPosnDetnX : 4|13@0+ (1.0,0.0) [0.0|8191.0] "Unitless" ZCUP
 SG_ DrvrHdPosnDetnY : 23|13@0+ (1.0,0.0) [0.0|8191.0] "Unitless" ZCUP
 SG_ DrvrHdPosnDetnZ : 39|13@0+ (1.0,0.0) [0.0|8191.0] "Unitless" ZCUP
 SG_ DrvSeatOccupySts : 55|2@0+ (1,0) [0|3] "" ZCUP
 SG_ DrvSeatOccupySts_UB : 53|1@0+ (1,0) [0|1] "" ZCUP
 SG_ HMIAirCdnrAutDrySet : 305|1@0+ (1,0) [0|1] "" ZCUP
 SG_ HMIAirCdnrAutDrySet_UB : 304|1@0+ (1,0) [0|1] "" ZCUP
 SG_ HmiPM25PopUpSet : 187|1@0+ (1,0) [0|1] "" ZCUP
 SG_ HmiPM25PopUpSet_UB : 186|1@0+ (1,0) [0|1] "" ZCUP
 SG_ PassSideHdPosnDetn_UB : 289|1@0+ (1,0) [0|1] "" ZCUP
 SG_ PassSideHdPosnDetnX : 252|13@0+ (1.0,0.0) [0.0|8191.0] "Unitless" ZCUP
 SG_ PassSideHdPosnDetnY : 271|13@0+ (1.0,0.0) [0.0|8191.0] "Unitless" ZCUP
 SG_ PassSideHdPosnDetnZ : 287|13@0+ (1.0,0.0) [0.0|8191.0] "Unitless" ZCUP
 SG_ SteerSetg_UB : 315|1@0+ (1,0) [0|1] "" ZCUD
 SG_ SteerSetgPen : 323|4@0+ (1,0) [0|15] "" ZCUD
 SG_ SteerSetgSteerAsscLvl : 326|3@0+ (1,0) [0|7] "" ZCUD
 SG_ SteerSetgSteerMod : 314|3@0+ (1,0) [0|7] "" ZCUD
 SG_ WiprReAutReq : 331|1@0+ (1,0) [0|1] "" ZCUD
 SG_ WiprReAutReq_UB : 306|1@0+ (1,0) [0|1] "" ZCUD

BO_ 368 DhuZCUCANFD2Fr10 : 64 IHU
 SG_ AutEgyRgnLvlSet : 190|3@0+ (1,0) [0|7] "" ZCUD
 SG_ AutEgyRgnLvlSet_UB : 187|1@0+ (1,0) [0|1] "" ZCUD
 SG_ FaceRecognitionIndcrFromDHU : 21|1@0+ (1,0) [0|1] "" ZCUD
 SG_ FaceRecognitionIndcrFromDHU_UB : 20|1@0+ (1,0) [0|1] "" ZCUD
 SG_ GestureDetn : 55|5@0+ (1,0) [0|31] "" ZCUD
 SG_ GestureDetn_UB : 42|1@0+ (1,0) [0|1] "" ZCUD
 SG_ LnchModSwt : 19|2@0+ (1,0) [0|3] "" ZCUD
 SG_ LnchModSwt_UB : 17|1@0+ (1,0) [0|1] "" ZCUD
 SG_ LvlgSwtSetReq_UB : 8|1@0+ (1,0) [0|1] "" ZCUD
 SG_ LvlgSwtSetReqChks : 7|8@0+ (1.0,0.0) [0.0|255.0] "Unitless" ZCUD
 SG_ LvlgSwtSetReqCntr : 15|4@0+ (1.0,0.0) [0.0|15.0] "Unitless" ZCUD
 SG_ LvlgSwtSetReqLvlgSwtSetReq : 11|3@0+ (1,0) [0|7] "" ZCUD
 SG_ PrpsnMaxEvMod : 23|1@0+ (1,0) [0|1] "" ZCUD
 SG_ PrpsnMaxEvMod_UB : 22|1@0+ (1,0) [0|1] "" ZCUD
 SG_ RainSnsrSnvtyHMIReq : 30|3@0+ (1,0) [0|7] "" ZCUD
 SG_ RainSnsrSnvtyHMIReq_UB : 27|1@0+ (1,0) [0|1] "" ZCUD
 SG_ SecLeSeatTarPosnCmdReq_UB : 41|1@0+ (1,0) [0|1] "" ZCUD
 SG_ SecLeSeatTarPosnCmdReqSeatBackrTargPosAg : 63|8@0+ (1.0,0.0) [0.0|180.0] "Deg" ZCUD
 SG_ SecLeSeatTarPosnCmdReqSeatFrntExtenTargPosPerc : 71|10@0+ (0.1,0.0) [0.0|100.0] "%" ZCUD
 SG_ SecLeSeatTarPosnCmdReqSeatFrntHeiTargPosPerc : 77|10@0+ (0.1,0.0) [0.0|100.0] "%" ZCUD
 SG_ SecLeSeatTarPosnCmdReqSeatLenTargPosPerc : 81|10@0+ (0.1,0.0) [0.0|100.0] "%" ZCUD
 SG_ SecLeSeatTarPosnCmdReqTarPosnCmd1 : 83|2@0+ (1,0) [0|3] "" ZCUD
 SG_ SecRiSeatTarPosnCmdReq_UB : 40|1@0+ (1,0) [0|1] "" ZCUD
 SG_ SecRiSeatTarPosnCmdReqSeatBackrTargPosAg : 103|8@0+ (1.0,0.0) [0.0|180.0] "Deg" ZCUD
 SG_ SecRiSeatTarPosnCmdReqSeatFrntExtenTargPosPerc : 111|10@0+ (0.1,0.0) [0.0|100.0] "%" ZCUD
 SG_ SecRiSeatTarPosnCmdReqSeatFrntHeiTargPosPerc : 117|10@0+ (0.1,0.0) [0.0|100.0] "%" ZCUD
 SG_ SecRiSeatTarPosnCmdReqSeatLenTargPosPerc : 121|10@0+ (0.1,0.0) [0.0|100.0] "%" ZCUD
 SG_ SecRiSeatTarPosnCmdReqTarPosnCmd1 : 123|2@0+ (1,0) [0|3] "" ZCUD

BO_ 259 DhuZCUCANFD2Fr11 : 64 IHU
 SG_ ConfCurrSpd : 3|2@0+ (1,0) [0|3] "" ZCUD
 SG_ ConfCurrSpd_UB : 8|1@0+ (1,0) [0|1] "" ZCUD
 SG_ ConfPath : 1|2@0+ (1,0) [0|3] "" ZCUD
 SG_ ConfPath_UB : 9|1@0+ (1,0) [0|1] "" ZCUD
 SG_ DchrgnInSwtCtrl : 282|2@0+ (1,0) [0|3] "" ZCUD
 SG_ DchrgnInSwtCtrl_UB : 280|1@0+ (1,0) [0|1] "" ZCUD
 SG_ DrvrCrsCtrlFctDeactvnReq : 15|1@0+ (1,0) [0|1] "" ZCUD
 SG_ DrvrCrsCtrlFctDeactvnReq_UB : 27|1@0+ (1,0) [0|1] "" ZCUD
 SG_ DrvrCrsCtrlFctReActvReq : 14|1@0+ (1,0) [0|1] "" ZCUD
 SG_ DrvrCrsCtrlFctReActvReq_UB : 26|1@0+ (1,0) [0|1] "" ZCUD
 SG_ DrvrCrsCtrlFctSeld : 199|3@0+ (1,0) [0|7] "" ZCUD
 SG_ DrvrCrsCtrlFctSeld_UB : 196|1@0+ (1,0) [0|1] "" ZCUD
 SG_ EPedlModCtrlSt : 13|1@0+ (1,0) [0|1] "" ZCUD
 SG_ EPedlModCtrlSt_UB : 25|1@0+ (1,0) [0|1] "" ZCUD
 SG_ ESCLvlSwt : 12|3@0+ (1,0) [0|7] "" ZCUD
 SG_ ESCLvlSwt_UB : 24|1@0+ (1,0) [0|1] "" ZCUD
 SG_ FuLvlRawActvSide_UB : 43|1@0+ (1,0) [0|1] "" ZCUD
 SG_ FuLvlRawActvSideFuLvlValFromFuTbl : 23|10@0+ (0.2,0.0) [0.0|204.60000000000002] "Litre" ZCUD
 SG_ FuLvlRawActvSideGenQF : 29|2@0+ (1,0) [0|3] "" ZCUD
 SG_ FuLvlRawPasSide_UB : 42|1@0+ (1,0) [0|1] "" ZCUD
 SG_ FuLvlRawPasSideFuLvlValFromFuTbl : 39|10@0+ (0.2,0.0) [0.0|204.60000000000002] "Litre" ZCUD
 SG_ FuLvlRawPasSideGenQF : 45|2@0+ (1,0) [0|3] "" ZCUD
 SG_ HmiMaxEvMod : 175|1@0+ (1,0) [0|1] "" ZCUD
 SG_ HmiMaxEvMod_UB : 174|1@0+ (1,0) [0|1] "" ZCUD
 SG_ HMISteplessBarPosnSetting : 55|7@0+ (1.0,0.0) [0.0|100.0] "%" ZCUD
 SG_ HMISteplessBarPosnSetting_UB : 48|1@0+ (1,0) [0|1] "" ZCUD
 SG_ HMIThermoTankDlyCls : 269|1@0+ (1,0) [0|1] "" ZCUD
 SG_ HMIThermoTankDlyCls_UB : 268|1@0+ (1,0) [0|1] "" ZCUD
 SG_ HMIThermoTankDlyClsTmr : 255|5@0+ (1.0,0.0) [0.0|31.0] "hours" ZCUD
 SG_ HMIThermoTankDlyClsTmr_UB : 260|1@0+ (1,0) [0|1] "" ZCUD
 SG_ HornWarnReq : 275|1@0+ (1,0) [0|1] "" ZCUD
 SG_ HornWarnReq_UB : 274|1@0+ (1,0) [0|1] "" ZCUD
 SG_ IAMSMod : 173|1@0+ (1,0) [0|1] "" ZCUD
 SG_ IAMSMod_UB : 195|1@0+ (1,0) [0|1] "" ZCUD
 SG_ KickTailgateSig : 267|1@0+ (1,0) [0|1] "" ZCUD
 SG_ KickTailgateSig_UB : 266|1@0+ (1,0) [0|1] "" ZCUD
 SG_ LiFlashWarnReq : 273|1@0+ (1,0) [0|1] "" ZCUD
 SG_ LiFlashWarnReq_UB : 272|1@0+ (1,0) [0|1] "" ZCUD
 SG_ LvngCratuDetdSts : 287|2@0+ (1,0) [0|3] "" ZCUD
 SG_ LvngCratuDetdSts_UB : 285|1@0+ (1,0) [0|1] "" ZCUD
 SG_ MirrTarPosnCmdReq_UB : 194|1@0+ (1,0) [0|1] "" ZCUD,ZCUP
 SG_ MirrTarPosnCmdReqDrvrMirrAdjLeRi : 207|8@0+ (1.0,0.0) [0.0|180.0] "Deg" ZCUD,ZCUP
 SG_ MirrTarPosnCmdReqDrvrMirrAdjUpDwn : 215|8@0+ (1.0,0.0) [0.0|180.0] "Deg" ZCUD,ZCUP
 SG_ MirrTarPosnCmdReqPassMirrAdjLeRi : 223|8@0+ (1.0,0.0) [0.0|180.0] "Deg" ZCUD,ZCUP
 SG_ MirrTarPosnCmdReqPassMirrAdjUpDwn : 231|8@0+ (1.0,0.0) [0.0|180.0] "Deg" ZCUD,ZCUP
 SG_ MirrTarPosnCmdReqTarPosnCmd1 : 193|2@0+ (1,0) [0|3] "" ZCUD,ZCUP
 SG_ PasEntryEnaReq1 : 41|1@0+ (1,0) [0|1] "" ZCUD
 SG_ PasEntryEnaReq1_UB : 40|1@0+ (1,0) [0|1] "" ZCUD
 SG_ RemHvStrtActvReq : 60|2@0+ (1,0) [0|3] "" ZCUD
 SG_ RemHvStrtActvReq_UB : 58|1@0+ (1,0) [0|1] "" ZCUD
 SG_ RoadCondDis : 71|16@0+ (1.0,0.0) [0.0|65535.0] "m" ZCUD
 SG_ RoadCondDis_UB : 137|1@0+ (1,0) [0|1] "" ZCUD
 SG_ RoadCondLvl : 122|3@0+ (1,0) [0|7] "" ZCUD
 SG_ RoadCondLvl_UB : 138|1@0+ (1,0) [0|1] "" ZCUD
 SG_ RoadCondNum : 127|5@0+ (1.0,0.0) [0.0|31.0] "Unitless" ZCUD
 SG_ RoadCondNum_UB : 139|1@0+ (1,0) [0|1] "" ZCUD
 SG_ RoadCondTime : 87|16@0+ (1.0,0.0) [0.0|65535.0] "s" ZCUD
 SG_ RoadCondTime_UB : 140|1@0+ (1,0) [0|1] "" ZCUD
 SG_ RoadSlope : 135|11@0- (0.001,0.0) [0.0|1.0230000000000001] "Unitless" ZCUD
 SG_ RoadSlope_UB : 168|1@0+ (1,0) [0|1] "" ZCUD
 SG_ RoadSlopeDis : 103|16@0+ (1.0,0.0) [0.0|65535.0] "m" ZCUD
 SG_ RoadSlopeDis_UB : 169|1@0+ (1,0) [0|1] "" ZCUD
 SG_ RoadSlopeNum : 119|8@0+ (1.0,0.0) [0.0|255.0] "Unitless" ZCUD
 SG_ RoadSlopeNum_UB : 170|1@0+ (1,0) [0|1] "" ZCUD
 SG_ TelmClimaTmr : 183|16@0+ (1.0,0.0) [0.0|65535.0] "s" ZCUP
 SG_ TelmClimaTmr_UB : 172|1@0+ (1,0) [0|1] "" ZCUP
 SG_ TotDstTrvld : 136|25@0+ (0.1,0.0) [0.0|2000000.0] "km" ZCUD
 SG_ TotDstTrvld_UB : 171|1@0+ (1,0) [0|1] "" ZCUD
 SG_ WinOpenLDACReq : 284|1@0+ (1,0) [0|1] "" ZCUD,ZCUP
 SG_ WinOpenLDACReq_UB : 283|1@0+ (1,0) [0|1] "" ZCUD,ZCUP

BO_ 624 DhuZCUCANFD2Fr12 : 64 IHU
 SG_ MmedHdPwrMod : 3|2@0+ (1,0) [0|3] "" ZCUD
 SG_ MmedHdPwrMod_UB : 1|1@0+ (1,0) [0|1] "" ZCUD
 SG_ MobDevBtnPanicReq : 15|2@0+ (1,0) [0|3] "" ZCUD
 SG_ MobDevBtnPanicReq_UB : 0|1@0+ (1,0) [0|1] "" ZCUD

BO_ 80 DhuZCUCANFD2Fr13 : 64 IHU
 SG_ CnclBookTrvlReq : 490|1@0+ (1,0) [0|1] "" ZCUD
 SG_ CnclBookTrvlReq_UB : 491|1@0+ (1,0) [0|1] "" ZCUD
 SG_ DKDataFromTelm_UB : 481|1@0+ (1,0) [0|1] "" ZCUD
 SG_ DKDataFromTelmAcknowledgment : 327|8@0+ (1.0,0.0) [0.0|255.0] "Unitless" ZCUD
 SG_ DKDataFromTelmDKDataByte1 : 335|8@0+ (1.0,0.0) [0.0|255.0] "Unitless" ZCUD
 SG_ DKDataFromTelmDKDataByte2 : 343|8@0+ (1.0,0.0) [0.0|255.0] "Unitless" ZCUD
 SG_ DKDataFromTelmDKDataByte3 : 351|8@0+ (1.0,0.0) [0.0|255.0] "Unitless" ZCUD
 SG_ DKDataFromTelmDKDataByte4 : 359|8@0+ (1.0,0.0) [0.0|255.0] "Unitless" ZCUD
 SG_ DKDataFromTelmDKDataByte5 : 367|8@0+ (1.0,0.0) [0.0|255.0] "Unitless" ZCUD
 SG_ DKDataFromTelmDKDataByte6 : 375|8@0+ (1.0,0.0) [0.0|255.0] "Unitless" ZCUD
 SG_ DKDataFromTelmHeader : 383|8@0+ (1.0,0.0) [0.0|255.0] "Unitless" ZCUD
 SG_ ErsCmdRec_UB : 488|1@0+ (1,0) [0|1] "" ZCUD
 SG_ ErsCmdRecErsCmd : 511|2@0+ (1,0) [0|3] "" ZCUD
 SG_ ErsCmdRecErsRunTime : 509|6@0+ (1.0,0.0) [0.0|59.0] "Mins" ZCUD

BO_ 1168 DhuZCUCANFD2Fr14 : 64 IHU
 SG_ CarSharingMde : 79|1@0+ (1,0) [0|1] "" ZCUD
 SG_ CarSharingMde_UB : 75|1@0+ (1,0) [0|1] "" ZCUD
 SG_ LongTiRunngMod_UB : 103|1@0+ (1,0) [0|1] "" ZCUD
 SG_ LongTiRunngModCampMod : 87|1@0+ (1,0) [0|1] "" ZCUD
 SG_ LongTiRunngModGameMod : 86|1@0+ (1,0) [0|1] "" ZCUD
 SG_ LongTiRunngModMonrbyOMS : 85|1@0+ (1,0) [0|1] "" ZCUD
 SG_ LongTiRunngModPanelTouched : 84|1@0+ (1,0) [0|1] "" ZCUD
 SG_ LongTiRunngModParkComfortMod : 83|1@0+ (1,0) [0|1] "" ZCUD
 SG_ LongTiRunngModPetMod : 82|1@0+ (1,0) [0|1] "" ZCUD
 SG_ LongTiRunngModReserved1 : 81|1@0+ (1,0) [0|1] "" ZCUD
 SG_ LongTiRunngModReserved2 : 80|1@0+ (1,0) [0|1] "" ZCUD
 SG_ LongTiRunngModReserved3 : 95|1@0+ (1,0) [0|1] "" ZCUD
 SG_ LongTiRunngModReserved4 : 94|1@0+ (1,0) [0|1] "" ZCUD
 SG_ LongTiRunngModReserved5 : 93|1@0+ (1,0) [0|1] "" ZCUD
 SG_ LongTiRunngModReserved6 : 92|1@0+ (1,0) [0|1] "" ZCUD
 SG_ LongTiRunngModReserved7 : 91|1@0+ (1,0) [0|1] "" ZCUD
 SG_ LongTiRunngModReserved8 : 90|1@0+ (1,0) [0|1] "" ZCUD
 SG_ LongTiRunngModRestMod : 89|1@0+ (1,0) [0|1] "" ZCUD
 SG_ LongTiRunngModTheaterMod : 88|1@0+ (1,0) [0|1] "" ZCUD
 SG_ PosnBrief_UB : 6|1@0+ (1,0) [0|1] "" ZCUD,ZCUP
 SG_ PosnBriefPosnLat : 5|30@0- (0.000000277778,0.0) [-90.000072|90.000072] "Deg" ZCUD,ZCUP
 SG_ PosnBriefPosnLgt : 39|31@0- (0.000000277778,0.0) [-180.000144|180.000144] "Deg" ZCUD,ZCUP
 SG_ UnlckRemReq : 67|1@0+ (1,0) [0|1] "" ZCUD
 SG_ UnlckRemReq_UB : 56|1@0+ (1,0) [0|1] "" ZCUD

BO_ 435 DhuZCUCANFD2Fr15 : 64 IHU
 SG_ HznPosnLR_UB : 45|1@0+ (1,0) [0|1] "" ZCUD
 SG_ HznPosnLRCurrentLane : 214|3@0+ (1.0,0.0) [0.0|7.0] "Unitless" ZCUD
 SG_ HznPosnLRCyclicCounter : 211|2@0+ (1.0,0.0) [0.0|3.0] "Unitless" ZCUD
 SG_ HznPosnLRMessageType : 223|3@0+ (1,0) [0|7] "" ZCUD
 SG_ HznPosnLROffset : 220|13@0+ (1.0,0.0) [0.0|8191.0] "m" ZCUD
 SG_ HznPosnLRPathIndex : 247|6@0+ (1.0,0.0) [0.0|63.0] "Unitless" ZCUD
 SG_ HznPosnLRPositionAge : 184|9@0+ (1.0,0.0) [0.0|511.0] "Milliseconds" ZCUD
 SG_ HznPosnLRPositionConfidence : 255|3@0+ (1.0,0.0) [0.0|7.0] "Unitless" ZCUD
 SG_ HznPosnLRPositionIndex : 209|2@0+ (1.0,0.0) [0.0|3.0] "Unitless" ZCUD
 SG_ HznPosnLRPositionProbability : 189|5@0+ (1.0,0.0) [0.0|31.0] "%" ZCUD
 SG_ HznPosnLRRelativeHeading : 239|8@0+ (1.0,0.0) [0.0|255.0] "Unitless" ZCUD
 SG_ HznPosnLRSpeed : 207|9@0+ (1.0,0.0) [0.0|511.0] "m/s" ZCUD
 SG_ HznProfLongLR_UB : 68|1@0+ (1,0) [0|1] "" ZCUD
 SG_ HznProfLongLRControlPoint : 319|1@0+ (1,0) [0|1] "" ZCUD
 SG_ HznProfLongLRCyclicCounter : 257|2@0+ (1.0,0.0) [0.0|3.0] "Unitless" ZCUD
 SG_ HznProfLongLRMessageType : 271|3@0+ (1,0) [0|7] "" ZCUD
 SG_ HznProfLongLROffset : 268|13@0+ (1.0,0.0) [0.0|8191.0] "m" ZCUD
 SG_ HznProfLongLRPathIndex : 263|6@0+ (1.0,0.0) [0.0|63.0] "Unitless" ZCUD
 SG_ HznProfLongLRProfileType : 252|5@0+ (1.0,0.0) [0.0|31.0] "Unitless" ZCUD
 SG_ HznProfLongLRRetransmission : 318|1@0+ (1,0) [0|1] "" ZCUD
 SG_ HznProfLongLRUpdate : 317|1@0+ (1,0) [0|1] "" ZCUD
 SG_ HznProfLongLRValue : 287|32@0+ (1.0,0.0) [0.0|4294967295.0] "Unitless" ZCUD
 SG_ LocalBookChrgnTarVal : 87|10@0+ (0.1,0.0) [0.0|100.0] "%" ZCUD
 SG_ LocalBookChrgnTarVal_UB : 69|1@0+ (1,0) [0|1] "" ZCUD
 SG_ MaxAcInpCurrentSet : 327|8@0+ (1.0,0.0) [0.0|255.0] "Unitless" ZCUD
 SG_ MaxAcInpCurrentSet_UB : 90|1@0+ (1,0) [0|1] "" ZCUD
 SG_ ShowTypOfDTESet : 165|2@0+ (1,0) [0|3] "" ZCUD
 SG_ ShowTypOfDTESet_UB : 141|1@0+ (1,0) [0|1] "" ZCUD

BO_ 464 DhuZCUCANFD2Fr16 : 64 IHU
 SG_ BackRestSideSpprtAdjmtRowFirstDrvr : 7|2@0+ (1,0) [0|3] "" ZCUD
 SG_ BackRestSideSpprtAdjmtRowFirstDrvr_UB : 3|1@0+ (1,0) [0|1] "" ZCUD
 SG_ BackRestSideSpprtAdjmtRowFirstPass : 5|2@0+ (1,0) [0|3] "" ZCUP
 SG_ BackRestSideSpprtAdjmtRowFirstPass_UB : 35|1@0+ (1,0) [0|1] "" ZCUP
 SG_ CushSideSpprtAdjmtRowFirstDrvr : 39|2@0+ (1,0) [0|3] "" ZCUD
 SG_ CushSideSpprtAdjmtRowFirstDrvr_UB : 57|1@0+ (1,0) [0|1] "" ZCUD
 SG_ CushSideSpprtAdjmtRowFirstPass : 37|2@0+ (1,0) [0|3] "" ZCUP
 SG_ CushSideSpprtAdjmtRowFirstPass_UB : 56|1@0+ (1,0) [0|1] "" ZCUP
 SG_ DiagcComActv : 14|1@0+ (1,0) [0|1] "" ZCUD
 SG_ DiagcComActv_UB : 1|1@0+ (1,0) [0|1] "" ZCUD
 SG_ DiagcExtCom : 33|1@0+ (1,0) [0|1] "" ZCUD
 SG_ DiagcExtCom_UB : 32|1@0+ (1,0) [0|1] "" ZCUD
 SG_ DrvrSeatDispMassgFct_UB : 2|1@0+ (1,0) [0|1] "" ZCUD
 SG_ DrvrSeatDispMassgFctMassgInten : 71|2@0+ (1,0) [0|3] "" ZCUD
 SG_ DrvrSeatDispMassgFctMassgProg : 69|3@0+ (1,0) [0|7] "" ZCUD
 SG_ DrvrSeatDispMassgFctOnOffl2 : 66|2@0+ (1,0) [0|3] "" ZCUD
 SG_ DrvrSeatDispSpplFct : 55|3@0+ (1,0) [0|7] "" ZCUD
 SG_ DrvrSeatDispSpplFct_UB : 52|1@0+ (1,0) [0|1] "" ZCUD
 SG_ HMIIonizerAirCdnr : 15|1@0+ (1,0) [0|1] "" ZCUP
 SG_ HMIIonizerAirCdnr_UB : 0|1@0+ (1,0) [0|1] "" ZCUP
 SG_ LumHeiAdjmtRowFirstDrvr : 47|2@0+ (1,0) [0|3] "" ZCUD
 SG_ LumHeiAdjmtRowFirstDrvr_UB : 17|1@0+ (1,0) [0|1] "" ZCUD
 SG_ LumHeiAdjmtRowFirstPass : 45|2@0+ (1,0) [0|3] "" ZCUP
 SG_ LumHeiAdjmtRowFirstPass_UB : 16|1@0+ (1,0) [0|1] "" ZCUP
 SG_ LumLenAdjmtRowFirstDrvr : 43|2@0+ (1,0) [0|3] "" ZCUD
 SG_ LumLenAdjmtRowFirstDrvr_UB : 25|1@0+ (1,0) [0|1] "" ZCUD
 SG_ LumLenAdjmtRowFirstPass : 41|2@0+ (1,0) [0|3] "" ZCUP
 SG_ LumLenAdjmtRowFirstPass_UB : 24|1@0+ (1,0) [0|1] "" ZCUP
 SG_ PassSeatDispMassgFct_UB : 34|1@0+ (1,0) [0|1] "" ZCUP
 SG_ PassSeatDispMassgFctMassgInten : 79|2@0+ (1,0) [0|3] "" ZCUP
 SG_ PassSeatDispMassgFctMassgProg : 77|3@0+ (1,0) [0|7] "" ZCUP
 SG_ PassSeatDispMassgFctOnOffl2 : 74|2@0+ (1,0) [0|3] "" ZCUP
 SG_ PassSeatDispSpplFct : 51|3@0+ (1,0) [0|7] "" ZCUP
 SG_ PassSeatDispSpplFct_UB : 48|1@0+ (1,0) [0|1] "" ZCUP
 SG_ SteerWhlHeatngAutStrtReq : 9|1@0+ (1,0) [0|1] "" ZCUD
 SG_ SteerWhlHeatngAutStrtReq_UB : 8|1@0+ (1,0) [0|1] "" ZCUD
 SG_ SunCurtCtrlReq : 23|2@0+ (1,0) [0|3] "" ZCUD
 SG_ SunCurtCtrlReq_UB : 21|1@0+ (1,0) [0|1] "" ZCUD
 SG_ SunRoofCtrlReq : 20|2@0+ (1,0) [0|3] "" ZCUD
 SG_ SunRoofCtrlReq_UB : 18|1@0+ (1,0) [0|1] "" ZCUD
 SG_ TelmBookChrgnTyp : 12|3@0+ (1,0) [0|7] "" ZCUD
 SG_ TelmBookChrgnTyp_UB : 13|1@0+ (1,0) [0|1] "" ZCUD
 SG_ WirelschrgActvReqFromHmi : 31|1@0+ (1,0) [0|1] "" ZCUD
 SG_ WirelschrgActvReqFromHmi_UB : 30|1@0+ (1,0) [0|1] "" ZCUD

BO_ 311 DhuZCUCANFD2Fr17 : 64 IHU
 SG_ ExtrMirrAdjHmiReq : 303|3@0+ (1,0) [0|7] "" ZCUD
 SG_ ExtrMirrAdjHmiReq_UB : 298|1@0+ (1,0) [0|1] "" ZCUD
 SG_ ExtrMirrFoldHmiReq : 296|1@0+ (1,0) [0|1] "" ZCUD
 SG_ ExtrMirrFoldHmiReq_UB : 311|1@0+ (1,0) [0|1] "" ZCUD
 SG_ ExtrMirrSelnHmiReq : 300|2@0+ (1,0) [0|3] "" ZCUD
 SG_ ExtrMirrSelnHmiReq_UB : 297|1@0+ (1,0) [0|1] "" ZCUD
 SG_ HmiAC : 222|1@0+ (1,0) [0|1] "" ZCUD,ZCUP
 SG_ HmiAC_UB : 221|1@0+ (1,0) [0|1] "" ZCUD,ZCUP
 SG_ HmiElecFrntDefrstReq : 218|2@0+ (1,0) [0|3] "" ZCUD
 SG_ HmiElecFrntDefrstReq_UB : 216|1@0+ (1,0) [0|1] "" ZCUD
 SG_ HmiElecReMirrDefrstReq : 231|2@0+ (1,0) [0|3] "" ZCUD
 SG_ HmiElecReMirrDefrstReq_UB : 229|1@0+ (1,0) [0|1] "" ZCUD
 SG_ HmiElecReWinDefrstReq : 228|2@0+ (1,0) [0|3] "" ZCUD
 SG_ HmiElecReWinDefrstReq_UB : 226|1@0+ (1,0) [0|1] "" ZCUD
 SG_ IdleChrgCtrl : 225|1@0+ (1,0) [0|1] "" ZCUD
 SG_ IdleChrgCtrl_UB : 224|1@0+ (1,0) [0|1] "" ZCUD
 SG_ PwrCnsAvgIndcd_UB : 168|1@0+ (1,0) [0|1] "" ZCUD
 SG_ PwrCnsAvgIndcdEcoDrvInfo1 : 23|11@0+ (0.1,-102.3) [-102.3|102.30000000000003] "Unitless" ZCUD
 SG_ PwrCnsAvgIndcdPwrCnsUnit : 28|1@0+ (1,0) [0|1] "" ZCUD
 SG_ RadioFrqAM : 250|11@0+ (1.0,522.0) [522.0|1710.0] "Unitless" ZCUD,ZCUP
 SG_ RadioFrqAM_UB : 251|1@0+ (1,0) [0|1] "" ZCUD,ZCUP
 SG_ RstTrip1 : 244|4@0+ (1,0) [0|15] "" ZCUD
 SG_ RstTrip1_UB : 240|1@0+ (1,0) [0|1] "" ZCUD
 SG_ RstTrip2 : 271|3@0+ (1,0) [0|7] "" ZCUD
 SG_ RstTrip2_UB : 268|1@0+ (1,0) [0|1] "" ZCUD
 SG_ SaveSetgToMemPrmnt : 310|2@0+ (1,0) [0|3] "" ZCUD,ZCUP
 SG_ SaveSetgToMemPrmnt_UB : 308|1@0+ (1,0) [0|1] "" ZCUD,ZCUP
 SG_ SunRoofAndCurtIninSwt : 265|1@0+ (1,0) [0|1] "" ZCUD
 SG_ SunRoofAndCurtIninSwt_UB : 264|1@0+ (1,0) [0|1] "" ZCUD
 SG_ TrunkOpenHmiReq : 287|2@0+ (1,0) [0|3] "" ZCUD
 SG_ TrunkOpenHmiReq_UB : 285|1@0+ (1,0) [0|1] "" ZCUD
 SG_ WinOpenDrvrReq : 327|5@0+ (1,0) [0|31] "" ZCUD
 SG_ WinOpenDrvrReq_UB : 306|1@0+ (1,0) [0|1] "" ZCUD
 SG_ WinOpenPassReq : 175|5@0+ (1,0) [0|31] "" ZCUP
 SG_ WinOpenPassReq_UB : 170|1@0+ (1,0) [0|1] "" ZCUP
 SG_ WinOpenReLeReq : 335|5@0+ (1,0) [0|31] "" ZCUD,ZCUP
 SG_ WinOpenReLeReq_UB : 305|1@0+ (1,0) [0|1] "" ZCUD,ZCUP
 SG_ WinOpenReRiReq : 319|5@0+ (1,0) [0|31] "" ZCUD,ZCUP
 SG_ WinOpenReRiReq_UB : 307|1@0+ (1,0) [0|1] "" ZCUD,ZCUP
 SG_ Zone1Settings_UB : 179|1@0+ (1,0) [0|1] "" ZCUP
 SG_ Zone1SettingsBlue : 111|8@0+ (1.0,0.0) [0.0|255.0] "Unitless" ZCUP
 SG_ Zone1SettingsGreen : 119|8@0+ (1.0,0.0) [0.0|255.0] "Unitless" ZCUP
 SG_ Zone1SettingsIntensity : 135|7@0+ (1.0,0.0) [0.0|127.0] "Unitless" ZCUP
 SG_ Zone1SettingsRed : 127|8@0+ (1.0,0.0) [0.0|255.0] "Unitless" ZCUP
 SG_ Zone1SettingsZoneStatus : 128|1@0+ (1,0) [0|1] "" ZCUP
 SG_ Zone2Settings_UB : 169|1@0+ (1,0) [0|1] "" ZCUP
 SG_ Zone2SettingsBlue : 143|8@0+ (1.0,0.0) [0.0|255.0] "Unitless" ZCUP
 SG_ Zone2SettingsGreen : 151|8@0+ (1.0,0.0) [0.0|255.0] "Unitless" ZCUP
 SG_ Zone2SettingsIntensity : 167|7@0+ (1.0,0.0) [0.0|127.0] "Unitless" ZCUP
 SG_ Zone2SettingsRed : 159|8@0+ (1.0,0.0) [0.0|255.0] "Unitless" ZCUP
 SG_ Zone2SettingsZoneStatus : 160|1@0+ (1,0) [0|1] "" ZCUP
 SG_ Zone3Settings_UB : 181|1@0+ (1,0) [0|1] "" ZCUP
 SG_ Zone3SettingsBlue : 191|8@0+ (1.0,0.0) [0.0|255.0] "Unitless" ZCUP
 SG_ Zone3SettingsGreen : 199|8@0+ (1.0,0.0) [0.0|255.0] "Unitless" ZCUP
 SG_ Zone3SettingsIntensity : 215|7@0+ (1.0,0.0) [0.0|127.0] "Unitless" ZCUP
 SG_ Zone3SettingsRed : 207|8@0+ (1.0,0.0) [0.0|255.0] "Unitless" ZCUP
 SG_ Zone3SettingsZoneStatus : 208|1@0+ (1,0) [0|1] "" ZCUP

BO_ 66 DhuZCUCANFD2Fr18 : 64 IHU
 SG_ ApproachReq_UB : 185|1@0+ (1,0) [0|1] "" ZCUD
 SG_ ApproachReqData1 : 199|8@0+ (1.0,0.0) [0.0|255.0] "Unitless" ZCUD
 SG_ ApproachReqData10 : 271|8@0+ (1.0,0.0) [0.0|255.0] "Unitless" ZCUD
 SG_ ApproachReqData11 : 279|8@0+ (1.0,0.0) [0.0|255.0] "Unitless" ZCUD
 SG_ ApproachReqData12 : 287|8@0+ (1.0,0.0) [0.0|255.0] "Unitless" ZCUD
 SG_ ApproachReqData13 : 295|8@0+ (1.0,0.0) [0.0|255.0] "Unitless" ZCUD
 SG_ ApproachReqData14 : 303|8@0+ (1.0,0.0) [0.0|255.0] "Unitless" ZCUD
 SG_ ApproachReqData15 : 311|8@0+ (1.0,0.0) [0.0|255.0] "Unitless" ZCUD
 SG_ ApproachReqData16 : 319|8@0+ (1.0,0.0) [0.0|255.0] "Unitless" ZCUD
 SG_ ApproachReqData2 : 207|8@0+ (1.0,0.0) [0.0|255.0] "Unitless" ZCUD
 SG_ ApproachReqData3 : 215|8@0+ (1.0,0.0) [0.0|255.0] "Unitless" ZCUD
 SG_ ApproachReqData4 : 223|8@0+ (1.0,0.0) [0.0|255.0] "Unitless" ZCUD
 SG_ ApproachReqData5 : 231|8@0+ (1.0,0.0) [0.0|255.0] "Unitless" ZCUD
 SG_ ApproachReqData6 : 239|8@0+ (1.0,0.0) [0.0|255.0] "Unitless" ZCUD
 SG_ ApproachReqData7 : 247|8@0+ (1.0,0.0) [0.0|255.0] "Unitless" ZCUD
 SG_ ApproachReqData8 : 255|8@0+ (1.0,0.0) [0.0|255.0] "Unitless" ZCUD
 SG_ ApproachReqData9 : 263|8@0+ (1.0,0.0) [0.0|255.0] "Unitless" ZCUD
 SG_ DchaChrgnTarVal : 135|10@0+ (0.1,0.0) [0.0|100.0] "%" ZCUD
 SG_ DchaChrgnTarVal_UB : 125|1@0+ (1,0) [0|1] "" ZCUD
 SG_ DChaEngStsCtrl : 65|2@0+ (1,0) [0|3] "" ZCUD
 SG_ DChaEngStsCtrl_UB : 162|1@0+ (1,0) [0|1] "" ZCUD
 SG_ DstFromDestination : 137|10@0+ (1.0,0.0) [0.0|1023.0] "Unitless" ZCUD
 SG_ DstFromDestination_UB : 123|1@0+ (1,0) [0|1] "" ZCUD
 SG_ HVPwrDwnRstReq : 115|1@0+ (1,0) [0|1] "" ZCUD
 SG_ HVPwrDwnRstReq_UB : 124|1@0+ (1,0) [0|1] "" ZCUD
 SG_ ReadLiOpenReq_UB : 127|1@0+ (1,0) [0|1] "" ZCUD
 SG_ ReadLiOpenReqFrontLeft : 79|2@0+ (1,0) [0|3] "" ZCUD
 SG_ ReadLiOpenReqFrontRight : 77|2@0+ (1,0) [0|3] "" ZCUD
 SG_ ReadLiOpenReqSecondRowLeft : 75|2@0+ (1,0) [0|3] "" ZCUD
 SG_ ReadLiOpenReqSecondRowRight : 73|2@0+ (1,0) [0|3] "" ZCUD
 SG_ ReadLiOpenReqThirdRowLeft : 87|2@0+ (1,0) [0|3] "" ZCUD
 SG_ ReadLiOpenReqThirdRowRight : 85|2@0+ (1,0) [0|3] "" ZCUD
 SG_ RemBookChrgnTarVal : 161|10@0+ (0.1,0.0) [0.0|100.0] "%" ZCUD
 SG_ RemBookChrgnTarVal_UB : 163|1@0+ (1,0) [0|1] "" ZCUD
 SG_ RKEAndNFCReqSts_UB : 184|1@0+ (1,0) [0|1] "" ZCUD
 SG_ RKEAndNFCReqStsData1 : 327|8@0+ (1.0,0.0) [0.0|255.0] "Unitless" ZCUD
 SG_ RKEAndNFCReqStsData10 : 399|8@0+ (1.0,0.0) [0.0|255.0] "Unitless" ZCUD
 SG_ RKEAndNFCReqStsData11 : 407|8@0+ (1.0,0.0) [0.0|255.0] "Unitless" ZCUD
 SG_ RKEAndNFCReqStsData12 : 415|8@0+ (1.0,0.0) [0.0|255.0] "Unitless" ZCUD
 SG_ RKEAndNFCReqStsData13 : 423|8@0+ (1.0,0.0) [0.0|255.0] "Unitless" ZCUD
 SG_ RKEAndNFCReqStsData14 : 431|8@0+ (1.0,0.0) [0.0|255.0] "Unitless" ZCUD
 SG_ RKEAndNFCReqStsData15 : 439|8@0+ (1.0,0.0) [0.0|255.0] "Unitless" ZCUD
 SG_ RKEAndNFCReqStsData16 : 447|8@0+ (1.0,0.0) [0.0|255.0] "Unitless" ZCUD
 SG_ RKEAndNFCReqStsData2 : 335|8@0+ (1.0,0.0) [0.0|255.0] "Unitless" ZCUD
 SG_ RKEAndNFCReqStsData3 : 343|8@0+ (1.0,0.0) [0.0|255.0] "Unitless" ZCUD
 SG_ RKEAndNFCReqStsData4 : 351|8@0+ (1.0,0.0) [0.0|255.0] "Unitless" ZCUD
 SG_ RKEAndNFCReqStsData5 : 359|8@0+ (1.0,0.0) [0.0|255.0] "Unitless" ZCUD
 SG_ RKEAndNFCReqStsData6 : 367|8@0+ (1.0,0.0) [0.0|255.0] "Unitless" ZCUD
 SG_ RKEAndNFCReqStsData7 : 375|8@0+ (1.0,0.0) [0.0|255.0] "Unitless" ZCUD
 SG_ RKEAndNFCReqStsData8 : 383|8@0+ (1.0,0.0) [0.0|255.0] "Unitless" ZCUD
 SG_ RKEAndNFCReqStsData9 : 391|8@0+ (1.0,0.0) [0.0|255.0] "Unitless" ZCUD
 SG_ TopPosTrFromHmi : 106|3@0+ (1,0) [0|7] "" ZCUD
 SG_ TopPosTrFromHmi_UB : 186|1@0+ (1,0) [0|1] "" ZCUD
 SG_ UsrSpeechSts : 113|1@0+ (1,0) [0|1] "" ZCUD
 SG_ UsrSpeechSts_UB : 187|1@0+ (1,0) [0|1] "" ZCUD
 SG_ WinOpenAppReq_UB : 164|1@0+ (1,0) [0|1] "" ZCUD,ZCUP
 SG_ WinOpenAppReqWindowOpenValue : 183|8@0+ (1.0,0.0) [0.0|100.0] "%" ZCUD,ZCUP
 SG_ WinOpenAppReqWinOpenClsGlbSts : 191|2@0+ (1,0) [0|3] "" ZCUD,ZCUP

BO_ 272 DhuZCUCANFD2Fr19 : 64 IHU
 SG_ BookTrvlClimaActvReq : 7|2@0+ (1,0) [0|3] "" ZCUP
 SG_ BookTrvlClimaActvReq_UB : 26|1@0+ (1,0) [0|1] "" ZCUP
 SG_ CarFindrHornLiReqFromTelm : 5|2@0+ (1,0) [0|3] "" ZCUD
 SG_ CarFindrHornLiReqFromTelm_UB : 24|1@0+ (1,0) [0|1] "" ZCUD
 SG_ CbnOverHeatProtnEnaFromTelm : 0|1@0+ (1,0) [0|1] "" ZCUP
 SG_ CbnOverHeatProtnEnaFromTelm_UB : 39|1@0+ (1,0) [0|1] "" ZCUP
 SG_ ChrgLidTelmLockgReq : 9|1@0+ (1,0) [0|1] "" ZCUD
 SG_ ChrgLidTelmLockgReq_UB : 38|1@0+ (1,0) [0|1] "" ZCUD
 SG_ ClimaRqrd1 : 23|2@0+ (1,0) [0|3] "" ZCUP
 SG_ ClimaRqrd1_UB : 33|1@0+ (1,0) [0|1] "" ZCUP
 SG_ ClimaTmrStsTelmRqrd : 19|1@0+ (1,0) [0|1] "" ZCUP
 SG_ ClimaTmrStsTelmRqrd_UB : 32|1@0+ (1,0) [0|1] "" ZCUP
 SG_ EmgyAsscTrigSts : 21|2@0+ (1,0) [0|3] "" ZCUD
 SG_ EmgyAsscTrigSts_UB : 47|1@0+ (1,0) [0|1] "" ZCUD
 SG_ EngForbidReqFromTelm : 18|1@0+ (1,0) [0|1] "" ZCUD
 SG_ EngForbidReqFromTelm_UB : 46|1@0+ (1,0) [0|1] "" ZCUD
 SG_ EngPermitReqFromTelm : 17|1@0+ (1,0) [0|1] "" ZCUD
 SG_ EngPermitReqFromTelm_UB : 45|1@0+ (1,0) [0|1] "" ZCUD
 SG_ ExtrLiShowActvnReq : 16|1@0+ (1,0) [0|1] "" ZCUD
 SG_ ExtrLiShowActvnReq_UB : 44|1@0+ (1,0) [0|1] "" ZCUD
 SG_ ExtrLiShowFileTxReq : 29|1@0+ (1,0) [0|1] "" ZCUD
 SG_ ExtrLiShowFileTxReq_UB : 43|1@0+ (1,0) [0|1] "" ZCUD
 SG_ TelmThermoTankReq1 : 41|2@0+ (1,0) [0|3] "" ZCUD
 SG_ TelmThermoTankReq1_UB : 56|1@0+ (1,0) [0|1] "" ZCUD
 SG_ TelmThermoTankT : 55|8@0+ (1.0,-50.0) [-50.0|205.0] "degC" ZCUD
 SG_ TelmThermoTankT_UB : 63|1@0+ (1,0) [0|1] "" ZCUD
 SG_ TelmThermoTankTmr1 : 62|5@0+ (1.0,0.0) [0.0|31.0] "hours" ZCUD
 SG_ TelmThermoTankTmr1_UB : 57|1@0+ (1,0) [0|1] "" ZCUD

BO_ 74 DhuZCUCANFD2Fr20 : 64 IHU
 SG_ BLEKeySearchResp_UB : 391|1@0+ (1,0) [0|1] "" ZCUD
 SG_ BLEKeySearchRespData1 : 7|8@0+ (1.0,0.0) [0.0|255.0] "Unitless" ZCUD
 SG_ BLEKeySearchRespData10 : 79|8@0+ (1.0,0.0) [0.0|255.0] "Unitless" ZCUD
 SG_ BLEKeySearchRespData11 : 87|8@0+ (1.0,0.0) [0.0|255.0] "Unitless" ZCUD
 SG_ BLEKeySearchRespData12 : 95|8@0+ (1.0,0.0) [0.0|255.0] "Unitless" ZCUD
 SG_ BLEKeySearchRespData13 : 103|8@0+ (1.0,0.0) [0.0|255.0] "Unitless" ZCUD
 SG_ BLEKeySearchRespData14 : 111|8@0+ (1.0,0.0) [0.0|255.0] "Unitless" ZCUD
 SG_ BLEKeySearchRespData15 : 119|8@0+ (1.0,0.0) [0.0|255.0] "Unitless" ZCUD
 SG_ BLEKeySearchRespData16 : 127|8@0+ (1.0,0.0) [0.0|255.0] "Unitless" ZCUD
 SG_ BLEKeySearchRespData2 : 15|8@0+ (1.0,0.0) [0.0|255.0] "Unitless" ZCUD
 SG_ BLEKeySearchRespData3 : 23|8@0+ (1.0,0.0) [0.0|255.0] "Unitless" ZCUD
 SG_ BLEKeySearchRespData4 : 31|8@0+ (1.0,0.0) [0.0|255.0] "Unitless" ZCUD
 SG_ BLEKeySearchRespData5 : 39|8@0+ (1.0,0.0) [0.0|255.0] "Unitless" ZCUD
 SG_ BLEKeySearchRespData6 : 47|8@0+ (1.0,0.0) [0.0|255.0] "Unitless" ZCUD
 SG_ BLEKeySearchRespData7 : 55|8@0+ (1.0,0.0) [0.0|255.0] "Unitless" ZCUD
 SG_ BLEKeySearchRespData8 : 63|8@0+ (1.0,0.0) [0.0|255.0] "Unitless" ZCUD
 SG_ BLEKeySearchRespData9 : 71|8@0+ (1.0,0.0) [0.0|255.0] "Unitless" ZCUD
 SG_ NFCAndBLEKeyEnaSts_UB : 390|1@0+ (1,0) [0|1] "" ZCUD
 SG_ NFCAndBLEKeyEnaStsData1 : 135|8@0+ (1.0,0.0) [0.0|255.0] "Unitless" ZCUD
 SG_ NFCAndBLEKeyEnaStsData10 : 207|8@0+ (1.0,0.0) [0.0|255.0] "Unitless" ZCUD
 SG_ NFCAndBLEKeyEnaStsData11 : 215|8@0+ (1.0,0.0) [0.0|255.0] "Unitless" ZCUD
 SG_ NFCAndBLEKeyEnaStsData12 : 223|8@0+ (1.0,0.0) [0.0|255.0] "Unitless" ZCUD
 SG_ NFCAndBLEKeyEnaStsData13 : 231|8@0+ (1.0,0.0) [0.0|255.0] "Unitless" ZCUD
 SG_ NFCAndBLEKeyEnaStsData14 : 239|8@0+ (1.0,0.0) [0.0|255.0] "Unitless" ZCUD
 SG_ NFCAndBLEKeyEnaStsData15 : 247|8@0+ (1.0,0.0) [0.0|255.0] "Unitless" ZCUD
 SG_ NFCAndBLEKeyEnaStsData16 : 255|8@0+ (1.0,0.0) [0.0|255.0] "Unitless" ZCUD
 SG_ NFCAndBLEKeyEnaStsData2 : 143|8@0+ (1.0,0.0) [0.0|255.0] "Unitless" ZCUD
 SG_ NFCAndBLEKeyEnaStsData3 : 151|8@0+ (1.0,0.0) [0.0|255.0] "Unitless" ZCUD
 SG_ NFCAndBLEKeyEnaStsData4 : 159|8@0+ (1.0,0.0) [0.0|255.0] "Unitless" ZCUD
 SG_ NFCAndBLEKeyEnaStsData5 : 167|8@0+ (1.0,0.0) [0.0|255.0] "Unitless" ZCUD
 SG_ NFCAndBLEKeyEnaStsData6 : 175|8@0+ (1.0,0.0) [0.0|255.0] "Unitless" ZCUD
 SG_ NFCAndBLEKeyEnaStsData7 : 183|8@0+ (1.0,0.0) [0.0|255.0] "Unitless" ZCUD
 SG_ NFCAndBLEKeyEnaStsData8 : 191|8@0+ (1.0,0.0) [0.0|255.0] "Unitless" ZCUD
 SG_ NFCAndBLEKeyEnaStsData9 : 199|8@0+ (1.0,0.0) [0.0|255.0] "Unitless" ZCUD
 SG_ NFCKeySearchResp_UB : 389|1@0+ (1,0) [0|1] "" ZCUD
 SG_ NFCKeySearchRespData1 : 263|8@0+ (1.0,0.0) [0.0|255.0] "Unitless" ZCUD
 SG_ NFCKeySearchRespData10 : 335|8@0+ (1.0,0.0) [0.0|255.0] "Unitless" ZCUD
 SG_ NFCKeySearchRespData11 : 343|8@0+ (1.0,0.0) [0.0|255.0] "Unitless" ZCUD
 SG_ NFCKeySearchRespData12 : 351|8@0+ (1.0,0.0) [0.0|255.0] "Unitless" ZCUD
 SG_ NFCKeySearchRespData13 : 359|8@0+ (1.0,0.0) [0.0|255.0] "Unitless" ZCUD
 SG_ NFCKeySearchRespData14 : 367|8@0+ (1.0,0.0) [0.0|255.0] "Unitless" ZCUD
 SG_ NFCKeySearchRespData15 : 375|8@0+ (1.0,0.0) [0.0|255.0] "Unitless" ZCUD
 SG_ NFCKeySearchRespData16 : 383|8@0+ (1.0,0.0) [0.0|255.0] "Unitless" ZCUD
 SG_ NFCKeySearchRespData2 : 271|8@0+ (1.0,0.0) [0.0|255.0] "Unitless" ZCUD
 SG_ NFCKeySearchRespData3 : 279|8@0+ (1.0,0.0) [0.0|255.0] "Unitless" ZCUD
 SG_ NFCKeySearchRespData4 : 287|8@0+ (1.0,0.0) [0.0|255.0] "Unitless" ZCUD
 SG_ NFCKeySearchRespData5 : 295|8@0+ (1.0,0.0) [0.0|255.0] "Unitless" ZCUD
 SG_ NFCKeySearchRespData6 : 303|8@0+ (1.0,0.0) [0.0|255.0] "Unitless" ZCUD
 SG_ NFCKeySearchRespData7 : 311|8@0+ (1.0,0.0) [0.0|255.0] "Unitless" ZCUD
 SG_ NFCKeySearchRespData8 : 319|8@0+ (1.0,0.0) [0.0|255.0] "Unitless" ZCUD
 SG_ NFCKeySearchRespData9 : 327|8@0+ (1.0,0.0) [0.0|255.0] "Unitless" ZCUD

CM_ SG_ 99 DwnLoadDynLtgPrmForFrntRIGrp10ContinueTime "Light Show Continue Time Parameter 2";
CM_ SG_ 99 DwnLoadDynLtgPrmForFrntRIGrp10HighBrightness "Light Show Upper Brightness Parameter 2";
CM_ SG_ 99 DwnLoadDynLtgPrmForFrntRIGrp10LowBrightness "Light Show Lower Brightness Parameter 2";
CM_ SG_ 99 DwnLoadDynLtgPrmForFrntRIGrp10Mode1 "Light Show Mode Parameter 2";
CM_ SG_ 99 DwnLoadDynLtgPrmForFrntRIGrp10OffsetTime "Light Show Offset Time Parameter 2";
CM_ SG_ 99 DwnLoadDynLtgPrmForFrntRIGrp10Timestamp "Light Show time stamp 2";
CM_ SG_ 99 DwnLoadDynLtgPrmForFrntRIGrp11ContinueTime "Light Show Continue Time Parameter 2";
CM_ SG_ 99 DwnLoadDynLtgPrmForFrntRIGrp11HighBrightness "Light Show Upper Brightness Parameter 2";
CM_ SG_ 99 DwnLoadDynLtgPrmForFrntRIGrp11LowBrightness "Light Show Lower Brightness Parameter 2";
CM_ SG_ 99 DwnLoadDynLtgPrmForFrntRIGrp11Mode1 "Light Show Mode Parameter 2";
CM_ SG_ 99 DwnLoadDynLtgPrmForFrntRIGrp11OffsetTime "Light Show Offset Time Parameter 2";
CM_ SG_ 99 DwnLoadDynLtgPrmForFrntRIGrp11Timestamp "Light Show time stamp 2";
CM_ SG_ 99 DwnLoadDynLtgPrmForFrntRIGrp12ContinueTime "Light Show Continue Time Parameter 2";
CM_ SG_ 99 DwnLoadDynLtgPrmForFrntRIGrp12HighBrightness "Light Show Upper Brightness Parameter 2";
CM_ SG_ 99 DwnLoadDynLtgPrmForFrntRIGrp12LowBrightness "Light Show Lower Brightness Parameter 2";
CM_ SG_ 99 DwnLoadDynLtgPrmForFrntRIGrp12Mode1 "Light Show Mode Parameter 2";
CM_ SG_ 99 DwnLoadDynLtgPrmForFrntRIGrp12OffsetTime "Light Show Offset Time Parameter 2";
CM_ SG_ 99 DwnLoadDynLtgPrmForFrntRIGrp12Timestamp "Light Show time stamp 2";
CM_ SG_ 99 DwnLoadDynLtgPrmForFrntRIGrp1ContinueTime "Light Show Continue Time Parameter 2";
CM_ SG_ 99 DwnLoadDynLtgPrmForFrntRIGrp1HighBrightness "Light Show Upper Brightness Parameter 2";
CM_ SG_ 99 DwnLoadDynLtgPrmForFrntRIGrp1LowBrightness "Light Show Lower Brightness Parameter 2";
CM_ SG_ 99 DwnLoadDynLtgPrmForFrntRIGrp1Mode1 "Light Show Mode Parameter 2";
CM_ SG_ 99 DwnLoadDynLtgPrmForFrntRIGrp1OffsetTime "Light Show Offset Time Parameter 2";
CM_ SG_ 99 DwnLoadDynLtgPrmForFrntRIGrp1Timestamp "Light Show time stamp 2";
CM_ SG_ 99 DwnLoadDynLtgPrmForFrntRIGrp2ContinueTime "Light Show Continue Time Parameter 2";
CM_ SG_ 99 DwnLoadDynLtgPrmForFrntRIGrp2HighBrightness "Light Show Upper Brightness Parameter 2";
CM_ SG_ 99 DwnLoadDynLtgPrmForFrntRIGrp2LowBrightness "Light Show Lower Brightness Parameter 2";
CM_ SG_ 99 DwnLoadDynLtgPrmForFrntRIGrp2Mode1 "Light Show Mode Parameter 2";
CM_ SG_ 99 DwnLoadDynLtgPrmForFrntRIGrp2OffsetTime "Light Show Offset Time Parameter 2";
CM_ SG_ 99 DwnLoadDynLtgPrmForFrntRIGrp2Timestamp "Light Show time stamp 2";
CM_ SG_ 99 DwnLoadDynLtgPrmForFrntRIGrp3ContinueTime "Light Show Continue Time Parameter 2";
CM_ SG_ 99 DwnLoadDynLtgPrmForFrntRIGrp3HighBrightness "Light Show Upper Brightness Parameter 2";
CM_ SG_ 99 DwnLoadDynLtgPrmForFrntRIGrp3LowBrightness "Light Show Lower Brightness Parameter 2";
CM_ SG_ 99 DwnLoadDynLtgPrmForFrntRIGrp3Mode1 "Light Show Mode Parameter 2";
CM_ SG_ 99 DwnLoadDynLtgPrmForFrntRIGrp3OffsetTime "Light Show Offset Time Parameter 2";
CM_ SG_ 99 DwnLoadDynLtgPrmForFrntRIGrp3Timestamp "Light Show time stamp 2";
CM_ SG_ 99 DwnLoadDynLtgPrmForFrntRIGrp4ContinueTime "Light Show Continue Time Parameter 2";
CM_ SG_ 99 DwnLoadDynLtgPrmForFrntRIGrp4HighBrightness "Light Show Upper Brightness Parameter 2";
CM_ SG_ 99 DwnLoadDynLtgPrmForFrntRIGrp4LowBrightness "Light Show Lower Brightness Parameter 2";
CM_ SG_ 99 DwnLoadDynLtgPrmForFrntRIGrp4Mode1 "Light Show Mode Parameter 2";
CM_ SG_ 99 DwnLoadDynLtgPrmForFrntRIGrp4OffsetTime "Light Show Offset Time Parameter 2";
CM_ SG_ 99 DwnLoadDynLtgPrmForFrntRIGrp4Timestamp "Light Show time stamp 2";
CM_ SG_ 99 DwnLoadDynLtgPrmForFrntRIGrp5ContinueTime "Light Show Continue Time Parameter 2";
CM_ SG_ 99 DwnLoadDynLtgPrmForFrntRIGrp5HighBrightness "Light Show Upper Brightness Parameter 2";
CM_ SG_ 99 DwnLoadDynLtgPrmForFrntRIGrp5LowBrightness "Light Show Lower Brightness Parameter 2";
CM_ SG_ 99 DwnLoadDynLtgPrmForFrntRIGrp5Mode1 "Light Show Mode Parameter 2";
CM_ SG_ 99 DwnLoadDynLtgPrmForFrntRIGrp5OffsetTime "Light Show Offset Time Parameter 2";
CM_ SG_ 99 DwnLoadDynLtgPrmForFrntRIGrp5Timestamp "Light Show time stamp 2";
CM_ SG_ 99 DwnLoadDynLtgPrmForFrntRIGrp6ContinueTime "Light Show Continue Time Parameter 2";
CM_ SG_ 99 DwnLoadDynLtgPrmForFrntRIGrp6HighBrightness "Light Show Upper Brightness Parameter 2";
CM_ SG_ 99 DwnLoadDynLtgPrmForFrntRIGrp6LowBrightness "Light Show Lower Brightness Parameter 2";
CM_ SG_ 99 DwnLoadDynLtgPrmForFrntRIGrp6Mode1 "Light Show Mode Parameter 2";
CM_ SG_ 99 DwnLoadDynLtgPrmForFrntRIGrp6OffsetTime "Light Show Offset Time Parameter 2";
CM_ SG_ 99 DwnLoadDynLtgPrmForFrntRIGrp6Timestamp "Light Show time stamp 2";
CM_ SG_ 99 DwnLoadDynLtgPrmForFrntRIGrp7ContinueTime "Light Show Continue Time Parameter 2";
CM_ SG_ 99 DwnLoadDynLtgPrmForFrntRIGrp7HighBrightness "Light Show Upper Brightness Parameter 2";
CM_ SG_ 99 DwnLoadDynLtgPrmForFrntRIGrp7LowBrightness "Light Show Lower Brightness Parameter 2";
CM_ SG_ 99 DwnLoadDynLtgPrmForFrntRIGrp7Mode1 "Light Show Mode Parameter 2";
CM_ SG_ 99 DwnLoadDynLtgPrmForFrntRIGrp7OffsetTime "Light Show Offset Time Parameter 2";
CM_ SG_ 99 DwnLoadDynLtgPrmForFrntRIGrp7Timestamp "Light Show time stamp 2";
CM_ SG_ 99 DwnLoadDynLtgPrmForFrntRIGrp8ContinueTime "Light Show Continue Time Parameter 2";
CM_ SG_ 99 DwnLoadDynLtgPrmForFrntRIGrp8HighBrightness "Light Show Upper Brightness Parameter 2";
CM_ SG_ 99 DwnLoadDynLtgPrmForFrntRIGrp8LowBrightness "Light Show Lower Brightness Parameter 2";
CM_ SG_ 99 DwnLoadDynLtgPrmForFrntRIGrp8Mode1 "Light Show Mode Parameter 2";
CM_ SG_ 99 DwnLoadDynLtgPrmForFrntRIGrp8OffsetTime "Light Show Offset Time Parameter 2";
CM_ SG_ 99 DwnLoadDynLtgPrmForFrntRIGrp8Timestamp "Light Show time stamp 2";
CM_ SG_ 99 DwnLoadDynLtgPrmForFrntRIGrp9ContinueTime "Light Show Continue Time Parameter 2";
CM_ SG_ 99 DwnLoadDynLtgPrmForFrntRIGrp9HighBrightness "Light Show Upper Brightness Parameter 2";
CM_ SG_ 99 DwnLoadDynLtgPrmForFrntRIGrp9LowBrightness "Light Show Lower Brightness Parameter 2";
CM_ SG_ 99 DwnLoadDynLtgPrmForFrntRIGrp9Mode1 "Light Show Mode Parameter 2";
CM_ SG_ 99 DwnLoadDynLtgPrmForFrntRIGrp9OffsetTime "Light Show Offset Time Parameter 2";
CM_ SG_ 99 DwnLoadDynLtgPrmForFrntRIGrp9Timestamp "Light Show time stamp 2";
CM_ SG_ 99 TelmBookSeatHeatClimalReqDrvHeatClimaLvl "driver seat heat level for booking climate";
CM_ SG_ 99 TelmBookSeatHeatClimalReqPassHeatClimaLvl "passenger seat heat level for booking climate";
CM_ SG_ 99 TelmBookSeatHeatClimalReqSecLeHeatClimaLvl "second left seat heat level for booking climate";
CM_ SG_ 99 TelmBookSeatHeatClimalReqSecRiHeatClimaLvl "second right seat heat level for booking climate";
CM_ SG_ 99 TelmBookSeatHeatClimalReqThrdLeHeatClimaLvl "third left seat heat level for booking climate";
CM_ SG_ 99 TelmBookSeatHeatClimalReqThrdRiHeatClimaLvl "third right seat heat level for booking climate";
CM_ SG_ 99 TelmBookSeatVentnClimalReqDrvVentnClimaLvl "driver seat ventilate level for booking climate";
CM_ SG_ 99 TelmBookSeatVentnClimalReqPassVentnClimaLvl "passenger seat ventilate level for booking climate";
CM_ SG_ 99 TelmBookSeatVentnClimalReqSecLeVentnClimaLvl "second left seat ventilate level for booking climate";
CM_ SG_ 99 TelmBookSeatVentnClimalReqSecRiVentnClimaLvl "second right seat ventilate level for booking climate";
CM_ SG_ 99 TelmBookSeatVentnClimalReqThrdLeVentnClimaLvl "third left seat ventilate level for booking climate";
CM_ SG_ 99 TelmBookSeatVentnClimalReqThrdRiVentnClimaL "third right seat ventilate level for booking climate";
CM_ SG_ 99 TelmClimaTSetHmiCmptmtTSpSpcl "remote climate temperature setting status";
CM_ SG_ 99 TelmClimaTSetTempRange "remote climate temperature setting";
CM_ SG_ 99 TelmStrtEngForChrgnReq "remote start engine request for discharging";
CM_ SG_ 103 DwnLoadDynLtgPrmForFrntRIGrp13ContinueTime "Light Show Continue Time Parameter 2";
CM_ SG_ 103 DwnLoadDynLtgPrmForFrntRIGrp13HighBrightness "Light Show Upper Brightness Parameter 2";
CM_ SG_ 103 DwnLoadDynLtgPrmForFrntRIGrp13LowBrightness "Light Show Lower Brightness Parameter 2";
CM_ SG_ 103 DwnLoadDynLtgPrmForFrntRIGrp13Mode1 "Light Show Mode Parameter 2";
CM_ SG_ 103 DwnLoadDynLtgPrmForFrntRIGrp13OffsetTime "Light Show Offset Time Parameter 2";
CM_ SG_ 103 DwnLoadDynLtgPrmForFrntRIGrp13Timestamp "Light Show time stamp 2";
CM_ SG_ 103 DwnLoadDynLtgPrmForFrntRIGrp14ContinueTime "Light Show Continue Time Parameter 2";
CM_ SG_ 103 DwnLoadDynLtgPrmForFrntRIGrp14HighBrightness "Light Show Upper Brightness Parameter 2";
CM_ SG_ 103 DwnLoadDynLtgPrmForFrntRIGrp14LowBrightness "Light Show Lower Brightness Parameter 2";
CM_ SG_ 103 DwnLoadDynLtgPrmForFrntRIGrp14Mode1 "Light Show Mode Parameter 2";
CM_ SG_ 103 DwnLoadDynLtgPrmForFrntRIGrp14OffsetTime "Light Show Offset Time Parameter 2";
CM_ SG_ 103 DwnLoadDynLtgPrmForFrntRIGrp14Timestamp "Light Show time stamp 2";
CM_ SG_ 103 DwnLoadDynLtgPrmForFrntRIGrp15ContinueTime "Light Show Continue Time Parameter 2";
CM_ SG_ 103 DwnLoadDynLtgPrmForFrntRIGrp15HighBrightness "Light Show Upper Brightness Parameter 2";
CM_ SG_ 103 DwnLoadDynLtgPrmForFrntRIGrp15LowBrightness "Light Show Lower Brightness Parameter 2";
CM_ SG_ 103 DwnLoadDynLtgPrmForFrntRIGrp15Mode1 "Light Show Mode Parameter 2";
CM_ SG_ 103 DwnLoadDynLtgPrmForFrntRIGrp15OffsetTime "Light Show Offset Time Parameter 2";
CM_ SG_ 103 DwnLoadDynLtgPrmForFrntRIGrp15Timestamp "Light Show time stamp 2";
CM_ SG_ 103 DwnLoadDynLtgPrmForFrntRIGrp16ContinueTime "Light Show Continue Time Parameter 2";
CM_ SG_ 103 DwnLoadDynLtgPrmForFrntRIGrp16HighBrightness "Light Show Upper Brightness Parameter 2";
CM_ SG_ 103 DwnLoadDynLtgPrmForFrntRIGrp16LowBrightness "Light Show Lower Brightness Parameter 2";
CM_ SG_ 103 DwnLoadDynLtgPrmForFrntRIGrp16Mode1 "Light Show Mode Parameter 2";
CM_ SG_ 103 DwnLoadDynLtgPrmForFrntRIGrp16OffsetTime "Light Show Offset Time Parameter 2";
CM_ SG_ 103 DwnLoadDynLtgPrmForFrntRIGrp16Timestamp "Light Show time stamp 2";
CM_ SG_ 103 DwnLoadDynLtgPrmForFrntRIGrp17ContinueTime "Light Show Continue Time Parameter 2";
CM_ SG_ 103 DwnLoadDynLtgPrmForFrntRIGrp17HighBrightness "Light Show Upper Brightness Parameter 2";
CM_ SG_ 103 DwnLoadDynLtgPrmForFrntRIGrp17LowBrightness "Light Show Lower Brightness Parameter 2";
CM_ SG_ 103 DwnLoadDynLtgPrmForFrntRIGrp17Mode1 "Light Show Mode Parameter 2";
CM_ SG_ 103 DwnLoadDynLtgPrmForFrntRIGrp17OffsetTime "Light Show Offset Time Parameter 2";
CM_ SG_ 103 DwnLoadDynLtgPrmForFrntRIGrp17Timestamp "Light Show time stamp 2";
CM_ SG_ 103 DwnLoadDynLtgPrmForFrntRIGrp18ContinueTime "Light Show Continue Time Parameter 2";
CM_ SG_ 103 DwnLoadDynLtgPrmForFrntRIGrp18HighBrightness "Light Show Upper Brightness Parameter 2";
CM_ SG_ 103 DwnLoadDynLtgPrmForFrntRIGrp18LowBrightness "Light Show Lower Brightness Parameter 2";
CM_ SG_ 103 DwnLoadDynLtgPrmForFrntRIGrp18Mode1 "Light Show Mode Parameter 2";
CM_ SG_ 103 DwnLoadDynLtgPrmForFrntRIGrp18OffsetTime "Light Show Offset Time Parameter 2";
CM_ SG_ 103 DwnLoadDynLtgPrmForFrntRIGrp18Timestamp "Light Show time stamp 2";
CM_ SG_ 103 DwnLoadDynLtgPrmForFrntRIGrp19ContinueTime "Light Show Continue Time Parameter 2";
CM_ SG_ 103 DwnLoadDynLtgPrmForFrntRIGrp19HighBrightness "Light Show Upper Brightness Parameter 2";
CM_ SG_ 103 DwnLoadDynLtgPrmForFrntRIGrp19LowBrightness "Light Show Lower Brightness Parameter 2";
CM_ SG_ 103 DwnLoadDynLtgPrmForFrntRIGrp19Mode1 "Light Show Mode Parameter 2";
CM_ SG_ 103 DwnLoadDynLtgPrmForFrntRIGrp19OffsetTime "Light Show Offset Time Parameter 2";
CM_ SG_ 103 DwnLoadDynLtgPrmForFrntRIGrp19Timestamp "Light Show time stamp 2";
CM_ SG_ 103 DwnLoadDynLtgPrmForFrntRIGrp20ContinueTime "Light Show Continue Time Parameter 2";
CM_ SG_ 103 DwnLoadDynLtgPrmForFrntRIGrp20HighBrightness "Light Show Upper Brightness Parameter 2";
CM_ SG_ 103 DwnLoadDynLtgPrmForFrntRIGrp20LowBrightness "Light Show Lower Brightness Parameter 2";
CM_ SG_ 103 DwnLoadDynLtgPrmForFrntRIGrp20Mode1 "Light Show Mode Parameter 2";
CM_ SG_ 103 DwnLoadDynLtgPrmForFrntRIGrp20OffsetTime "Light Show Offset Time Parameter 2";
CM_ SG_ 103 DwnLoadDynLtgPrmForFrntRIGrp20Timestamp "Light Show time stamp 2";
CM_ SG_ 103 DwnLoadDynLtgPrmForFrntRIGrp21ContinueTime "Light Show Continue Time Parameter 2";
CM_ SG_ 103 DwnLoadDynLtgPrmForFrntRIGrp21HighBrightness "Light Show Upper Brightness Parameter 2";
CM_ SG_ 103 DwnLoadDynLtgPrmForFrntRIGrp21LowBrightness "Light Show Lower Brightness Parameter 2";
CM_ SG_ 103 DwnLoadDynLtgPrmForFrntRIGrp21Mode1 "Light Show Mode Parameter 2";
CM_ SG_ 103 DwnLoadDynLtgPrmForFrntRIGrp21OffsetTime "Light Show Offset Time Parameter 2";
CM_ SG_ 103 DwnLoadDynLtgPrmForFrntRIGrp21Timestamp "Light Show time stamp 2";
CM_ SG_ 103 DwnLoadDynLtgPrmForFrntRIGrp22ContinueTime "Light Show Continue Time Parameter 2";
CM_ SG_ 103 DwnLoadDynLtgPrmForFrntRIGrp22HighBrightness "Light Show Upper Brightness Parameter 2";
CM_ SG_ 103 DwnLoadDynLtgPrmForFrntRIGrp22LowBrightness "Light Show Lower Brightness Parameter 2";
CM_ SG_ 103 DwnLoadDynLtgPrmForFrntRIGrp22Mode1 "Light Show Mode Parameter 2";
CM_ SG_ 103 DwnLoadDynLtgPrmForFrntRIGrp22OffsetTime "Light Show Offset Time Parameter 2";
CM_ SG_ 103 DwnLoadDynLtgPrmForFrntRIGrp22Timestamp "Light Show time stamp 2";
CM_ SG_ 103 DwnLoadDynLtgPrmForFrntRIGrp23ContinueTime "Light Show Continue Time Parameter 2";
CM_ SG_ 103 DwnLoadDynLtgPrmForFrntRIGrp23HighBrightness "Light Show Upper Brightness Parameter 2";
CM_ SG_ 103 DwnLoadDynLtgPrmForFrntRIGrp23LowBrightness "Light Show Lower Brightness Parameter 2";
CM_ SG_ 103 DwnLoadDynLtgPrmForFrntRIGrp23Mode1 "Light Show Mode Parameter 2";
CM_ SG_ 103 DwnLoadDynLtgPrmForFrntRIGrp23OffsetTime "Light Show Offset Time Parameter 2";
CM_ SG_ 103 DwnLoadDynLtgPrmForFrntRIGrp23Timestamp "Light Show time stamp 2";
CM_ SG_ 103 DwnLoadDynLtgPrmForFrntRIGrp24ContinueTime "Light Show Continue Time Parameter 2";
CM_ SG_ 103 DwnLoadDynLtgPrmForFrntRIGrp24HighBrightness "Light Show Upper Brightness Parameter 2";
CM_ SG_ 103 DwnLoadDynLtgPrmForFrntRIGrp24LowBrightness "Light Show Lower Brightness Parameter 2";
CM_ SG_ 103 DwnLoadDynLtgPrmForFrntRIGrp24Mode1 "Light Show Mode Parameter 2";
CM_ SG_ 103 DwnLoadDynLtgPrmForFrntRIGrp24OffsetTime "Light Show Offset Time Parameter 2";
CM_ SG_ 103 DwnLoadDynLtgPrmForFrntRIGrp24Timestamp "Light Show time stamp 2";
CM_ SG_ 103 TelmBookClimaReqHmiCmptmtTSpSpcl "Climate mode Normal/Lo/Hi";
CM_ SG_ 103 TelmBookClimaReqOnOffNoReq "Climate request On/Off";
CM_ SG_ 103 TelmBookClimaReqTempRange "Climate temperature set";
CM_ SG_ 103 TelmEngDelayTi "remote engine delay time";
CM_ SG_ 103 WinOpenClsGlbReqFromTelmWindowOpenValue "Windows open value pec open 1-100";
CM_ SG_ 103 WinOpenClsGlbReqFromTelmWinOpenClsGlbSts "remote global windows open and closed command request from telematics";
CM_ SG_ 560 AudWarnActv "Signal to CEM that sound has been played for GearPositionWarning.";
CM_ SG_ 560 BevPwrCtrl "send the status of Bev power button";
CM_ SG_ 560 CopilotSeatOccupySts "Copilot seat Occupy status.";
CM_ SG_ 560 DrvrHdPosnDetnX "Defines the signal that monitors the X-axis of the driver's head position.";
CM_ SG_ 560 DrvrHdPosnDetnY "Defines the signal that monitors the Y-axis of the driver's head position.";
CM_ SG_ 560 DrvrHdPosnDetnZ "Defines the signal that monitors the Z-axis of the driver's head position.";
CM_ SG_ 560 DrvSeatOccupySts "Driver seat Occupy status.";
CM_ SG_ 560 HMIAirCdnrAutDrySet "Air Conditioner Automatic Dry";
CM_ SG_ 560 HmiPM25PopUpSet "PM2.5 PopUp function setting Request";
CM_ SG_ 560 PassSideHdPosnDetnX "Defines the signal that monitors the X-axis of the copilot head position.";
CM_ SG_ 560 PassSideHdPosnDetnY "Defines the signal that monitors the Y-axis of the copilot head position.";
CM_ SG_ 560 PassSideHdPosnDetnZ "Defines the signal that monitors the Z-axis of the copilot head position.";
CM_ SG_ 560 SteerSetgPen "IdPen";
CM_ SG_ 560 SteerSetgSteerAsscLvl "Steer Assistance Level";
CM_ SG_ 560 SteerSetgSteerMod "Steer Mode";
CM_ SG_ 560 WiprReAutReq "Activation of Automatic Rear Wiping";
CM_ SG_ 368 AutEgyRgnLvlSet "This signal represents the setting of the energy regeneration level which car with auto level.";
CM_ SG_ 368 FaceRecognitionIndcrFromDHU "The indicator of face recognition successful";
CM_ SG_ 368 GestureDetn "Define signals to monitor gesture status.";
CM_ SG_ 368 LnchModSwt "to switch on/off the launch mode";
CM_ SG_ 368 LvlgSwtSetReqChks "this signal is used to set the vertical level of low beam for exterior  light systerm ";
CM_ SG_ 368 LvlgSwtSetReqCntr "this signal is used to set the vertical level of low beam for exterior  light systerm ";
CM_ SG_ 368 LvlgSwtSetReqLvlgSwtSetReq "this signal is used to set the vertical level of low beam for exterior  light systerm ";
CM_ SG_ 368 PrpsnMaxEvMod "Propulsion Max EV Mod On/Off";
CM_ SG_ 368 RainSnsrSnvtyHMIReq "Rain sensor sensitivity soft switch require";
CM_ SG_ 368 SecLeSeatTarPosnCmdReqSeatBackrTargPosAg "Second row left seat backrest data";
CM_ SG_ 368 SecLeSeatTarPosnCmdReqSeatFrntExtenTargPosPerc "Second row left seat extension data";
CM_ SG_ 368 SecLeSeatTarPosnCmdReqSeatFrntHeiTargPosPerc "Second row left seat front height data";
CM_ SG_ 368 SecLeSeatTarPosnCmdReqSeatLenTargPosPerc "Second row left seat Length data";
CM_ SG_ 368 SecLeSeatTarPosnCmdReqTarPosnCmd1 "Request second left side seat adjusting to target position";
CM_ SG_ 368 SecRiSeatTarPosnCmdReqSeatBackrTargPosAg "Second row right seat backrest data";
CM_ SG_ 368 SecRiSeatTarPosnCmdReqSeatFrntExtenTargPosPerc "Second row right seat extension data";
CM_ SG_ 368 SecRiSeatTarPosnCmdReqSeatFrntHeiTargPosPerc "Second row right seat front height data";
CM_ SG_ 368 SecRiSeatTarPosnCmdReqSeatLenTargPosPerc "Second row right seat Length data";
CM_ SG_ 368 SecRiSeatTarPosnCmdReqTarPosnCmd1 "Request second right side seat adjusting to target position";
CM_ SG_ 259 ConfCurrSpd "Configure paths Speed Status";
CM_ SG_ 259 ConfPath "Configure paths  Status";
CM_ SG_ 259 DchrgnInSwtCtrl "Define whether the internal discharge function is turned on";
CM_ SG_ 259 DrvrCrsCtrlFctDeactvnReq "request to deactivate cc";
CM_ SG_ 259 DrvrCrsCtrlFctReActvReq "request to activate cc";
CM_ SG_ 259 DrvrCrsCtrlFctSeld "select ACC function or CC function.";
CM_ SG_ 259 EPedlModCtrlSt "e-Pedal mode activation soft button signal";
CM_ SG_ 259 ESCLvlSwt "ESC level switch";
CM_ SG_ 259 FuLvlRawActvSideFuLvlValFromFuTbl "raw value from sensor";
CM_ SG_ 259 FuLvlRawActvSideGenQF "QF";
CM_ SG_ 259 FuLvlRawPasSideFuLvlValFromFuTbl "RAW value from sensor";
CM_ SG_ 259 FuLvlRawPasSideGenQF "Quality Flag";
CM_ SG_ 259 HmiMaxEvMod "HMI MAX EV mode";
CM_ SG_ 259 HMISteplessBarPosnSetting "HMISteplessBarPosnSetting";
CM_ SG_ 259 HMIThermoTankDlyCls "HMIThermoTankDly";
CM_ SG_ 259 HMIThermoTankDlyClsTmr "HMIThermoTankDlyClsTmr";
CM_ SG_ 259 HornWarnReq "Horn warning request";
CM_ SG_ 259 IAMSMod "Intelligen tAnti Motion Sickness Mode";
CM_ SG_ 259 KickTailgateSig "UWB kick tailgate signal";
CM_ SG_ 259 LiFlashWarnReq "Light flash warning raquest";
CM_ SG_ 259 LvngCratuDetdSts "Living creature detected status";
CM_ SG_ 259 MirrTarPosnCmdReqDrvrMirrAdjLeRi "Driver side left-right data";
CM_ SG_ 259 MirrTarPosnCmdReqDrvrMirrAdjUpDwn "Driver side up-down data";
CM_ SG_ 259 MirrTarPosnCmdReqPassMirrAdjLeRi "Passenger side left-right data";
CM_ SG_ 259 MirrTarPosnCmdReqPassMirrAdjUpDwn "Passenger side up-down data";
CM_ SG_ 259 MirrTarPosnCmdReqTarPosnCmd1 "request mirrir module adjusting to target position";
CM_ SG_ 259 PasEntryEnaReq1 "Request locking to enable passive entry function";
CM_ SG_ 259 RemHvStrtActvReq "remote High volage power start request for remote real time video function";
CM_ SG_ 259 RoadCondDis "Current traffic distance";
CM_ SG_ 259 RoadCondLvl "Road Congestion level";
CM_ SG_ 259 RoadCondNum "Current road condition data element";
CM_ SG_ 259 RoadCondTime "Current traffic time";
CM_ SG_ 259 RoadSlope "Current road Slope";
CM_ SG_ 259 RoadSlopeDis "Road Slope Distance";
CM_ SG_ 259 RoadSlopeNum "Current road slope condition data element";
CM_ SG_ 259 TelmClimaTmr "Pre-climatization activated timer from telematics.";
CM_ SG_ 259 TotDstTrvld "Total driven distance (odometer), in km";
CM_ SG_ 259 WinOpenLDACReq "Lower windows request from LDAC";
CM_ SG_ 624 MmedHdPwrMod "IHU power mode";
CM_ SG_ 624 MobDevBtnPanicReq "Panic  alarm  active request on the Mobile Device ";
CM_ SG_ 80 CnclBookTrvlReq "A cancel request of the reservation departure function";
CM_ SG_ 80 DKDataFromTelmAcknowledgment "Packet received acknowledgement";
CM_ SG_ 80 DKDataFromTelmDKDataByte1 "Byte number 1";
CM_ SG_ 80 DKDataFromTelmDKDataByte2 "Byte number 2";
CM_ SG_ 80 DKDataFromTelmDKDataByte3 "Byte number 3";
CM_ SG_ 80 DKDataFromTelmDKDataByte4 "Byte number 4";
CM_ SG_ 80 DKDataFromTelmDKDataByte5 "Byte number 5";
CM_ SG_ 80 DKDataFromTelmDKDataByte6 "Byte number 6";
CM_ SG_ 80 DKDataFromTelmHeader "Packet Header";
CM_ SG_ 80 ErsCmdRecErsCmd "Ers command signal";
CM_ SG_ 80 ErsCmdRecErsRunTime "How long time to run ERS";
CM_ SG_ 1168 CarSharingMde "Car sharing mode";
CM_ SG_ 1168 LongTiRunngModCampMod "Camping mode on/off";
CM_ SG_ 1168 LongTiRunngModGameMod "Game mode on/off";
CM_ SG_ 1168 LongTiRunngModMonrbyOMS "User inside or not monitored by OMS";
CM_ SG_ 1168 LongTiRunngModPanelTouched "Panel Touched or not";
CM_ SG_ 1168 LongTiRunngModParkComfortMod "Park comfort mode on/off";
CM_ SG_ 1168 LongTiRunngModPetMod "Pet mode on/off";
CM_ SG_ 1168 LongTiRunngModReserved1 "Reserved";
CM_ SG_ 1168 LongTiRunngModReserved2 "Reserved";
CM_ SG_ 1168 LongTiRunngModReserved3 "Reserved";
CM_ SG_ 1168 LongTiRunngModReserved4 "Reserved";
CM_ SG_ 1168 LongTiRunngModReserved5 "Reserved";
CM_ SG_ 1168 LongTiRunngModReserved6 "Reserved";
CM_ SG_ 1168 LongTiRunngModReserved7 "Reserved";
CM_ SG_ 1168 LongTiRunngModReserved8 "Reserved";
CM_ SG_ 1168 LongTiRunngModRestMod "Refresh mode on/off";
CM_ SG_ 1168 LongTiRunngModTheaterMod "Theater mode on/off";
CM_ SG_ 1168 PosnBriefPosnLat "Latitude";
CM_ SG_ 1168 PosnBriefPosnLgt "Longitude";
CM_ SG_ 1168 UnlckRemReq "Enable or disable two step unlock";
CM_ SG_ 435 HznPosnLRCurrentLane "0x0 Unknown 0x1 Emergency lane 0x2 Single-lane road 0x3 Left-most lane 0x4 Right-most lane 0x5 One of middle lanes on road with three or more lanes 0x6 Reserved0x7 N/A";
CM_ SG_ 435 HznPosnLRCyclicCounter "Cyclic counter of this message type: Reconstructor can use this value to detect missing messages";
CM_ SG_ 435 HznPosnLRMessageType "Type of a CAN message in the scope of the ADASISv2 protocol. ";
CM_ SG_ 435 HznPosnLROffset "Offset of current position from the current path start point modulo 8191.";
CM_ SG_ 435 HznPosnLRPathIndex "[0x0: Unknown][0x1: Position not in Digitized Area][0x2: Position not on-road][0x3:  Vehicle Positioning sub-system not calibrated][0x4:the current vehicle position segment][0x5: the existence of a crossroad branch]...";
CM_ SG_ 435 HznPosnLRPositionAge "Time difference between the moment the message is sent and the moment the vehicle position is calculated by the positioning sub-system.";
CM_ SG_ 435 HznPosnLRPositionConfidence "Position confidence: this field contains Av2HP implementation specific values. Use 0 for highest confidence, 6 for lowest confidence. Value 7 means N/A";
CM_ SG_ 435 HznPosnLRPositionIndex "If Av2HP supports positioning alternatives, contains index of this Position Candidate. Candidate 0 is always most probable position candidate, candidate 1 second etc. If Av2HP does not support positioning alternatives, it will be always 0.";
CM_ SG_ 435 HznPosnLRPositionProbability "Position Probability is calculated by Positioning module of ADASIS v2 Horizon Provider. Different Av2HPs will use different algorithms to calculate this value. 0x0:unknown 0x1F: N/A";
CM_ SG_ 435 HznPosnLRRelativeHeading "[0x0:In path direction][0x1:1.417 degrees right][0x2..0x7E:Right from path direction][0x7E:178.583 degrees right][0x7F:Opposite direction][0x80:178.583 degrees left (181.417 degrees right)][0x80..0xFC:Left from path direction][0xFD:1.417 degrees left (358.583 degrees right)][0xFE:Unknown][0xFF:N/A]";
CM_ SG_ 435 HznPosnLRSpeed "Speed of the vehicle projected to the path ";
CM_ SG_ 435 HznProfLongLRControlPoint "If true, values in this message specifies additional control points required for the interpolation of this profile; If false, actual profile values are specified. ";
CM_ SG_ 435 HznProfLongLRCyclicCounter "Cyclic counter of this message type and profile type: Reconstructor can use this value to detect missing messages.";
CM_ SG_ 435 HznProfLongLRMessageType "Type of a CAN message in the scope of the ADASISv2 protocol.";
CM_ SG_ 435 HznProfLongLROffset "Offset of position of the first profile spot from start position modulo 8191. Offset 8191 is invalid. 0X0-0X1FFE: 0-8190m 0X1FFF: Invalid";
CM_ SG_ 435 HznProfLongLRPathIndex "Index of the path where this profile(s) is located";
CM_ SG_ 435 HznProfLongLRProfileType "Standard PROFILE LONG Types  0:N/A 8:Traffic Sign 10:Extended Lane 19:Traffic event 20:Weather Info";
CM_ SG_ 435 HznProfLongLRRetransmission "If true, this message was sent already at least once before. 0x0:false 0x1:true";
CM_ SG_ 435 HznProfLongLRUpdate "Value true indicates that this message contains updated information of already transmitted PROFILE LONG. 0x0:false 0x1:true";
CM_ SG_ 435 HznProfLongLRValue "Profile value at Offset.";
CM_ SG_ 435 LocalBookChrgnTarVal "Battery SOC Value";
CM_ SG_ 435 MaxAcInpCurrentSet "set the input current";
CM_ SG_ 435 ShowTypOfDTESet "selected status of DTE show type set";
CM_ SG_ 464 BackRestSideSpprtAdjmtRowFirstDrvr "seat side support adjustment ";
CM_ SG_ 464 BackRestSideSpprtAdjmtRowFirstPass "seat side support adjustment ";
CM_ SG_ 464 CushSideSpprtAdjmtRowFirstDrvr "cush side support";
CM_ SG_ 464 CushSideSpprtAdjmtRowFirstPass "cush side support";
CM_ SG_ 464 DiagcComActv "Indicates if a diagnostic communication session is ongoing.";
CM_ SG_ 464 DiagcExtCom "Indicates if a diagnostic tester is connected to the vehicle or if an internal tester is active.";
CM_ SG_ 464 DrvrSeatDispMassgFctMassgInten "Massage program Intensity Level";
CM_ SG_ 464 DrvrSeatDispMassgFctMassgProg "Massage Programs Types";
CM_ SG_ 464 DrvrSeatDispMassgFctOnOffl2 "Turn on or off seat massage";
CM_ SG_ 464 DrvrSeatDispSpplFct "Handles the two way communication for driver multi seat control.";
CM_ SG_ 464 HMIIonizerAirCdnr "HMI Ionizer Air Conditioner";
CM_ SG_ 464 LumHeiAdjmtRowFirstDrvr "lumbar height adjustment";
CM_ SG_ 464 LumHeiAdjmtRowFirstPass "lumbar height adjustment";
CM_ SG_ 464 LumLenAdjmtRowFirstDrvr "lumbar length adjustment";
CM_ SG_ 464 LumLenAdjmtRowFirstPass "lumbar length adjustment";
CM_ SG_ 464 PassSeatDispMassgFctMassgInten "Massage program Intensity Level";
CM_ SG_ 464 PassSeatDispMassgFctMassgProg "Massage Programs Types";
CM_ SG_ 464 PassSeatDispMassgFctOnOffl2 "Turn on or off seat massage";
CM_ SG_ 464 PassSeatDispSpplFct "Handles the two way communication for passenger multi seat control.";
CM_ SG_ 464 SteerWhlHeatngAutStrtReq "automatic start steering wheel heating request";
CM_ SG_ 464 SunCurtCtrlReq "User operate suncurt open and close";
CM_ SG_ 464 SunRoofCtrlReq "User operate sunroof open and close";
CM_ SG_ 464 TelmBookChrgnTyp "Telm Book Chrgn Type from HIM or APP";
CM_ SG_ 464 WirelschrgActvReqFromHmi "On Off";
CM_ SG_ 311 ExtrMirrAdjHmiReq "Adjust the exterior mirror position";
CM_ SG_ 311 ExtrMirrFoldHmiReq "Fold the left and right exterior mirror request";
CM_ SG_ 311 ExtrMirrSelnHmiReq "Select left or right exterior mirror to adjust";
CM_ SG_ 311 HmiAC "Hmi Compartment Cooling Request";
CM_ SG_ 311 HmiElecFrntDefrstReq "Hmi Electric Defrost";
CM_ SG_ 311 HmiElecReMirrDefrstReq "HMI Rear Mirror Defrost";
CM_ SG_ 311 HmiElecReWinDefrstReq "Hmi Rear Window Defrost";
CM_ SG_ 311 IdleChrgCtrl "Soft switch signal for idle charging control.";
CM_ SG_ 311 PwrCnsAvgIndcdEcoDrvInfo1 "AEC value";
CM_ SG_ 311 PwrCnsAvgIndcdPwrCnsUnit "AEC unit";
CM_ SG_ 311 RadioFrqAM "radio frequency analog";
CM_ SG_ 311 RstTrip1 "The reason of restting Trip1 information. ";
CM_ SG_ 311 RstTrip2 "The reason of restting Trip2 information. ";
CM_ SG_ 311 SaveSetgToMemPrmnt "Signal for personal settings saving concept
0: Profile locked, no saving to be performed
1: On the event (toggle 0 to 1) settings shall be saved (manually saving)
2: Automatic saving";
CM_ SG_ 311 SunRoofAndCurtIninSwt "Sunroof and sun curtain initialazation switch";
CM_ SG_ 311 TrunkOpenHmiReq "Boot lid/Tailgate open or close request";
CM_ SG_ 311 WinOpenDrvrReq "driver window open";
CM_ SG_ 311 WinOpenPassReq "passenger window open";
CM_ SG_ 311 WinOpenReLeReq "rear window left open";
CM_ SG_ 311 WinOpenReRiReq "rear window right open";
CM_ SG_ 311 Zone1SettingsBlue "Color settings for zone 1";
CM_ SG_ 311 Zone1SettingsGreen "Color settings for zone 1";
CM_ SG_ 311 Zone1SettingsIntensity "intensity settings for zone 1";
CM_ SG_ 311 Zone1SettingsRed "Color settings for zone 1";
CM_ SG_ 311 Zone1SettingsZoneStatus "Zone status settings for zone 1";
CM_ SG_ 311 Zone2SettingsBlue "Color settings for zone 2";
CM_ SG_ 311 Zone2SettingsGreen "Color settings for zone 2";
CM_ SG_ 311 Zone2SettingsIntensity "intensity settings for zone 2";
CM_ SG_ 311 Zone2SettingsRed "Color settings for zone 2";
CM_ SG_ 311 Zone2SettingsZoneStatus "Zone status settings for zone 2";
CM_ SG_ 311 Zone3SettingsBlue "Color settings for zone 3";
CM_ SG_ 311 Zone3SettingsGreen "Color settings for zone 3";
CM_ SG_ 311 Zone3SettingsIntensity "intensity settings for zone 3";
CM_ SG_ 311 Zone3SettingsRed "Color settings for zone 3";
CM_ SG_ 311 Zone3SettingsZoneStatus "Zone status settings for zone 3";
CM_ SG_ 66 ApproachReqData1 "data";
CM_ SG_ 66 ApproachReqData10 "data";
CM_ SG_ 66 ApproachReqData11 "data";
CM_ SG_ 66 ApproachReqData12 "data";
CM_ SG_ 66 ApproachReqData13 "data";
CM_ SG_ 66 ApproachReqData14 "data";
CM_ SG_ 66 ApproachReqData15 "data";
CM_ SG_ 66 ApproachReqData16 "data";
CM_ SG_ 66 ApproachReqData2 "data";
CM_ SG_ 66 ApproachReqData3 "data";
CM_ SG_ 66 ApproachReqData4 "data";
CM_ SG_ 66 ApproachReqData5 "data";
CM_ SG_ 66 ApproachReqData6 "data";
CM_ SG_ 66 ApproachReqData7 "data";
CM_ SG_ 66 ApproachReqData8 "data";
CM_ SG_ 66 ApproachReqData9 "data";
CM_ SG_ 66 DchaChrgnTarVal "DisCharging Target Value Setting";
CM_ SG_ 66 DChaEngStsCtrl "on/off button,To start the engine to charge the battery.";
CM_ SG_ 66 DstFromDestination "Distance from destination";
CM_ SG_ 66 HVPwrDwnRstReq "HV Power down reset req.";
CM_ SG_ 66 ReadLiOpenReqFrontLeft "Reading light Open or close request";
CM_ SG_ 66 ReadLiOpenReqFrontRight "Reading light Open or close request";
CM_ SG_ 66 ReadLiOpenReqSecondRowLeft "Reading light Open or close request";
CM_ SG_ 66 ReadLiOpenReqSecondRowRight "Reading light Open or close request";
CM_ SG_ 66 ReadLiOpenReqThirdRowLeft "Reading light Open or close request";
CM_ SG_ 66 ReadLiOpenReqThirdRowRight "Reading light Open or close request";
CM_ SG_ 66 RemBookChrgnTarVal "Remote Book Charging Target Value";
CM_ SG_ 66 RKEAndNFCReqStsData1 "data";
CM_ SG_ 66 RKEAndNFCReqStsData10 "data";
CM_ SG_ 66 RKEAndNFCReqStsData11 "data";
CM_ SG_ 66 RKEAndNFCReqStsData12 "data";
CM_ SG_ 66 RKEAndNFCReqStsData13 "data";
CM_ SG_ 66 RKEAndNFCReqStsData14 "data";
CM_ SG_ 66 RKEAndNFCReqStsData15 "data";
CM_ SG_ 66 RKEAndNFCReqStsData16 "data";
CM_ SG_ 66 RKEAndNFCReqStsData2 "data";
CM_ SG_ 66 RKEAndNFCReqStsData3 "data";
CM_ SG_ 66 RKEAndNFCReqStsData4 "data";
CM_ SG_ 66 RKEAndNFCReqStsData5 "data";
CM_ SG_ 66 RKEAndNFCReqStsData6 "data";
CM_ SG_ 66 RKEAndNFCReqStsData7 "data";
CM_ SG_ 66 RKEAndNFCReqStsData8 "data";
CM_ SG_ 66 RKEAndNFCReqStsData9 "data";
CM_ SG_ 66 TopPosTrFromHmi "This signal is used to set top position of tailgate";
CM_ SG_ 66 UsrSpeechSts "The signal of user speech status";
CM_ SG_ 66 WinOpenAppReqWindowOpenValue "Windows open value pec open 1-100";
CM_ SG_ 66 WinOpenAppReqWinOpenClsGlbSts "Remote global windows open and closed command request from Connected Service Sub-system";
CM_ SG_ 272 BookTrvlClimaActvReq "The request to activate air conditioning for the booking travel function with climate control";
CM_ SG_ 272 CarFindrHornLiReqFromTelm "Request signal from Telematics to activate the Car Locator Horn and Light function (FR Mobile App).";
CM_ SG_ 272 CbnOverHeatProtnEnaFromTelm "Users activate or inactivate the cabin overheat protection function through mobile app";
CM_ SG_ 272 ChrgLidTelmLockgReq "Release request for charging lid unlocking by phone App.";
CM_ SG_ 272 ClimaRqrd1 "Request signal from Telematics to start or stop a remote pre-climatization.";
CM_ SG_ 272 ClimaTmrStsTelmRqrd "Pre-climatization  Indicate  an active time ";
CM_ SG_ 272 EmgyAsscTrigSts "Defined the signal as:
0: when the eCall without trigget
1: eCall been automatically trigget by SRS
2: eCall been manually trigget by user via SOS button
3: eCall has fault when SRS trigget crash   ";
CM_ SG_ 272 EngForbidReqFromTelm "remote forbid engine start";
CM_ SG_ 272 EngPermitReqFromTelm "remote permit engine start";
CM_ SG_ 272 ExtrLiShowActvnReq "Request signal for activating Light show, if the value has been set to on. ";
CM_ SG_ 272 ExtrLiShowFileTxReq "Request signal for transferring sequence table. If the value has been set to on, the parameter of lamp elements can be downloaded from IHU to HCM/RCM. ";
CM_ SG_ 272 TelmThermoTankReq1 "Remote Thermotank Control request";
CM_ SG_ 272 TelmThermoTankT "temperature setting for Remote Thermotank Control ";
CM_ SG_ 272 TelmThermoTankTmr1 "Running time setting for Remote Thermotank Control ";
CM_ SG_ 74 BLEKeySearchRespData1 "data";
CM_ SG_ 74 BLEKeySearchRespData10 "data";
CM_ SG_ 74 BLEKeySearchRespData11 "data";
CM_ SG_ 74 BLEKeySearchRespData12 "data";
CM_ SG_ 74 BLEKeySearchRespData13 "data";
CM_ SG_ 74 BLEKeySearchRespData14 "data";
CM_ SG_ 74 BLEKeySearchRespData15 "data";
CM_ SG_ 74 BLEKeySearchRespData16 "data";
CM_ SG_ 74 BLEKeySearchRespData2 "data";
CM_ SG_ 74 BLEKeySearchRespData3 "data";
CM_ SG_ 74 BLEKeySearchRespData4 "data";
CM_ SG_ 74 BLEKeySearchRespData5 "data";
CM_ SG_ 74 BLEKeySearchRespData6 "data";
CM_ SG_ 74 BLEKeySearchRespData7 "data";
CM_ SG_ 74 BLEKeySearchRespData8 "data";
CM_ SG_ 74 BLEKeySearchRespData9 "data";
CM_ SG_ 74 NFCAndBLEKeyEnaStsData1 "data";
CM_ SG_ 74 NFCAndBLEKeyEnaStsData10 "data";
CM_ SG_ 74 NFCAndBLEKeyEnaStsData11 "data";
CM_ SG_ 74 NFCAndBLEKeyEnaStsData12 "data";
CM_ SG_ 74 NFCAndBLEKeyEnaStsData13 "data";
CM_ SG_ 74 NFCAndBLEKeyEnaStsData14 "data";
CM_ SG_ 74 NFCAndBLEKeyEnaStsData15 "data";
CM_ SG_ 74 NFCAndBLEKeyEnaStsData16 "data";
CM_ SG_ 74 NFCAndBLEKeyEnaStsData2 "data";
CM_ SG_ 74 NFCAndBLEKeyEnaStsData3 "data";
CM_ SG_ 74 NFCAndBLEKeyEnaStsData4 "data";
CM_ SG_ 74 NFCAndBLEKeyEnaStsData5 "data";
CM_ SG_ 74 NFCAndBLEKeyEnaStsData6 "data";
CM_ SG_ 74 NFCAndBLEKeyEnaStsData7 "data";
CM_ SG_ 74 NFCAndBLEKeyEnaStsData8 "data";
CM_ SG_ 74 NFCAndBLEKeyEnaStsData9 "data";
CM_ SG_ 74 NFCKeySearchRespData1 "data";
CM_ SG_ 74 NFCKeySearchRespData10 "data";
CM_ SG_ 74 NFCKeySearchRespData11 "data";
CM_ SG_ 74 NFCKeySearchRespData12 "data";
CM_ SG_ 74 NFCKeySearchRespData13 "data";
CM_ SG_ 74 NFCKeySearchRespData14 "data";
CM_ SG_ 74 NFCKeySearchRespData15 "data";
CM_ SG_ 74 NFCKeySearchRespData16 "data";
CM_ SG_ 74 NFCKeySearchRespData2 "data";
CM_ SG_ 74 NFCKeySearchRespData3 "data";
CM_ SG_ 74 NFCKeySearchRespData4 "data";
CM_ SG_ 74 NFCKeySearchRespData5 "data";
CM_ SG_ 74 NFCKeySearchRespData6 "data";
CM_ SG_ 74 NFCKeySearchRespData7 "data";
CM_ SG_ 74 NFCKeySearchRespData8 "data";
CM_ SG_ 74 NFCKeySearchRespData9 "data";
BA_DEF_ BO_ "CANFD_BRS" ENUM "0","1";
BA_DEF_ BO_ "GenMsgCycleTime" INT 0 65536;
BA_DEF_ BO_ "GenMsgDelayTime" INT 0 65536;
BA_DEF_ BO_ "GenMsgSendType" ENUM "cyclic", "spontaneous", "not-used", "not-used", "not-used", "cyclicAndSpontaneous", "not-used", "cyclicIfActive", "NoMsgSendType";
BA_DEF_ BO_ "GenMsgStartDelayTime" INT 0 65536;
BA_DEF_ BO_ "VFrameFormat" ENUM "StandardCAN","ExtendedCAN","reserved","J1939PG","reserved","reserved","reserved","reserved","reserved","reserved","reserved","reserved","reserved","reserved","StandardCAN_FD","ExtendedCAN_FD";
BA_DEF_ SG_ "GenSigSendType" ENUM "Cyclic","OnWrite","OnWriteWithRepetition","OnChange","OnChangeWithRepetition","IfActive","IfActiveWithRepetition","NoSigSendType";
BA_DEF_ SG_ "GenSigStartValue" HEX 0 80000000;
BA_DEF_ BO_ "GenMsgILSupport" ENUM "No","Yes";
BA_DEF_ BO_ "NmAsrMessage" ENUM "No","Yes";
BA_DEF_ SG_ "GenSigFuncType" ENUM "NoFunction","n/a","n/a","n/a","n/a","n/a","n/a","n/a","n/a","n/a","n/a","n/a","n/a","n/a","n/a","CHK","CNTR","n/a","n/a","n/a","CNTR_AR_01","CRC_AR_01_BOTH","CRC_AR_01_ALT","CRC_AR_01_LOW","CRC_AR_01_NIBBLE","CNTR_AR_04","CRC_AR_04A","CNTR_AR_05","CRC_AR_05";
BA_DEF_ SG_ "GenSigDataID" STRING;
BA_DEF_DEF_ "CANFD_BRS" "1";
BA_DEF_DEF_ "GenSigStartValue" 0;
BA_DEF_DEF_ "VFrameFormat" "J1939PG";
BA_DEF_DEF_ "GenSigSendType" "NoSigSendType";
BA_DEF_DEF_ "GenMsgCycleTime" 0;
BA_DEF_DEF_ "GenMsgDelayTime" 0;
BA_DEF_DEF_ "GenMsgStartDelayTime" 0;
BA_DEF_DEF_ "GenMsgSendType" "NoMsgSendType";
BA_DEF_DEF_ "GenMsgILSupport" "Yes";
BA_DEF_DEF_ "NmAsrMessage" "No";
BA_DEF_DEF_ "GenSigFuncType" "NoFunction";
BA_DEF_DEF_ "GenSigDataID" "";

BA_ "GenMsgDelayTime" BO_ 99 30.000;
BA_ "GenMsgSendType" BO_ 99 1;
BA_ "VFrameFormat" BO_ 99 14;

BA_ "GenMsgDelayTime" BO_ 103 30.000;
BA_ "GenMsgSendType" BO_ 103 1;
BA_ "VFrameFormat" BO_ 103 14;

BA_ "GenMsgCycleTime" BO_ 560 300.000;
BA_ "GenMsgSendType" BO_ 560 0;
BA_ "VFrameFormat" BO_ 560 14;

BA_ "GenMsgCycleTime" BO_ 368 80.000;
BA_ "GenMsgSendType" BO_ 368 0;
BA_ "VFrameFormat" BO_ 368 14;

BA_ "GenMsgCycleTime" BO_ 259 15.000;
BA_ "GenMsgSendType" BO_ 259 0;
BA_ "VFrameFormat" BO_ 259 14;

BA_ "GenMsgCycleTime" BO_ 624 450.000;
BA_ "GenMsgSendType" BO_ 624 0;
BA_ "VFrameFormat" BO_ 624 14;

BA_ "GenMsgDelayTime" BO_ 80 20.000;
BA_ "GenMsgSendType" BO_ 80 1;
BA_ "VFrameFormat" BO_ 80 14;

BA_ "GenMsgCycleTime" BO_ 1168 1000.000;
BA_ "GenMsgSendType" BO_ 1168 0;
BA_ "VFrameFormat" BO_ 1168 14;

BA_ "GenMsgDelayTime" BO_ 435 100.000;
BA_ "GenMsgSendType" BO_ 435 1;
BA_ "VFrameFormat" BO_ 435 14;

BA_ "GenMsgCycleTime" BO_ 464 200.000;
BA_ "GenMsgSendType" BO_ 464 0;
BA_ "VFrameFormat" BO_ 464 14;

BA_ "GenMsgCycleTime" BO_ 311 50.000;
BA_ "GenMsgSendType" BO_ 311 0;
BA_ "VFrameFormat" BO_ 311 14;

BA_ "GenMsgDelayTime" BO_ 66 10.000;
BA_ "GenMsgSendType" BO_ 66 1;
BA_ "VFrameFormat" BO_ 66 14;

BA_ "GenMsgDelayTime" BO_ 272 25.000;
BA_ "GenMsgSendType" BO_ 272 1;
BA_ "VFrameFormat" BO_ 272 14;

BA_ "GenMsgDelayTime" BO_ 74 10.000;
BA_ "GenMsgSendType" BO_ 74 1;
BA_ "VFrameFormat" BO_ 74 14;
BA_ "GenSigSendType" SG_ 66 ApproachReqData1 1;
BA_ "GenSigSendType" SG_ 66 ApproachReqData10 1;
BA_ "GenSigSendType" SG_ 66 ApproachReqData11 1;
BA_ "GenSigSendType" SG_ 66 ApproachReqData12 1;
BA_ "GenSigSendType" SG_ 66 ApproachReqData13 1;
BA_ "GenSigSendType" SG_ 66 ApproachReqData14 1;
BA_ "GenSigSendType" SG_ 66 ApproachReqData15 1;
BA_ "GenSigSendType" SG_ 66 ApproachReqData16 1;
BA_ "GenSigSendType" SG_ 66 ApproachReqData2 1;
BA_ "GenSigSendType" SG_ 66 ApproachReqData3 1;
BA_ "GenSigSendType" SG_ 66 ApproachReqData4 1;
BA_ "GenSigSendType" SG_ 66 ApproachReqData5 1;
BA_ "GenSigSendType" SG_ 66 ApproachReqData6 1;
BA_ "GenSigSendType" SG_ 66 ApproachReqData7 1;
BA_ "GenSigSendType" SG_ 66 ApproachReqData8 1;
BA_ "GenSigSendType" SG_ 66 ApproachReqData9 1;
BA_ "GenSigSendType" SG_ 560 AudWarnActv 0;
BA_ "GenSigSendType" SG_ 368 AutEgyRgnLvlSet 0;
BA_ "GenSigStartValue" SG_ 368 AutEgyRgnLvlSet 3;
BA_ "GenSigSendType" SG_ 74 BLEKeySearchRespData1 1;
BA_ "GenSigSendType" SG_ 74 BLEKeySearchRespData10 1;
BA_ "GenSigSendType" SG_ 74 BLEKeySearchRespData11 1;
BA_ "GenSigSendType" SG_ 74 BLEKeySearchRespData12 1;
BA_ "GenSigSendType" SG_ 74 BLEKeySearchRespData13 1;
BA_ "GenSigSendType" SG_ 74 BLEKeySearchRespData14 1;
BA_ "GenSigSendType" SG_ 74 BLEKeySearchRespData15 1;
BA_ "GenSigSendType" SG_ 74 BLEKeySearchRespData16 1;
BA_ "GenSigSendType" SG_ 74 BLEKeySearchRespData2 1;
BA_ "GenSigSendType" SG_ 74 BLEKeySearchRespData3 1;
BA_ "GenSigSendType" SG_ 74 BLEKeySearchRespData4 1;
BA_ "GenSigSendType" SG_ 74 BLEKeySearchRespData5 1;
BA_ "GenSigSendType" SG_ 74 BLEKeySearchRespData6 1;
BA_ "GenSigSendType" SG_ 74 BLEKeySearchRespData7 1;
BA_ "GenSigSendType" SG_ 74 BLEKeySearchRespData8 1;
BA_ "GenSigSendType" SG_ 74 BLEKeySearchRespData9 1;
BA_ "GenSigSendType" SG_ 464 BackRestSideSpprtAdjmtRowFirstDrvr 0;
BA_ "GenSigSendType" SG_ 464 BackRestSideSpprtAdjmtRowFirstPass 0;
BA_ "GenSigSendType" SG_ 560 BevPwrCtrl 0;
BA_ "GenSigSendType" SG_ 272 BookTrvlClimaActvReq 1;
BA_ "GenSigSendType" SG_ 272 CarFindrHornLiReqFromTelm 1;
BA_ "GenSigSendType" SG_ 1168 CarSharingMde 0;
BA_ "GenSigSendType" SG_ 272 CbnOverHeatProtnEnaFromTelm 1;
BA_ "GenSigSendType" SG_ 272 ChrgLidTelmLockgReq 1;
BA_ "GenSigSendType" SG_ 272 ClimaRqrd1 1;
BA_ "GenSigSendType" SG_ 272 ClimaTmrStsTelmRqrd 1;
BA_ "GenSigSendType" SG_ 80 CnclBookTrvlReq 1;
BA_ "GenSigSendType" SG_ 259 ConfCurrSpd 0;
BA_ "GenSigSendType" SG_ 259 ConfPath 0;
BA_ "GenSigSendType" SG_ 560 CopilotSeatOccupySts 0;
BA_ "GenSigSendType" SG_ 464 CushSideSpprtAdjmtRowFirstDrvr 0;
BA_ "GenSigSendType" SG_ 464 CushSideSpprtAdjmtRowFirstPass 0;
BA_ "GenSigSendType" SG_ 66 DChaEngStsCtrl 1;
BA_ "GenSigSendType" SG_ 80 DKDataFromTelmAcknowledgment 1;
BA_ "GenSigSendType" SG_ 80 DKDataFromTelmDKDataByte1 1;
BA_ "GenSigSendType" SG_ 80 DKDataFromTelmDKDataByte2 1;
BA_ "GenSigSendType" SG_ 80 DKDataFromTelmDKDataByte3 1;
BA_ "GenSigSendType" SG_ 80 DKDataFromTelmDKDataByte4 1;
BA_ "GenSigSendType" SG_ 80 DKDataFromTelmDKDataByte5 1;
BA_ "GenSigSendType" SG_ 80 DKDataFromTelmDKDataByte6 1;
BA_ "GenSigSendType" SG_ 80 DKDataFromTelmHeader 1;
BA_ "GenSigSendType" SG_ 66 DchaChrgnTarVal 1;
BA_ "GenSigSendType" SG_ 259 DchrgnInSwtCtrl 0;
BA_ "GenSigSendType" SG_ 464 DiagcComActv 0;
BA_ "GenSigSendType" SG_ 464 DiagcExtCom 0;
BA_ "GenSigSendType" SG_ 560 DrvSeatOccupySts 0;
BA_ "GenSigSendType" SG_ 259 DrvrCrsCtrlFctDeactvnReq 0;
BA_ "GenSigSendType" SG_ 259 DrvrCrsCtrlFctReActvReq 0;
BA_ "GenSigSendType" SG_ 259 DrvrCrsCtrlFctSeld 0;
BA_ "GenSigSendType" SG_ 560 DrvrHdPosnDetnX 0;
BA_ "GenSigSendType" SG_ 560 DrvrHdPosnDetnY 0;
BA_ "GenSigSendType" SG_ 560 DrvrHdPosnDetnZ 0;
BA_ "GenSigSendType" SG_ 464 DrvrSeatDispMassgFctMassgInten 0;
BA_ "GenSigSendType" SG_ 464 DrvrSeatDispMassgFctMassgProg 0;
BA_ "GenSigSendType" SG_ 464 DrvrSeatDispMassgFctOnOffl2 0;
BA_ "GenSigStartValue" SG_ 464 DrvrSeatDispMassgFctOnOffl2 2;
BA_ "GenSigSendType" SG_ 464 DrvrSeatDispSpplFct 0;
BA_ "GenSigSendType" SG_ 66 DstFromDestination 1;
BA_ "GenSigSendType" SG_ 99 DwnLoadDynLtgPrmForFrntRIGrp10ContinueTime 1;
BA_ "GenSigSendType" SG_ 99 DwnLoadDynLtgPrmForFrntRIGrp10HighBrightness 1;
BA_ "GenSigSendType" SG_ 99 DwnLoadDynLtgPrmForFrntRIGrp10LowBrightness 1;
BA_ "GenSigSendType" SG_ 99 DwnLoadDynLtgPrmForFrntRIGrp10Mode1 1;
BA_ "GenSigSendType" SG_ 99 DwnLoadDynLtgPrmForFrntRIGrp10OffsetTime 1;
BA_ "GenSigSendType" SG_ 99 DwnLoadDynLtgPrmForFrntRIGrp10Timestamp 1;
BA_ "GenSigSendType" SG_ 99 DwnLoadDynLtgPrmForFrntRIGrp11ContinueTime 1;
BA_ "GenSigSendType" SG_ 99 DwnLoadDynLtgPrmForFrntRIGrp11HighBrightness 1;
BA_ "GenSigSendType" SG_ 99 DwnLoadDynLtgPrmForFrntRIGrp11LowBrightness 1;
BA_ "GenSigSendType" SG_ 99 DwnLoadDynLtgPrmForFrntRIGrp11Mode1 1;
BA_ "GenSigSendType" SG_ 99 DwnLoadDynLtgPrmForFrntRIGrp11OffsetTime 1;
BA_ "GenSigSendType" SG_ 99 DwnLoadDynLtgPrmForFrntRIGrp11Timestamp 1;
BA_ "GenSigSendType" SG_ 99 DwnLoadDynLtgPrmForFrntRIGrp12ContinueTime 1;
BA_ "GenSigSendType" SG_ 99 DwnLoadDynLtgPrmForFrntRIGrp12HighBrightness 1;
BA_ "GenSigSendType" SG_ 99 DwnLoadDynLtgPrmForFrntRIGrp12LowBrightness 1;
BA_ "GenSigSendType" SG_ 99 DwnLoadDynLtgPrmForFrntRIGrp12Mode1 1;
BA_ "GenSigSendType" SG_ 99 DwnLoadDynLtgPrmForFrntRIGrp12OffsetTime 1;
BA_ "GenSigSendType" SG_ 99 DwnLoadDynLtgPrmForFrntRIGrp12Timestamp 1;
BA_ "GenSigSendType" SG_ 103 DwnLoadDynLtgPrmForFrntRIGrp13ContinueTime 1;
BA_ "GenSigSendType" SG_ 103 DwnLoadDynLtgPrmForFrntRIGrp13HighBrightness 1;
BA_ "GenSigSendType" SG_ 103 DwnLoadDynLtgPrmForFrntRIGrp13LowBrightness 1;
BA_ "GenSigSendType" SG_ 103 DwnLoadDynLtgPrmForFrntRIGrp13Mode1 1;
BA_ "GenSigSendType" SG_ 103 DwnLoadDynLtgPrmForFrntRIGrp13OffsetTime 1;
BA_ "GenSigSendType" SG_ 103 DwnLoadDynLtgPrmForFrntRIGrp13Timestamp 1;
BA_ "GenSigSendType" SG_ 103 DwnLoadDynLtgPrmForFrntRIGrp14ContinueTime 1;
BA_ "GenSigSendType" SG_ 103 DwnLoadDynLtgPrmForFrntRIGrp14HighBrightness 1;
BA_ "GenSigSendType" SG_ 103 DwnLoadDynLtgPrmForFrntRIGrp14LowBrightness 1;
BA_ "GenSigSendType" SG_ 103 DwnLoadDynLtgPrmForFrntRIGrp14Mode1 1;
BA_ "GenSigSendType" SG_ 103 DwnLoadDynLtgPrmForFrntRIGrp14OffsetTime 1;
BA_ "GenSigSendType" SG_ 103 DwnLoadDynLtgPrmForFrntRIGrp14Timestamp 1;
BA_ "GenSigSendType" SG_ 103 DwnLoadDynLtgPrmForFrntRIGrp15ContinueTime 1;
BA_ "GenSigSendType" SG_ 103 DwnLoadDynLtgPrmForFrntRIGrp15HighBrightness 1;
BA_ "GenSigSendType" SG_ 103 DwnLoadDynLtgPrmForFrntRIGrp15LowBrightness 1;
BA_ "GenSigSendType" SG_ 103 DwnLoadDynLtgPrmForFrntRIGrp15Mode1 1;
BA_ "GenSigSendType" SG_ 103 DwnLoadDynLtgPrmForFrntRIGrp15OffsetTime 1;
BA_ "GenSigSendType" SG_ 103 DwnLoadDynLtgPrmForFrntRIGrp15Timestamp 1;
BA_ "GenSigSendType" SG_ 103 DwnLoadDynLtgPrmForFrntRIGrp16ContinueTime 1;
BA_ "GenSigSendType" SG_ 103 DwnLoadDynLtgPrmForFrntRIGrp16HighBrightness 1;
BA_ "GenSigSendType" SG_ 103 DwnLoadDynLtgPrmForFrntRIGrp16LowBrightness 1;
BA_ "GenSigSendType" SG_ 103 DwnLoadDynLtgPrmForFrntRIGrp16Mode1 1;
BA_ "GenSigSendType" SG_ 103 DwnLoadDynLtgPrmForFrntRIGrp16OffsetTime 1;
BA_ "GenSigSendType" SG_ 103 DwnLoadDynLtgPrmForFrntRIGrp16Timestamp 1;
BA_ "GenSigSendType" SG_ 103 DwnLoadDynLtgPrmForFrntRIGrp17ContinueTime 1;
BA_ "GenSigSendType" SG_ 103 DwnLoadDynLtgPrmForFrntRIGrp17HighBrightness 1;
BA_ "GenSigSendType" SG_ 103 DwnLoadDynLtgPrmForFrntRIGrp17LowBrightness 1;
BA_ "GenSigSendType" SG_ 103 DwnLoadDynLtgPrmForFrntRIGrp17Mode1 1;
BA_ "GenSigSendType" SG_ 103 DwnLoadDynLtgPrmForFrntRIGrp17OffsetTime 1;
BA_ "GenSigSendType" SG_ 103 DwnLoadDynLtgPrmForFrntRIGrp17Timestamp 1;
BA_ "GenSigSendType" SG_ 103 DwnLoadDynLtgPrmForFrntRIGrp18ContinueTime 1;
BA_ "GenSigSendType" SG_ 103 DwnLoadDynLtgPrmForFrntRIGrp18HighBrightness 1;
BA_ "GenSigSendType" SG_ 103 DwnLoadDynLtgPrmForFrntRIGrp18LowBrightness 1;
BA_ "GenSigSendType" SG_ 103 DwnLoadDynLtgPrmForFrntRIGrp18Mode1 1;
BA_ "GenSigSendType" SG_ 103 DwnLoadDynLtgPrmForFrntRIGrp18OffsetTime 1;
BA_ "GenSigSendType" SG_ 103 DwnLoadDynLtgPrmForFrntRIGrp18Timestamp 1;
BA_ "GenSigSendType" SG_ 103 DwnLoadDynLtgPrmForFrntRIGrp19ContinueTime 1;
BA_ "GenSigSendType" SG_ 103 DwnLoadDynLtgPrmForFrntRIGrp19HighBrightness 1;
BA_ "GenSigSendType" SG_ 103 DwnLoadDynLtgPrmForFrntRIGrp19LowBrightness 1;
BA_ "GenSigSendType" SG_ 103 DwnLoadDynLtgPrmForFrntRIGrp19Mode1 1;
BA_ "GenSigSendType" SG_ 103 DwnLoadDynLtgPrmForFrntRIGrp19OffsetTime 1;
BA_ "GenSigSendType" SG_ 103 DwnLoadDynLtgPrmForFrntRIGrp19Timestamp 1;
BA_ "GenSigSendType" SG_ 99 DwnLoadDynLtgPrmForFrntRIGrp1ContinueTime 1;
BA_ "GenSigSendType" SG_ 99 DwnLoadDynLtgPrmForFrntRIGrp1HighBrightness 1;
BA_ "GenSigSendType" SG_ 99 DwnLoadDynLtgPrmForFrntRIGrp1LowBrightness 1;
BA_ "GenSigSendType" SG_ 99 DwnLoadDynLtgPrmForFrntRIGrp1Mode1 1;
BA_ "GenSigSendType" SG_ 99 DwnLoadDynLtgPrmForFrntRIGrp1OffsetTime 1;
BA_ "GenSigSendType" SG_ 99 DwnLoadDynLtgPrmForFrntRIGrp1Timestamp 1;
BA_ "GenSigSendType" SG_ 103 DwnLoadDynLtgPrmForFrntRIGrp20ContinueTime 1;
BA_ "GenSigSendType" SG_ 103 DwnLoadDynLtgPrmForFrntRIGrp20HighBrightness 1;
BA_ "GenSigSendType" SG_ 103 DwnLoadDynLtgPrmForFrntRIGrp20LowBrightness 1;
BA_ "GenSigSendType" SG_ 103 DwnLoadDynLtgPrmForFrntRIGrp20Mode1 1;
BA_ "GenSigSendType" SG_ 103 DwnLoadDynLtgPrmForFrntRIGrp20OffsetTime 1;
BA_ "GenSigSendType" SG_ 103 DwnLoadDynLtgPrmForFrntRIGrp20Timestamp 1;
BA_ "GenSigSendType" SG_ 103 DwnLoadDynLtgPrmForFrntRIGrp21ContinueTime 1;
BA_ "GenSigSendType" SG_ 103 DwnLoadDynLtgPrmForFrntRIGrp21HighBrightness 1;
BA_ "GenSigSendType" SG_ 103 DwnLoadDynLtgPrmForFrntRIGrp21LowBrightness 1;
BA_ "GenSigSendType" SG_ 103 DwnLoadDynLtgPrmForFrntRIGrp21Mode1 1;
BA_ "GenSigSendType" SG_ 103 DwnLoadDynLtgPrmForFrntRIGrp21OffsetTime 1;
BA_ "GenSigSendType" SG_ 103 DwnLoadDynLtgPrmForFrntRIGrp21Timestamp 1;
BA_ "GenSigSendType" SG_ 103 DwnLoadDynLtgPrmForFrntRIGrp22ContinueTime 1;
BA_ "GenSigSendType" SG_ 103 DwnLoadDynLtgPrmForFrntRIGrp22HighBrightness 1;
BA_ "GenSigSendType" SG_ 103 DwnLoadDynLtgPrmForFrntRIGrp22LowBrightness 1;
BA_ "GenSigSendType" SG_ 103 DwnLoadDynLtgPrmForFrntRIGrp22Mode1 1;
BA_ "GenSigSendType" SG_ 103 DwnLoadDynLtgPrmForFrntRIGrp22OffsetTime 1;
BA_ "GenSigSendType" SG_ 103 DwnLoadDynLtgPrmForFrntRIGrp22Timestamp 1;
BA_ "GenSigSendType" SG_ 103 DwnLoadDynLtgPrmForFrntRIGrp23ContinueTime 1;
BA_ "GenSigSendType" SG_ 103 DwnLoadDynLtgPrmForFrntRIGrp23HighBrightness 1;
BA_ "GenSigSendType" SG_ 103 DwnLoadDynLtgPrmForFrntRIGrp23LowBrightness 1;
BA_ "GenSigSendType" SG_ 103 DwnLoadDynLtgPrmForFrntRIGrp23Mode1 1;
BA_ "GenSigSendType" SG_ 103 DwnLoadDynLtgPrmForFrntRIGrp23OffsetTime 1;
BA_ "GenSigSendType" SG_ 103 DwnLoadDynLtgPrmForFrntRIGrp23Timestamp 1;
BA_ "GenSigSendType" SG_ 103 DwnLoadDynLtgPrmForFrntRIGrp24ContinueTime 1;
BA_ "GenSigSendType" SG_ 103 DwnLoadDynLtgPrmForFrntRIGrp24HighBrightness 1;
BA_ "GenSigSendType" SG_ 103 DwnLoadDynLtgPrmForFrntRIGrp24LowBrightness 1;
BA_ "GenSigSendType" SG_ 103 DwnLoadDynLtgPrmForFrntRIGrp24Mode1 1;
BA_ "GenSigSendType" SG_ 103 DwnLoadDynLtgPrmForFrntRIGrp24OffsetTime 1;
BA_ "GenSigSendType" SG_ 103 DwnLoadDynLtgPrmForFrntRIGrp24Timestamp 1;
BA_ "GenSigSendType" SG_ 99 DwnLoadDynLtgPrmForFrntRIGrp2ContinueTime 1;
BA_ "GenSigSendType" SG_ 99 DwnLoadDynLtgPrmForFrntRIGrp2HighBrightness 1;
BA_ "GenSigSendType" SG_ 99 DwnLoadDynLtgPrmForFrntRIGrp2LowBrightness 1;
BA_ "GenSigSendType" SG_ 99 DwnLoadDynLtgPrmForFrntRIGrp2Mode1 1;
BA_ "GenSigSendType" SG_ 99 DwnLoadDynLtgPrmForFrntRIGrp2OffsetTime 1;
BA_ "GenSigSendType" SG_ 99 DwnLoadDynLtgPrmForFrntRIGrp2Timestamp 1;
BA_ "GenSigSendType" SG_ 99 DwnLoadDynLtgPrmForFrntRIGrp3ContinueTime 1;
BA_ "GenSigSendType" SG_ 99 DwnLoadDynLtgPrmForFrntRIGrp3HighBrightness 1;
BA_ "GenSigSendType" SG_ 99 DwnLoadDynLtgPrmForFrntRIGrp3LowBrightness 1;
BA_ "GenSigSendType" SG_ 99 DwnLoadDynLtgPrmForFrntRIGrp3Mode1 1;
BA_ "GenSigSendType" SG_ 99 DwnLoadDynLtgPrmForFrntRIGrp3OffsetTime 1;
BA_ "GenSigSendType" SG_ 99 DwnLoadDynLtgPrmForFrntRIGrp3Timestamp 1;
BA_ "GenSigSendType" SG_ 99 DwnLoadDynLtgPrmForFrntRIGrp4ContinueTime 1;
BA_ "GenSigSendType" SG_ 99 DwnLoadDynLtgPrmForFrntRIGrp4HighBrightness 1;
BA_ "GenSigSendType" SG_ 99 DwnLoadDynLtgPrmForFrntRIGrp4LowBrightness 1;
BA_ "GenSigSendType" SG_ 99 DwnLoadDynLtgPrmForFrntRIGrp4Mode1 1;
BA_ "GenSigSendType" SG_ 99 DwnLoadDynLtgPrmForFrntRIGrp4OffsetTime 1;
BA_ "GenSigSendType" SG_ 99 DwnLoadDynLtgPrmForFrntRIGrp4Timestamp 1;
BA_ "GenSigSendType" SG_ 99 DwnLoadDynLtgPrmForFrntRIGrp5ContinueTime 1;
BA_ "GenSigSendType" SG_ 99 DwnLoadDynLtgPrmForFrntRIGrp5HighBrightness 1;
BA_ "GenSigSendType" SG_ 99 DwnLoadDynLtgPrmForFrntRIGrp5LowBrightness 1;
BA_ "GenSigSendType" SG_ 99 DwnLoadDynLtgPrmForFrntRIGrp5Mode1 1;
BA_ "GenSigSendType" SG_ 99 DwnLoadDynLtgPrmForFrntRIGrp5OffsetTime 1;
BA_ "GenSigSendType" SG_ 99 DwnLoadDynLtgPrmForFrntRIGrp5Timestamp 1;
BA_ "GenSigSendType" SG_ 99 DwnLoadDynLtgPrmForFrntRIGrp6ContinueTime 1;
BA_ "GenSigSendType" SG_ 99 DwnLoadDynLtgPrmForFrntRIGrp6HighBrightness 1;
BA_ "GenSigSendType" SG_ 99 DwnLoadDynLtgPrmForFrntRIGrp6LowBrightness 1;
BA_ "GenSigSendType" SG_ 99 DwnLoadDynLtgPrmForFrntRIGrp6Mode1 1;
BA_ "GenSigSendType" SG_ 99 DwnLoadDynLtgPrmForFrntRIGrp6OffsetTime 1;
BA_ "GenSigSendType" SG_ 99 DwnLoadDynLtgPrmForFrntRIGrp6Timestamp 1;
BA_ "GenSigSendType" SG_ 99 DwnLoadDynLtgPrmForFrntRIGrp7ContinueTime 1;
BA_ "GenSigSendType" SG_ 99 DwnLoadDynLtgPrmForFrntRIGrp7HighBrightness 1;
BA_ "GenSigSendType" SG_ 99 DwnLoadDynLtgPrmForFrntRIGrp7LowBrightness 1;
BA_ "GenSigSendType" SG_ 99 DwnLoadDynLtgPrmForFrntRIGrp7Mode1 1;
BA_ "GenSigSendType" SG_ 99 DwnLoadDynLtgPrmForFrntRIGrp7OffsetTime 1;
BA_ "GenSigSendType" SG_ 99 DwnLoadDynLtgPrmForFrntRIGrp7Timestamp 1;
BA_ "GenSigSendType" SG_ 99 DwnLoadDynLtgPrmForFrntRIGrp8ContinueTime 1;
BA_ "GenSigSendType" SG_ 99 DwnLoadDynLtgPrmForFrntRIGrp8HighBrightness 1;
BA_ "GenSigSendType" SG_ 99 DwnLoadDynLtgPrmForFrntRIGrp8LowBrightness 1;
BA_ "GenSigSendType" SG_ 99 DwnLoadDynLtgPrmForFrntRIGrp8Mode1 1;
BA_ "GenSigSendType" SG_ 99 DwnLoadDynLtgPrmForFrntRIGrp8OffsetTime 1;
BA_ "GenSigSendType" SG_ 99 DwnLoadDynLtgPrmForFrntRIGrp8Timestamp 1;
BA_ "GenSigSendType" SG_ 99 DwnLoadDynLtgPrmForFrntRIGrp9ContinueTime 1;
BA_ "GenSigSendType" SG_ 99 DwnLoadDynLtgPrmForFrntRIGrp9HighBrightness 1;
BA_ "GenSigSendType" SG_ 99 DwnLoadDynLtgPrmForFrntRIGrp9LowBrightness 1;
BA_ "GenSigSendType" SG_ 99 DwnLoadDynLtgPrmForFrntRIGrp9Mode1 1;
BA_ "GenSigSendType" SG_ 99 DwnLoadDynLtgPrmForFrntRIGrp9OffsetTime 1;
BA_ "GenSigSendType" SG_ 99 DwnLoadDynLtgPrmForFrntRIGrp9Timestamp 1;
BA_ "GenSigSendType" SG_ 259 EPedlModCtrlSt 0;
BA_ "GenSigSendType" SG_ 259 ESCLvlSwt 0;
BA_ "GenSigSendType" SG_ 272 EmgyAsscTrigSts 1;
BA_ "GenSigSendType" SG_ 272 EngForbidReqFromTelm 1;
BA_ "GenSigSendType" SG_ 272 EngPermitReqFromTelm 1;
BA_ "GenSigSendType" SG_ 80 ErsCmdRecErsCmd 1;
BA_ "GenSigSendType" SG_ 80 ErsCmdRecErsRunTime 1;
BA_ "GenSigSendType" SG_ 272 ExtrLiShowActvnReq 1;
BA_ "GenSigSendType" SG_ 272 ExtrLiShowFileTxReq 1;
BA_ "GenSigSendType" SG_ 311 ExtrMirrAdjHmiReq 0;
BA_ "GenSigSendType" SG_ 311 ExtrMirrFoldHmiReq 0;
BA_ "GenSigSendType" SG_ 311 ExtrMirrSelnHmiReq 0;
BA_ "GenSigSendType" SG_ 368 FaceRecognitionIndcrFromDHU 0;
BA_ "GenSigSendType" SG_ 259 FuLvlRawActvSideFuLvlValFromFuTbl 0;
BA_ "GenSigSendType" SG_ 259 FuLvlRawActvSideGenQF 0;
BA_ "GenSigSendType" SG_ 259 FuLvlRawPasSideFuLvlValFromFuTbl 0;
BA_ "GenSigSendType" SG_ 259 FuLvlRawPasSideGenQF 0;
BA_ "GenSigSendType" SG_ 368 GestureDetn 0;
BA_ "GenSigSendType" SG_ 560 HMIAirCdnrAutDrySet 0;
BA_ "GenSigStartValue" SG_ 560 HMIAirCdnrAutDrySet 1;
BA_ "GenSigSendType" SG_ 464 HMIIonizerAirCdnr 0;
BA_ "GenSigSendType" SG_ 259 HMISteplessBarPosnSetting 0;
BA_ "GenSigStartValue" SG_ 259 HMISteplessBarPosnSetting 50;
BA_ "GenSigSendType" SG_ 259 HMIThermoTankDlyCls 0;
BA_ "GenSigSendType" SG_ 259 HMIThermoTankDlyClsTmr 0;
BA_ "GenSigSendType" SG_ 66 HVPwrDwnRstReq 1;
BA_ "GenSigSendType" SG_ 311 HmiAC 0;
BA_ "GenSigSendType" SG_ 311 HmiElecFrntDefrstReq 0;
BA_ "GenSigSendType" SG_ 311 HmiElecReMirrDefrstReq 0;
BA_ "GenSigSendType" SG_ 311 HmiElecReWinDefrstReq 0;
BA_ "GenSigSendType" SG_ 259 HmiMaxEvMod 0;
BA_ "GenSigSendType" SG_ 560 HmiPM25PopUpSet 0;
BA_ "GenSigStartValue" SG_ 560 HmiPM25PopUpSet 1;
BA_ "GenSigSendType" SG_ 435 HznPosnLRCurrentLane 1;
BA_ "GenSigSendType" SG_ 435 HznPosnLRCyclicCounter 1;
BA_ "GenSigSendType" SG_ 435 HznPosnLRMessageType 1;
BA_ "GenSigStartValue" SG_ 435 HznPosnLRMessageType 1;
BA_ "GenSigSendType" SG_ 435 HznPosnLROffset 1;
BA_ "GenSigSendType" SG_ 435 HznPosnLRPathIndex 1;
BA_ "GenSigSendType" SG_ 435 HznPosnLRPositionAge 1;
BA_ "GenSigSendType" SG_ 435 HznPosnLRPositionConfidence 1;
BA_ "GenSigSendType" SG_ 435 HznPosnLRPositionIndex 1;
BA_ "GenSigSendType" SG_ 435 HznPosnLRPositionProbability 1;
BA_ "GenSigSendType" SG_ 435 HznPosnLRRelativeHeading 1;
BA_ "GenSigSendType" SG_ 435 HznPosnLRSpeed 1;
BA_ "GenSigSendType" SG_ 435 HznProfLongLRControlPoint 1;
BA_ "GenSigSendType" SG_ 435 HznProfLongLRCyclicCounter 1;
BA_ "GenSigSendType" SG_ 435 HznProfLongLRMessageType 1;
BA_ "GenSigStartValue" SG_ 435 HznProfLongLRMessageType 5;
BA_ "GenSigSendType" SG_ 435 HznProfLongLROffset 1;
BA_ "GenSigSendType" SG_ 435 HznProfLongLRPathIndex 1;
BA_ "GenSigSendType" SG_ 435 HznProfLongLRProfileType 1;
BA_ "GenSigSendType" SG_ 435 HznProfLongLRRetransmission 1;
BA_ "GenSigSendType" SG_ 435 HznProfLongLRUpdate 1;
BA_ "GenSigSendType" SG_ 435 HznProfLongLRValue 1;
BA_ "GenSigSendType" SG_ 259 IAMSMod 0;
BA_ "GenSigSendType" SG_ 311 IdleChrgCtrl 0;
BA_ "GenSigSendType" SG_ 259 KickTailgateSig 0;
BA_ "GenSigSendType" SG_ 368 LnchModSwt 0;
BA_ "GenSigSendType" SG_ 435 LocalBookChrgnTarVal 1;
BA_ "GenSigSendType" SG_ 1168 LongTiRunngModCampMod 0;
BA_ "GenSigSendType" SG_ 1168 LongTiRunngModGameMod 0;
BA_ "GenSigSendType" SG_ 1168 LongTiRunngModMonrbyOMS 0;
BA_ "GenSigSendType" SG_ 1168 LongTiRunngModPanelTouched 0;
BA_ "GenSigSendType" SG_ 1168 LongTiRunngModParkComfortMod 0;
BA_ "GenSigSendType" SG_ 1168 LongTiRunngModPetMod 0;
BA_ "GenSigSendType" SG_ 1168 LongTiRunngModReserved1 0;
BA_ "GenSigSendType" SG_ 1168 LongTiRunngModReserved2 0;
BA_ "GenSigSendType" SG_ 1168 LongTiRunngModReserved3 0;
BA_ "GenSigSendType" SG_ 1168 LongTiRunngModReserved4 0;
BA_ "GenSigSendType" SG_ 1168 LongTiRunngModReserved5 0;
BA_ "GenSigSendType" SG_ 1168 LongTiRunngModReserved6 0;
BA_ "GenSigSendType" SG_ 1168 LongTiRunngModReserved7 0;
BA_ "GenSigSendType" SG_ 1168 LongTiRunngModReserved8 0;
BA_ "GenSigSendType" SG_ 1168 LongTiRunngModRestMod 0;
BA_ "GenSigSendType" SG_ 1168 LongTiRunngModTheaterMod 0;
BA_ "GenSigSendType" SG_ 464 LumHeiAdjmtRowFirstDrvr 0;
BA_ "GenSigSendType" SG_ 464 LumHeiAdjmtRowFirstPass 0;
BA_ "GenSigSendType" SG_ 464 LumLenAdjmtRowFirstDrvr 0;
BA_ "GenSigSendType" SG_ 464 LumLenAdjmtRowFirstPass 0;
BA_ "GenSigSendType" SG_ 368 LvlgSwtSetReqChks 0;
BA_ "GenSigSendType" SG_ 368 LvlgSwtSetReqCntr 0;
BA_ "GenSigSendType" SG_ 368 LvlgSwtSetReqLvlgSwtSetReq 0;
BA_ "GenSigSendType" SG_ 435 MaxAcInpCurrentSet 1;
BA_ "GenSigSendType" SG_ 259 MirrTarPosnCmdReqDrvrMirrAdjLeRi 0;
BA_ "GenSigSendType" SG_ 259 MirrTarPosnCmdReqDrvrMirrAdjUpDwn 0;
BA_ "GenSigSendType" SG_ 259 MirrTarPosnCmdReqPassMirrAdjLeRi 0;
BA_ "GenSigSendType" SG_ 259 MirrTarPosnCmdReqPassMirrAdjUpDwn 0;
BA_ "GenSigSendType" SG_ 259 MirrTarPosnCmdReqTarPosnCmd1 0;
BA_ "GenSigSendType" SG_ 624 MmedHdPwrMod 0;
BA_ "GenSigSendType" SG_ 624 MobDevBtnPanicReq 0;
BA_ "GenSigSendType" SG_ 74 NFCAndBLEKeyEnaStsData1 1;
BA_ "GenSigSendType" SG_ 74 NFCAndBLEKeyEnaStsData10 1;
BA_ "GenSigSendType" SG_ 74 NFCAndBLEKeyEnaStsData11 1;
BA_ "GenSigSendType" SG_ 74 NFCAndBLEKeyEnaStsData12 1;
BA_ "GenSigSendType" SG_ 74 NFCAndBLEKeyEnaStsData13 1;
BA_ "GenSigSendType" SG_ 74 NFCAndBLEKeyEnaStsData14 1;
BA_ "GenSigSendType" SG_ 74 NFCAndBLEKeyEnaStsData15 1;
BA_ "GenSigSendType" SG_ 74 NFCAndBLEKeyEnaStsData16 1;
BA_ "GenSigSendType" SG_ 74 NFCAndBLEKeyEnaStsData2 1;
BA_ "GenSigSendType" SG_ 74 NFCAndBLEKeyEnaStsData3 1;
BA_ "GenSigSendType" SG_ 74 NFCAndBLEKeyEnaStsData4 1;
BA_ "GenSigSendType" SG_ 74 NFCAndBLEKeyEnaStsData5 1;
BA_ "GenSigSendType" SG_ 74 NFCAndBLEKeyEnaStsData6 1;
BA_ "GenSigSendType" SG_ 74 NFCAndBLEKeyEnaStsData7 1;
BA_ "GenSigSendType" SG_ 74 NFCAndBLEKeyEnaStsData8 1;
BA_ "GenSigSendType" SG_ 74 NFCAndBLEKeyEnaStsData9 1;
BA_ "GenSigSendType" SG_ 74 NFCKeySearchRespData1 1;
BA_ "GenSigSendType" SG_ 74 NFCKeySearchRespData10 1;
BA_ "GenSigSendType" SG_ 74 NFCKeySearchRespData11 1;
BA_ "GenSigSendType" SG_ 74 NFCKeySearchRespData12 1;
BA_ "GenSigSendType" SG_ 74 NFCKeySearchRespData13 1;
BA_ "GenSigSendType" SG_ 74 NFCKeySearchRespData14 1;
BA_ "GenSigSendType" SG_ 74 NFCKeySearchRespData15 1;
BA_ "GenSigSendType" SG_ 74 NFCKeySearchRespData16 1;
BA_ "GenSigSendType" SG_ 74 NFCKeySearchRespData2 1;
BA_ "GenSigSendType" SG_ 74 NFCKeySearchRespData3 1;
BA_ "GenSigSendType" SG_ 74 NFCKeySearchRespData4 1;
BA_ "GenSigSendType" SG_ 74 NFCKeySearchRespData5 1;
BA_ "GenSigSendType" SG_ 74 NFCKeySearchRespData6 1;
BA_ "GenSigSendType" SG_ 74 NFCKeySearchRespData7 1;
BA_ "GenSigSendType" SG_ 74 NFCKeySearchRespData8 1;
BA_ "GenSigSendType" SG_ 74 NFCKeySearchRespData9 1;
BA_ "GenSigSendType" SG_ 259 PasEntryEnaReq1 0;
BA_ "GenSigSendType" SG_ 464 PassSeatDispMassgFctMassgInten 0;
BA_ "GenSigSendType" SG_ 464 PassSeatDispMassgFctMassgProg 0;
BA_ "GenSigSendType" SG_ 464 PassSeatDispMassgFctOnOffl2 0;
BA_ "GenSigStartValue" SG_ 464 PassSeatDispMassgFctOnOffl2 2;
BA_ "GenSigSendType" SG_ 464 PassSeatDispSpplFct 0;
BA_ "GenSigSendType" SG_ 560 PassSideHdPosnDetnX 0;
BA_ "GenSigSendType" SG_ 560 PassSideHdPosnDetnY 0;
BA_ "GenSigSendType" SG_ 560 PassSideHdPosnDetnZ 0;
BA_ "GenSigSendType" SG_ 1168 PosnBriefPosnLat 0;
BA_ "GenSigStartValue" SG_ 1168 PosnBriefPosnLat 323999740.8002074;
BA_ "GenSigSendType" SG_ 1168 PosnBriefPosnLgt 0;
BA_ "GenSigStartValue" SG_ 1168 PosnBriefPosnLgt 647999481.6004148;
BA_ "GenSigSendType" SG_ 368 PrpsnMaxEvMod 0;
BA_ "GenSigStartValue" SG_ 368 PrpsnMaxEvMod 1;
BA_ "GenSigSendType" SG_ 311 PwrCnsAvgIndcdEcoDrvInfo1 0;
BA_ "GenSigSendType" SG_ 311 PwrCnsAvgIndcdPwrCnsUnit 0;
BA_ "GenSigSendType" SG_ 66 RKEAndNFCReqStsData1 1;
BA_ "GenSigSendType" SG_ 66 RKEAndNFCReqStsData10 1;
BA_ "GenSigSendType" SG_ 66 RKEAndNFCReqStsData11 1;
BA_ "GenSigSendType" SG_ 66 RKEAndNFCReqStsData12 1;
BA_ "GenSigSendType" SG_ 66 RKEAndNFCReqStsData13 1;
BA_ "GenSigSendType" SG_ 66 RKEAndNFCReqStsData14 1;
BA_ "GenSigSendType" SG_ 66 RKEAndNFCReqStsData15 1;
BA_ "GenSigSendType" SG_ 66 RKEAndNFCReqStsData16 1;
BA_ "GenSigSendType" SG_ 66 RKEAndNFCReqStsData2 1;
BA_ "GenSigSendType" SG_ 66 RKEAndNFCReqStsData3 1;
BA_ "GenSigSendType" SG_ 66 RKEAndNFCReqStsData4 1;
BA_ "GenSigSendType" SG_ 66 RKEAndNFCReqStsData5 1;
BA_ "GenSigSendType" SG_ 66 RKEAndNFCReqStsData6 1;
BA_ "GenSigSendType" SG_ 66 RKEAndNFCReqStsData7 1;
BA_ "GenSigSendType" SG_ 66 RKEAndNFCReqStsData8 1;
BA_ "GenSigSendType" SG_ 66 RKEAndNFCReqStsData9 1;
BA_ "GenSigSendType" SG_ 311 RadioFrqAM 0;
BA_ "GenSigSendType" SG_ 368 RainSnsrSnvtyHMIReq 0;
BA_ "GenSigStartValue" SG_ 368 RainSnsrSnvtyHMIReq 2;
BA_ "GenSigSendType" SG_ 66 ReadLiOpenReqFrontLeft 1;
BA_ "GenSigSendType" SG_ 66 ReadLiOpenReqFrontRight 1;
BA_ "GenSigSendType" SG_ 66 ReadLiOpenReqSecondRowLeft 1;
BA_ "GenSigSendType" SG_ 66 ReadLiOpenReqSecondRowRight 1;
BA_ "GenSigSendType" SG_ 66 ReadLiOpenReqThirdRowLeft 1;
BA_ "GenSigSendType" SG_ 66 ReadLiOpenReqThirdRowRight 1;
BA_ "GenSigSendType" SG_ 66 RemBookChrgnTarVal 1;
BA_ "GenSigSendType" SG_ 259 RemHvStrtActvReq 0;
BA_ "GenSigSendType" SG_ 259 RoadCondDis 0;
BA_ "GenSigSendType" SG_ 259 RoadCondLvl 0;
BA_ "GenSigSendType" SG_ 259 RoadCondNum 0;
BA_ "GenSigSendType" SG_ 259 RoadCondTime 0;
BA_ "GenSigSendType" SG_ 259 RoadSlope 0;
BA_ "GenSigSendType" SG_ 259 RoadSlopeDis 0;
BA_ "GenSigSendType" SG_ 259 RoadSlopeNum 0;
BA_ "GenSigSendType" SG_ 311 RstTrip1 0;
BA_ "GenSigSendType" SG_ 311 RstTrip2 0;
BA_ "GenSigSendType" SG_ 311 SaveSetgToMemPrmnt 0;
BA_ "GenSigSendType" SG_ 368 SecLeSeatTarPosnCmdReqSeatBackrTargPosAg 0;
BA_ "GenSigStartValue" SG_ 368 SecLeSeatTarPosnCmdReqSeatBackrTargPosAg 115;
BA_ "GenSigSendType" SG_ 368 SecLeSeatTarPosnCmdReqSeatFrntExtenTargPosPerc 0;
BA_ "GenSigSendType" SG_ 368 SecLeSeatTarPosnCmdReqSeatFrntHeiTargPosPerc 0;
BA_ "GenSigSendType" SG_ 368 SecLeSeatTarPosnCmdReqSeatLenTargPosPerc 0;
BA_ "GenSigStartValue" SG_ 368 SecLeSeatTarPosnCmdReqSeatLenTargPosPerc 300;
BA_ "GenSigSendType" SG_ 368 SecLeSeatTarPosnCmdReqTarPosnCmd1 0;
BA_ "GenSigSendType" SG_ 368 SecRiSeatTarPosnCmdReqSeatBackrTargPosAg 0;
BA_ "GenSigStartValue" SG_ 368 SecRiSeatTarPosnCmdReqSeatBackrTargPosAg 115;
BA_ "GenSigSendType" SG_ 368 SecRiSeatTarPosnCmdReqSeatFrntExtenTargPosPerc 0;
BA_ "GenSigSendType" SG_ 368 SecRiSeatTarPosnCmdReqSeatFrntHeiTargPosPerc 0;
BA_ "GenSigSendType" SG_ 368 SecRiSeatTarPosnCmdReqSeatLenTargPosPerc 0;
BA_ "GenSigStartValue" SG_ 368 SecRiSeatTarPosnCmdReqSeatLenTargPosPerc 300;
BA_ "GenSigSendType" SG_ 368 SecRiSeatTarPosnCmdReqTarPosnCmd1 0;
BA_ "GenSigSendType" SG_ 435 ShowTypOfDTESet 1;
BA_ "GenSigSendType" SG_ 560 SteerSetgPen 0;
BA_ "GenSigSendType" SG_ 560 SteerSetgSteerAsscLvl 0;
BA_ "GenSigSendType" SG_ 560 SteerSetgSteerMod 0;
BA_ "GenSigSendType" SG_ 464 SteerWhlHeatngAutStrtReq 0;
BA_ "GenSigSendType" SG_ 464 SunCurtCtrlReq 0;
BA_ "GenSigSendType" SG_ 311 SunRoofAndCurtIninSwt 0;
BA_ "GenSigSendType" SG_ 464 SunRoofCtrlReq 0;
BA_ "GenSigSendType" SG_ 464 TelmBookChrgnTyp 0;
BA_ "GenSigSendType" SG_ 103 TelmBookClimaReqHmiCmptmtTSpSpcl 1;
BA_ "GenSigSendType" SG_ 103 TelmBookClimaReqOnOffNoReq 1;
BA_ "GenSigSendType" SG_ 103 TelmBookClimaReqTempRange 1;
BA_ "GenSigSendType" SG_ 99 TelmBookSeatHeatClimalReqDrvHeatClimaLvl 1;
BA_ "GenSigSendType" SG_ 99 TelmBookSeatHeatClimalReqPassHeatClimaLvl 1;
BA_ "GenSigSendType" SG_ 99 TelmBookSeatHeatClimalReqSecLeHeatClimaLvl 1;
BA_ "GenSigSendType" SG_ 99 TelmBookSeatHeatClimalReqSecRiHeatClimaLvl 1;
BA_ "GenSigSendType" SG_ 99 TelmBookSeatHeatClimalReqThrdLeHeatClimaLvl 1;
BA_ "GenSigSendType" SG_ 99 TelmBookSeatHeatClimalReqThrdRiHeatClimaLvl 1;
BA_ "GenSigSendType" SG_ 99 TelmBookSeatVentnClimalReqDrvVentnClimaLvl 1;
BA_ "GenSigSendType" SG_ 99 TelmBookSeatVentnClimalReqPassVentnClimaLvl 1;
BA_ "GenSigSendType" SG_ 99 TelmBookSeatVentnClimalReqSecLeVentnClimaLvl 1;
BA_ "GenSigSendType" SG_ 99 TelmBookSeatVentnClimalReqSecRiVentnClimaLvl 1;
BA_ "GenSigSendType" SG_ 99 TelmBookSeatVentnClimalReqThrdLeVentnClimaLvl 1;
BA_ "GenSigSendType" SG_ 99 TelmBookSeatVentnClimalReqThrdRiVentnClimaL 1;
BA_ "GenSigSendType" SG_ 99 TelmClimaTSetHmiCmptmtTSpSpcl 1;
BA_ "GenSigSendType" SG_ 99 TelmClimaTSetTempRange 1;
BA_ "GenSigSendType" SG_ 259 TelmClimaTmr 1;
BA_ "GenSigSendType" SG_ 103 TelmEngDelayTi 1;
BA_ "GenSigSendType" SG_ 99 TelmStrtEngForChrgnReq 1;
BA_ "GenSigSendType" SG_ 272 TelmThermoTankReq1 1;
BA_ "GenSigSendType" SG_ 272 TelmThermoTankT 1;
BA_ "GenSigStartValue" SG_ 272 TelmThermoTankT 50;
BA_ "GenSigSendType" SG_ 272 TelmThermoTankTmr1 1;
BA_ "GenSigSendType" SG_ 66 TopPosTrFromHmi 1;
BA_ "GenSigSendType" SG_ 259 TotDstTrvld 0;
BA_ "GenSigSendType" SG_ 311 TrunkOpenHmiReq 0;
BA_ "GenSigSendType" SG_ 1168 UnlckRemReq 0;
BA_ "GenSigSendType" SG_ 66 UsrSpeechSts 1;
BA_ "GenSigSendType" SG_ 66 WinOpenAppReqWinOpenClsGlbSts 1;
BA_ "GenSigSendType" SG_ 66 WinOpenAppReqWindowOpenValue 1;
BA_ "GenSigSendType" SG_ 103 WinOpenClsGlbReqFromTelmWinOpenClsGlbSts 1;
BA_ "GenSigSendType" SG_ 103 WinOpenClsGlbReqFromTelmWindowOpenValue 1;
BA_ "GenSigSendType" SG_ 311 WinOpenDrvrReq 0;
BA_ "GenSigSendType" SG_ 311 WinOpenPassReq 0;
BA_ "GenSigSendType" SG_ 311 WinOpenReLeReq 0;
BA_ "GenSigSendType" SG_ 311 WinOpenReRiReq 0;
BA_ "GenSigSendType" SG_ 560 WiprReAutReq 0;
BA_ "GenSigSendType" SG_ 464 WirelschrgActvReqFromHmi 0;
BA_ "GenSigSendType" SG_ 311 Zone1SettingsBlue 0;
BA_ "GenSigSendType" SG_ 311 Zone1SettingsGreen 0;
BA_ "GenSigSendType" SG_ 311 Zone1SettingsIntensity 0;
BA_ "GenSigSendType" SG_ 311 Zone1SettingsRed 0;
BA_ "GenSigSendType" SG_ 311 Zone1SettingsZoneStatus 0;
BA_ "GenSigSendType" SG_ 311 Zone2SettingsBlue 0;
BA_ "GenSigSendType" SG_ 311 Zone2SettingsGreen 0;
BA_ "GenSigSendType" SG_ 311 Zone2SettingsIntensity 0;
BA_ "GenSigSendType" SG_ 311 Zone2SettingsRed 0;
BA_ "GenSigSendType" SG_ 311 Zone2SettingsZoneStatus 0;
BA_ "GenSigSendType" SG_ 311 Zone3SettingsBlue 0;
BA_ "GenSigSendType" SG_ 311 Zone3SettingsGreen 0;
BA_ "GenSigSendType" SG_ 311 Zone3SettingsIntensity 0;
BA_ "GenSigSendType" SG_ 311 Zone3SettingsRed 0;
BA_ "GenSigSendType" SG_ 311 Zone3SettingsZoneStatus 0;
VAL_ 99 DwnLoadDynLtgPrmForFrntRIGrp10Mode1 0 "Mode4_Off" 1 "Mode4_On" 2 "Mode4_GradualOn" 3 "Mode4_GradualOff" 4 "Mode4_ForwardWipingOn" 5 "Mode4_BackwardWipingOn" 6 "Mode4_OutwardWipingOn" 7 "Mode4_InwardWipingOn" 8 "Mode4_ForwardWipingOff" 9 "Mode4_BackwardWipingOff" 10 "Mode4_OutwardWipingOff" 11 "Mode4_InwardWipingOff" 12 "Mode4_ForwardScanning" 13 "Mode4_BackwardScanning" 14 "Mode4_BreathOn" 15 "Mode4_BreathOff" 16 "Mode4_1stHalfONand2ndHalfOFF" 17 "Mode4_HalfOFFHalfON" 18 "Mode4_HalfDimmingONHalfOFF" 19 "Mode4_HalfDimmingONHalfON" 20 "Mode4_HalfOFFHalfDimmingON" 21 "Mode4_HalfONHalfDimmingON" 22 "Mode4_HalfDimmingOFFHalfOFF" 23 "Mode4_HalfDimmingOFFHalfON" 24 "Mode4_HalfOFFHalfDimmingOFF" 25 "Mode4_HalfONHalfDimmingOFF" 26 "Mode4_SingleOn1" 27 "Mode4_SingleOn2" 28 "Mode4_SingleOn3" 29 "Mode4_SingleOn4" 30 "Mode4_SingleOn5" 31 "Mode4_SingleOn6" 32 "Mode4_SingleOn7" 33 "Mode4_SingleOn8" 34 "Mode4_SingleOn9" 35 "Mode4_SingleOn10" 36 "Mode4_SingleOn11" 37 "Mode4_SingleOn12" 38 "Mode4_SingleOff1" 39 "Mode4_SingleOff2" 40 "Mode4_SingleOff3" 41 "Mode4_SingleOff4" 42 "Mode4_SingleOff5" 43 "Mode4_SingleOff6" 44 "Mode4_SingleOff7" 45 "Mode4_SingleOff8" 46 "Mode4_SingleOff9" 47 "Mode4_SingleOff10" 48 "Mode4_SingleOff11" 49 "Mode4_SingleOff12";
VAL_ 99 DwnLoadDynLtgPrmForFrntRIGrp11Mode1 0 "Mode4_Off" 1 "Mode4_On" 2 "Mode4_GradualOn" 3 "Mode4_GradualOff" 4 "Mode4_ForwardWipingOn" 5 "Mode4_BackwardWipingOn" 6 "Mode4_OutwardWipingOn" 7 "Mode4_InwardWipingOn" 8 "Mode4_ForwardWipingOff" 9 "Mode4_BackwardWipingOff" 10 "Mode4_OutwardWipingOff" 11 "Mode4_InwardWipingOff" 12 "Mode4_ForwardScanning" 13 "Mode4_BackwardScanning" 14 "Mode4_BreathOn" 15 "Mode4_BreathOff" 16 "Mode4_1stHalfONand2ndHalfOFF" 17 "Mode4_HalfOFFHalfON" 18 "Mode4_HalfDimmingONHalfOFF" 19 "Mode4_HalfDimmingONHalfON" 20 "Mode4_HalfOFFHalfDimmingON" 21 "Mode4_HalfONHalfDimmingON" 22 "Mode4_HalfDimmingOFFHalfOFF" 23 "Mode4_HalfDimmingOFFHalfON" 24 "Mode4_HalfOFFHalfDimmingOFF" 25 "Mode4_HalfONHalfDimmingOFF" 26 "Mode4_SingleOn1" 27 "Mode4_SingleOn2" 28 "Mode4_SingleOn3" 29 "Mode4_SingleOn4" 30 "Mode4_SingleOn5" 31 "Mode4_SingleOn6" 32 "Mode4_SingleOn7" 33 "Mode4_SingleOn8" 34 "Mode4_SingleOn9" 35 "Mode4_SingleOn10" 36 "Mode4_SingleOn11" 37 "Mode4_SingleOn12" 38 "Mode4_SingleOff1" 39 "Mode4_SingleOff2" 40 "Mode4_SingleOff3" 41 "Mode4_SingleOff4" 42 "Mode4_SingleOff5" 43 "Mode4_SingleOff6" 44 "Mode4_SingleOff7" 45 "Mode4_SingleOff8" 46 "Mode4_SingleOff9" 47 "Mode4_SingleOff10" 48 "Mode4_SingleOff11" 49 "Mode4_SingleOff12";
VAL_ 99 DwnLoadDynLtgPrmForFrntRIGrp12Mode1 0 "Mode4_Off" 1 "Mode4_On" 2 "Mode4_GradualOn" 3 "Mode4_GradualOff" 4 "Mode4_ForwardWipingOn" 5 "Mode4_BackwardWipingOn" 6 "Mode4_OutwardWipingOn" 7 "Mode4_InwardWipingOn" 8 "Mode4_ForwardWipingOff" 9 "Mode4_BackwardWipingOff" 10 "Mode4_OutwardWipingOff" 11 "Mode4_InwardWipingOff" 12 "Mode4_ForwardScanning" 13 "Mode4_BackwardScanning" 14 "Mode4_BreathOn" 15 "Mode4_BreathOff" 16 "Mode4_1stHalfONand2ndHalfOFF" 17 "Mode4_HalfOFFHalfON" 18 "Mode4_HalfDimmingONHalfOFF" 19 "Mode4_HalfDimmingONHalfON" 20 "Mode4_HalfOFFHalfDimmingON" 21 "Mode4_HalfONHalfDimmingON" 22 "Mode4_HalfDimmingOFFHalfOFF" 23 "Mode4_HalfDimmingOFFHalfON" 24 "Mode4_HalfOFFHalfDimmingOFF" 25 "Mode4_HalfONHalfDimmingOFF" 26 "Mode4_SingleOn1" 27 "Mode4_SingleOn2" 28 "Mode4_SingleOn3" 29 "Mode4_SingleOn4" 30 "Mode4_SingleOn5" 31 "Mode4_SingleOn6" 32 "Mode4_SingleOn7" 33 "Mode4_SingleOn8" 34 "Mode4_SingleOn9" 35 "Mode4_SingleOn10" 36 "Mode4_SingleOn11" 37 "Mode4_SingleOn12" 38 "Mode4_SingleOff1" 39 "Mode4_SingleOff2" 40 "Mode4_SingleOff3" 41 "Mode4_SingleOff4" 42 "Mode4_SingleOff5" 43 "Mode4_SingleOff6" 44 "Mode4_SingleOff7" 45 "Mode4_SingleOff8" 46 "Mode4_SingleOff9" 47 "Mode4_SingleOff10" 48 "Mode4_SingleOff11" 49 "Mode4_SingleOff12";
VAL_ 99 DwnLoadDynLtgPrmForFrntRIGrp1Mode1 0 "Mode4_Off" 1 "Mode4_On" 2 "Mode4_GradualOn" 3 "Mode4_GradualOff" 4 "Mode4_ForwardWipingOn" 5 "Mode4_BackwardWipingOn" 6 "Mode4_OutwardWipingOn" 7 "Mode4_InwardWipingOn" 8 "Mode4_ForwardWipingOff" 9 "Mode4_BackwardWipingOff" 10 "Mode4_OutwardWipingOff" 11 "Mode4_InwardWipingOff" 12 "Mode4_ForwardScanning" 13 "Mode4_BackwardScanning" 14 "Mode4_BreathOn" 15 "Mode4_BreathOff" 16 "Mode4_1stHalfONand2ndHalfOFF" 17 "Mode4_HalfOFFHalfON" 18 "Mode4_HalfDimmingONHalfOFF" 19 "Mode4_HalfDimmingONHalfON" 20 "Mode4_HalfOFFHalfDimmingON" 21 "Mode4_HalfONHalfDimmingON" 22 "Mode4_HalfDimmingOFFHalfOFF" 23 "Mode4_HalfDimmingOFFHalfON" 24 "Mode4_HalfOFFHalfDimmingOFF" 25 "Mode4_HalfONHalfDimmingOFF" 26 "Mode4_SingleOn1" 27 "Mode4_SingleOn2" 28 "Mode4_SingleOn3" 29 "Mode4_SingleOn4" 30 "Mode4_SingleOn5" 31 "Mode4_SingleOn6" 32 "Mode4_SingleOn7" 33 "Mode4_SingleOn8" 34 "Mode4_SingleOn9" 35 "Mode4_SingleOn10" 36 "Mode4_SingleOn11" 37 "Mode4_SingleOn12" 38 "Mode4_SingleOff1" 39 "Mode4_SingleOff2" 40 "Mode4_SingleOff3" 41 "Mode4_SingleOff4" 42 "Mode4_SingleOff5" 43 "Mode4_SingleOff6" 44 "Mode4_SingleOff7" 45 "Mode4_SingleOff8" 46 "Mode4_SingleOff9" 47 "Mode4_SingleOff10" 48 "Mode4_SingleOff11" 49 "Mode4_SingleOff12";
VAL_ 99 DwnLoadDynLtgPrmForFrntRIGrp2Mode1 0 "Mode4_Off" 1 "Mode4_On" 2 "Mode4_GradualOn" 3 "Mode4_GradualOff" 4 "Mode4_ForwardWipingOn" 5 "Mode4_BackwardWipingOn" 6 "Mode4_OutwardWipingOn" 7 "Mode4_InwardWipingOn" 8 "Mode4_ForwardWipingOff" 9 "Mode4_BackwardWipingOff" 10 "Mode4_OutwardWipingOff" 11 "Mode4_InwardWipingOff" 12 "Mode4_ForwardScanning" 13 "Mode4_BackwardScanning" 14 "Mode4_BreathOn" 15 "Mode4_BreathOff" 16 "Mode4_1stHalfONand2ndHalfOFF" 17 "Mode4_HalfOFFHalfON" 18 "Mode4_HalfDimmingONHalfOFF" 19 "Mode4_HalfDimmingONHalfON" 20 "Mode4_HalfOFFHalfDimmingON" 21 "Mode4_HalfONHalfDimmingON" 22 "Mode4_HalfDimmingOFFHalfOFF" 23 "Mode4_HalfDimmingOFFHalfON" 24 "Mode4_HalfOFFHalfDimmingOFF" 25 "Mode4_HalfONHalfDimmingOFF" 26 "Mode4_SingleOn1" 27 "Mode4_SingleOn2" 28 "Mode4_SingleOn3" 29 "Mode4_SingleOn4" 30 "Mode4_SingleOn5" 31 "Mode4_SingleOn6" 32 "Mode4_SingleOn7" 33 "Mode4_SingleOn8" 34 "Mode4_SingleOn9" 35 "Mode4_SingleOn10" 36 "Mode4_SingleOn11" 37 "Mode4_SingleOn12" 38 "Mode4_SingleOff1" 39 "Mode4_SingleOff2" 40 "Mode4_SingleOff3" 41 "Mode4_SingleOff4" 42 "Mode4_SingleOff5" 43 "Mode4_SingleOff6" 44 "Mode4_SingleOff7" 45 "Mode4_SingleOff8" 46 "Mode4_SingleOff9" 47 "Mode4_SingleOff10" 48 "Mode4_SingleOff11" 49 "Mode4_SingleOff12";
VAL_ 99 DwnLoadDynLtgPrmForFrntRIGrp3Mode1 0 "Mode4_Off" 1 "Mode4_On" 2 "Mode4_GradualOn" 3 "Mode4_GradualOff" 4 "Mode4_ForwardWipingOn" 5 "Mode4_BackwardWipingOn" 6 "Mode4_OutwardWipingOn" 7 "Mode4_InwardWipingOn" 8 "Mode4_ForwardWipingOff" 9 "Mode4_BackwardWipingOff" 10 "Mode4_OutwardWipingOff" 11 "Mode4_InwardWipingOff" 12 "Mode4_ForwardScanning" 13 "Mode4_BackwardScanning" 14 "Mode4_BreathOn" 15 "Mode4_BreathOff" 16 "Mode4_1stHalfONand2ndHalfOFF" 17 "Mode4_HalfOFFHalfON" 18 "Mode4_HalfDimmingONHalfOFF" 19 "Mode4_HalfDimmingONHalfON" 20 "Mode4_HalfOFFHalfDimmingON" 21 "Mode4_HalfONHalfDimmingON" 22 "Mode4_HalfDimmingOFFHalfOFF" 23 "Mode4_HalfDimmingOFFHalfON" 24 "Mode4_HalfOFFHalfDimmingOFF" 25 "Mode4_HalfONHalfDimmingOFF" 26 "Mode4_SingleOn1" 27 "Mode4_SingleOn2" 28 "Mode4_SingleOn3" 29 "Mode4_SingleOn4" 30 "Mode4_SingleOn5" 31 "Mode4_SingleOn6" 32 "Mode4_SingleOn7" 33 "Mode4_SingleOn8" 34 "Mode4_SingleOn9" 35 "Mode4_SingleOn10" 36 "Mode4_SingleOn11" 37 "Mode4_SingleOn12" 38 "Mode4_SingleOff1" 39 "Mode4_SingleOff2" 40 "Mode4_SingleOff3" 41 "Mode4_SingleOff4" 42 "Mode4_SingleOff5" 43 "Mode4_SingleOff6" 44 "Mode4_SingleOff7" 45 "Mode4_SingleOff8" 46 "Mode4_SingleOff9" 47 "Mode4_SingleOff10" 48 "Mode4_SingleOff11" 49 "Mode4_SingleOff12";
VAL_ 99 DwnLoadDynLtgPrmForFrntRIGrp4Mode1 0 "Mode4_Off" 1 "Mode4_On" 2 "Mode4_GradualOn" 3 "Mode4_GradualOff" 4 "Mode4_ForwardWipingOn" 5 "Mode4_BackwardWipingOn" 6 "Mode4_OutwardWipingOn" 7 "Mode4_InwardWipingOn" 8 "Mode4_ForwardWipingOff" 9 "Mode4_BackwardWipingOff" 10 "Mode4_OutwardWipingOff" 11 "Mode4_InwardWipingOff" 12 "Mode4_ForwardScanning" 13 "Mode4_BackwardScanning" 14 "Mode4_BreathOn" 15 "Mode4_BreathOff" 16 "Mode4_1stHalfONand2ndHalfOFF" 17 "Mode4_HalfOFFHalfON" 18 "Mode4_HalfDimmingONHalfOFF" 19 "Mode4_HalfDimmingONHalfON" 20 "Mode4_HalfOFFHalfDimmingON" 21 "Mode4_HalfONHalfDimmingON" 22 "Mode4_HalfDimmingOFFHalfOFF" 23 "Mode4_HalfDimmingOFFHalfON" 24 "Mode4_HalfOFFHalfDimmingOFF" 25 "Mode4_HalfONHalfDimmingOFF" 26 "Mode4_SingleOn1" 27 "Mode4_SingleOn2" 28 "Mode4_SingleOn3" 29 "Mode4_SingleOn4" 30 "Mode4_SingleOn5" 31 "Mode4_SingleOn6" 32 "Mode4_SingleOn7" 33 "Mode4_SingleOn8" 34 "Mode4_SingleOn9" 35 "Mode4_SingleOn10" 36 "Mode4_SingleOn11" 37 "Mode4_SingleOn12" 38 "Mode4_SingleOff1" 39 "Mode4_SingleOff2" 40 "Mode4_SingleOff3" 41 "Mode4_SingleOff4" 42 "Mode4_SingleOff5" 43 "Mode4_SingleOff6" 44 "Mode4_SingleOff7" 45 "Mode4_SingleOff8" 46 "Mode4_SingleOff9" 47 "Mode4_SingleOff10" 48 "Mode4_SingleOff11" 49 "Mode4_SingleOff12";
VAL_ 99 DwnLoadDynLtgPrmForFrntRIGrp5Mode1 0 "Mode4_Off" 1 "Mode4_On" 2 "Mode4_GradualOn" 3 "Mode4_GradualOff" 4 "Mode4_ForwardWipingOn" 5 "Mode4_BackwardWipingOn" 6 "Mode4_OutwardWipingOn" 7 "Mode4_InwardWipingOn" 8 "Mode4_ForwardWipingOff" 9 "Mode4_BackwardWipingOff" 10 "Mode4_OutwardWipingOff" 11 "Mode4_InwardWipingOff" 12 "Mode4_ForwardScanning" 13 "Mode4_BackwardScanning" 14 "Mode4_BreathOn" 15 "Mode4_BreathOff" 16 "Mode4_1stHalfONand2ndHalfOFF" 17 "Mode4_HalfOFFHalfON" 18 "Mode4_HalfDimmingONHalfOFF" 19 "Mode4_HalfDimmingONHalfON" 20 "Mode4_HalfOFFHalfDimmingON" 21 "Mode4_HalfONHalfDimmingON" 22 "Mode4_HalfDimmingOFFHalfOFF" 23 "Mode4_HalfDimmingOFFHalfON" 24 "Mode4_HalfOFFHalfDimmingOFF" 25 "Mode4_HalfONHalfDimmingOFF" 26 "Mode4_SingleOn1" 27 "Mode4_SingleOn2" 28 "Mode4_SingleOn3" 29 "Mode4_SingleOn4" 30 "Mode4_SingleOn5" 31 "Mode4_SingleOn6" 32 "Mode4_SingleOn7" 33 "Mode4_SingleOn8" 34 "Mode4_SingleOn9" 35 "Mode4_SingleOn10" 36 "Mode4_SingleOn11" 37 "Mode4_SingleOn12" 38 "Mode4_SingleOff1" 39 "Mode4_SingleOff2" 40 "Mode4_SingleOff3" 41 "Mode4_SingleOff4" 42 "Mode4_SingleOff5" 43 "Mode4_SingleOff6" 44 "Mode4_SingleOff7" 45 "Mode4_SingleOff8" 46 "Mode4_SingleOff9" 47 "Mode4_SingleOff10" 48 "Mode4_SingleOff11" 49 "Mode4_SingleOff12";
VAL_ 99 DwnLoadDynLtgPrmForFrntRIGrp6Mode1 0 "Mode4_Off" 1 "Mode4_On" 2 "Mode4_GradualOn" 3 "Mode4_GradualOff" 4 "Mode4_ForwardWipingOn" 5 "Mode4_BackwardWipingOn" 6 "Mode4_OutwardWipingOn" 7 "Mode4_InwardWipingOn" 8 "Mode4_ForwardWipingOff" 9 "Mode4_BackwardWipingOff" 10 "Mode4_OutwardWipingOff" 11 "Mode4_InwardWipingOff" 12 "Mode4_ForwardScanning" 13 "Mode4_BackwardScanning" 14 "Mode4_BreathOn" 15 "Mode4_BreathOff" 16 "Mode4_1stHalfONand2ndHalfOFF" 17 "Mode4_HalfOFFHalfON" 18 "Mode4_HalfDimmingONHalfOFF" 19 "Mode4_HalfDimmingONHalfON" 20 "Mode4_HalfOFFHalfDimmingON" 21 "Mode4_HalfONHalfDimmingON" 22 "Mode4_HalfDimmingOFFHalfOFF" 23 "Mode4_HalfDimmingOFFHalfON" 24 "Mode4_HalfOFFHalfDimmingOFF" 25 "Mode4_HalfONHalfDimmingOFF" 26 "Mode4_SingleOn1" 27 "Mode4_SingleOn2" 28 "Mode4_SingleOn3" 29 "Mode4_SingleOn4" 30 "Mode4_SingleOn5" 31 "Mode4_SingleOn6" 32 "Mode4_SingleOn7" 33 "Mode4_SingleOn8" 34 "Mode4_SingleOn9" 35 "Mode4_SingleOn10" 36 "Mode4_SingleOn11" 37 "Mode4_SingleOn12" 38 "Mode4_SingleOff1" 39 "Mode4_SingleOff2" 40 "Mode4_SingleOff3" 41 "Mode4_SingleOff4" 42 "Mode4_SingleOff5" 43 "Mode4_SingleOff6" 44 "Mode4_SingleOff7" 45 "Mode4_SingleOff8" 46 "Mode4_SingleOff9" 47 "Mode4_SingleOff10" 48 "Mode4_SingleOff11" 49 "Mode4_SingleOff12";
VAL_ 99 DwnLoadDynLtgPrmForFrntRIGrp7Mode1 0 "Mode4_Off" 1 "Mode4_On" 2 "Mode4_GradualOn" 3 "Mode4_GradualOff" 4 "Mode4_ForwardWipingOn" 5 "Mode4_BackwardWipingOn" 6 "Mode4_OutwardWipingOn" 7 "Mode4_InwardWipingOn" 8 "Mode4_ForwardWipingOff" 9 "Mode4_BackwardWipingOff" 10 "Mode4_OutwardWipingOff" 11 "Mode4_InwardWipingOff" 12 "Mode4_ForwardScanning" 13 "Mode4_BackwardScanning" 14 "Mode4_BreathOn" 15 "Mode4_BreathOff" 16 "Mode4_1stHalfONand2ndHalfOFF" 17 "Mode4_HalfOFFHalfON" 18 "Mode4_HalfDimmingONHalfOFF" 19 "Mode4_HalfDimmingONHalfON" 20 "Mode4_HalfOFFHalfDimmingON" 21 "Mode4_HalfONHalfDimmingON" 22 "Mode4_HalfDimmingOFFHalfOFF" 23 "Mode4_HalfDimmingOFFHalfON" 24 "Mode4_HalfOFFHalfDimmingOFF" 25 "Mode4_HalfONHalfDimmingOFF" 26 "Mode4_SingleOn1" 27 "Mode4_SingleOn2" 28 "Mode4_SingleOn3" 29 "Mode4_SingleOn4" 30 "Mode4_SingleOn5" 31 "Mode4_SingleOn6" 32 "Mode4_SingleOn7" 33 "Mode4_SingleOn8" 34 "Mode4_SingleOn9" 35 "Mode4_SingleOn10" 36 "Mode4_SingleOn11" 37 "Mode4_SingleOn12" 38 "Mode4_SingleOff1" 39 "Mode4_SingleOff2" 40 "Mode4_SingleOff3" 41 "Mode4_SingleOff4" 42 "Mode4_SingleOff5" 43 "Mode4_SingleOff6" 44 "Mode4_SingleOff7" 45 "Mode4_SingleOff8" 46 "Mode4_SingleOff9" 47 "Mode4_SingleOff10" 48 "Mode4_SingleOff11" 49 "Mode4_SingleOff12";
VAL_ 99 DwnLoadDynLtgPrmForFrntRIGrp8Mode1 0 "Mode4_Off" 1 "Mode4_On" 2 "Mode4_GradualOn" 3 "Mode4_GradualOff" 4 "Mode4_ForwardWipingOn" 5 "Mode4_BackwardWipingOn" 6 "Mode4_OutwardWipingOn" 7 "Mode4_InwardWipingOn" 8 "Mode4_ForwardWipingOff" 9 "Mode4_BackwardWipingOff" 10 "Mode4_OutwardWipingOff" 11 "Mode4_InwardWipingOff" 12 "Mode4_ForwardScanning" 13 "Mode4_BackwardScanning" 14 "Mode4_BreathOn" 15 "Mode4_BreathOff" 16 "Mode4_1stHalfONand2ndHalfOFF" 17 "Mode4_HalfOFFHalfON" 18 "Mode4_HalfDimmingONHalfOFF" 19 "Mode4_HalfDimmingONHalfON" 20 "Mode4_HalfOFFHalfDimmingON" 21 "Mode4_HalfONHalfDimmingON" 22 "Mode4_HalfDimmingOFFHalfOFF" 23 "Mode4_HalfDimmingOFFHalfON" 24 "Mode4_HalfOFFHalfDimmingOFF" 25 "Mode4_HalfONHalfDimmingOFF" 26 "Mode4_SingleOn1" 27 "Mode4_SingleOn2" 28 "Mode4_SingleOn3" 29 "Mode4_SingleOn4" 30 "Mode4_SingleOn5" 31 "Mode4_SingleOn6" 32 "Mode4_SingleOn7" 33 "Mode4_SingleOn8" 34 "Mode4_SingleOn9" 35 "Mode4_SingleOn10" 36 "Mode4_SingleOn11" 37 "Mode4_SingleOn12" 38 "Mode4_SingleOff1" 39 "Mode4_SingleOff2" 40 "Mode4_SingleOff3" 41 "Mode4_SingleOff4" 42 "Mode4_SingleOff5" 43 "Mode4_SingleOff6" 44 "Mode4_SingleOff7" 45 "Mode4_SingleOff8" 46 "Mode4_SingleOff9" 47 "Mode4_SingleOff10" 48 "Mode4_SingleOff11" 49 "Mode4_SingleOff12";
VAL_ 99 DwnLoadDynLtgPrmForFrntRIGrp9Mode1 0 "Mode4_Off" 1 "Mode4_On" 2 "Mode4_GradualOn" 3 "Mode4_GradualOff" 4 "Mode4_ForwardWipingOn" 5 "Mode4_BackwardWipingOn" 6 "Mode4_OutwardWipingOn" 7 "Mode4_InwardWipingOn" 8 "Mode4_ForwardWipingOff" 9 "Mode4_BackwardWipingOff" 10 "Mode4_OutwardWipingOff" 11 "Mode4_InwardWipingOff" 12 "Mode4_ForwardScanning" 13 "Mode4_BackwardScanning" 14 "Mode4_BreathOn" 15 "Mode4_BreathOff" 16 "Mode4_1stHalfONand2ndHalfOFF" 17 "Mode4_HalfOFFHalfON" 18 "Mode4_HalfDimmingONHalfOFF" 19 "Mode4_HalfDimmingONHalfON" 20 "Mode4_HalfOFFHalfDimmingON" 21 "Mode4_HalfONHalfDimmingON" 22 "Mode4_HalfDimmingOFFHalfOFF" 23 "Mode4_HalfDimmingOFFHalfON" 24 "Mode4_HalfOFFHalfDimmingOFF" 25 "Mode4_HalfONHalfDimmingOFF" 26 "Mode4_SingleOn1" 27 "Mode4_SingleOn2" 28 "Mode4_SingleOn3" 29 "Mode4_SingleOn4" 30 "Mode4_SingleOn5" 31 "Mode4_SingleOn6" 32 "Mode4_SingleOn7" 33 "Mode4_SingleOn8" 34 "Mode4_SingleOn9" 35 "Mode4_SingleOn10" 36 "Mode4_SingleOn11" 37 "Mode4_SingleOn12" 38 "Mode4_SingleOff1" 39 "Mode4_SingleOff2" 40 "Mode4_SingleOff3" 41 "Mode4_SingleOff4" 42 "Mode4_SingleOff5" 43 "Mode4_SingleOff6" 44 "Mode4_SingleOff7" 45 "Mode4_SingleOff8" 46 "Mode4_SingleOff9" 47 "Mode4_SingleOff10" 48 "Mode4_SingleOff11" 49 "Mode4_SingleOff12";
VAL_ 99 TelmBookSeatHeatClimalReqDrvHeatClimaLvl 0 "TelmSeatClimaLvl_off" 1 "TelmSeatClimaLvl_Lvl1" 2 "TelmSeatClimaLvl_Lvl2" 3 "TelmSeatClimaLvl_Lvl3";
VAL_ 99 TelmBookSeatHeatClimalReqPassHeatClimaLvl 0 "TelmSeatClimaLvl_off" 1 "TelmSeatClimaLvl_Lvl1" 2 "TelmSeatClimaLvl_Lvl2" 3 "TelmSeatClimaLvl_Lvl3";
VAL_ 99 TelmBookSeatHeatClimalReqSecLeHeatClimaLvl 0 "TelmSeatClimaLvl_off" 1 "TelmSeatClimaLvl_Lvl1" 2 "TelmSeatClimaLvl_Lvl2" 3 "TelmSeatClimaLvl_Lvl3";
VAL_ 99 TelmBookSeatHeatClimalReqSecRiHeatClimaLvl 0 "TelmSeatClimaLvl_off" 1 "TelmSeatClimaLvl_Lvl1" 2 "TelmSeatClimaLvl_Lvl2" 3 "TelmSeatClimaLvl_Lvl3";
VAL_ 99 TelmBookSeatHeatClimalReqThrdLeHeatClimaLvl 0 "TelmSeatClimaLvl_off" 1 "TelmSeatClimaLvl_Lvl1" 2 "TelmSeatClimaLvl_Lvl2" 3 "TelmSeatClimaLvl_Lvl3";
VAL_ 99 TelmBookSeatHeatClimalReqThrdRiHeatClimaLvl 0 "TelmSeatClimaLvl_off" 1 "TelmSeatClimaLvl_Lvl1" 2 "TelmSeatClimaLvl_Lvl2" 3 "TelmSeatClimaLvl_Lvl3";
VAL_ 99 TelmBookSeatVentnClimalReqDrvVentnClimaLvl 0 "TelmSeatClimaLvl_off" 1 "TelmSeatClimaLvl_Lvl1" 2 "TelmSeatClimaLvl_Lvl2" 3 "TelmSeatClimaLvl_Lvl3";
VAL_ 99 TelmBookSeatVentnClimalReqPassVentnClimaLvl 0 "TelmSeatClimaLvl_off" 1 "TelmSeatClimaLvl_Lvl1" 2 "TelmSeatClimaLvl_Lvl2" 3 "TelmSeatClimaLvl_Lvl3";
VAL_ 99 TelmBookSeatVentnClimalReqSecLeVentnClimaLvl 0 "TelmSeatClimaLvl_off" 1 "TelmSeatClimaLvl_Lvl1" 2 "TelmSeatClimaLvl_Lvl2" 3 "TelmSeatClimaLvl_Lvl3";
VAL_ 99 TelmBookSeatVentnClimalReqSecRiVentnClimaLvl 0 "TelmSeatClimaLvl_off" 1 "TelmSeatClimaLvl_Lvl1" 2 "TelmSeatClimaLvl_Lvl2" 3 "TelmSeatClimaLvl_Lvl3";
VAL_ 99 TelmBookSeatVentnClimalReqThrdLeVentnClimaLvl 0 "TelmSeatClimaLvl_off" 1 "TelmSeatClimaLvl_Lvl1" 2 "TelmSeatClimaLvl_Lvl2" 3 "TelmSeatClimaLvl_Lvl3";
VAL_ 99 TelmBookSeatVentnClimalReqThrdRiVentnClimaL 0 "TelmSeatClimaLvl_off" 1 "TelmSeatClimaLvl_Lvl1" 2 "TelmSeatClimaLvl_Lvl2" 3 "TelmSeatClimaLvl_Lvl3";
VAL_ 99 TelmClimaTSetHmiCmptmtTSpSpcl 0 "HmiCmptmtTSpSpcl_Norm" 1 "HmiCmptmtTSpSpcl_Lo" 2 "HmiCmptmtTSpSpcl_Hi";
VAL_ 99 TelmStrtEngForChrgnReq 0 "ErsCmd_ErsCmdNotSet" 1 "ErsCmd_ErsCmdOn" 2 "ErsCmd_ErsCmdOff";
VAL_ 103 DwnLoadDynLtgPrmForFrntRIGrp13Mode1 0 "Mode4_Off" 1 "Mode4_On" 2 "Mode4_GradualOn" 3 "Mode4_GradualOff" 4 "Mode4_ForwardWipingOn" 5 "Mode4_BackwardWipingOn" 6 "Mode4_OutwardWipingOn" 7 "Mode4_InwardWipingOn" 8 "Mode4_ForwardWipingOff" 9 "Mode4_BackwardWipingOff" 10 "Mode4_OutwardWipingOff" 11 "Mode4_InwardWipingOff" 12 "Mode4_ForwardScanning" 13 "Mode4_BackwardScanning" 14 "Mode4_BreathOn" 15 "Mode4_BreathOff" 16 "Mode4_1stHalfONand2ndHalfOFF" 17 "Mode4_HalfOFFHalfON" 18 "Mode4_HalfDimmingONHalfOFF" 19 "Mode4_HalfDimmingONHalfON" 20 "Mode4_HalfOFFHalfDimmingON" 21 "Mode4_HalfONHalfDimmingON" 22 "Mode4_HalfDimmingOFFHalfOFF" 23 "Mode4_HalfDimmingOFFHalfON" 24 "Mode4_HalfOFFHalfDimmingOFF" 25 "Mode4_HalfONHalfDimmingOFF" 26 "Mode4_SingleOn1" 27 "Mode4_SingleOn2" 28 "Mode4_SingleOn3" 29 "Mode4_SingleOn4" 30 "Mode4_SingleOn5" 31 "Mode4_SingleOn6" 32 "Mode4_SingleOn7" 33 "Mode4_SingleOn8" 34 "Mode4_SingleOn9" 35 "Mode4_SingleOn10" 36 "Mode4_SingleOn11" 37 "Mode4_SingleOn12" 38 "Mode4_SingleOff1" 39 "Mode4_SingleOff2" 40 "Mode4_SingleOff3" 41 "Mode4_SingleOff4" 42 "Mode4_SingleOff5" 43 "Mode4_SingleOff6" 44 "Mode4_SingleOff7" 45 "Mode4_SingleOff8" 46 "Mode4_SingleOff9" 47 "Mode4_SingleOff10" 48 "Mode4_SingleOff11" 49 "Mode4_SingleOff12";
VAL_ 103 DwnLoadDynLtgPrmForFrntRIGrp14Mode1 0 "Mode4_Off" 1 "Mode4_On" 2 "Mode4_GradualOn" 3 "Mode4_GradualOff" 4 "Mode4_ForwardWipingOn" 5 "Mode4_BackwardWipingOn" 6 "Mode4_OutwardWipingOn" 7 "Mode4_InwardWipingOn" 8 "Mode4_ForwardWipingOff" 9 "Mode4_BackwardWipingOff" 10 "Mode4_OutwardWipingOff" 11 "Mode4_InwardWipingOff" 12 "Mode4_ForwardScanning" 13 "Mode4_BackwardScanning" 14 "Mode4_BreathOn" 15 "Mode4_BreathOff" 16 "Mode4_1stHalfONand2ndHalfOFF" 17 "Mode4_HalfOFFHalfON" 18 "Mode4_HalfDimmingONHalfOFF" 19 "Mode4_HalfDimmingONHalfON" 20 "Mode4_HalfOFFHalfDimmingON" 21 "Mode4_HalfONHalfDimmingON" 22 "Mode4_HalfDimmingOFFHalfOFF" 23 "Mode4_HalfDimmingOFFHalfON" 24 "Mode4_HalfOFFHalfDimmingOFF" 25 "Mode4_HalfONHalfDimmingOFF" 26 "Mode4_SingleOn1" 27 "Mode4_SingleOn2" 28 "Mode4_SingleOn3" 29 "Mode4_SingleOn4" 30 "Mode4_SingleOn5" 31 "Mode4_SingleOn6" 32 "Mode4_SingleOn7" 33 "Mode4_SingleOn8" 34 "Mode4_SingleOn9" 35 "Mode4_SingleOn10" 36 "Mode4_SingleOn11" 37 "Mode4_SingleOn12" 38 "Mode4_SingleOff1" 39 "Mode4_SingleOff2" 40 "Mode4_SingleOff3" 41 "Mode4_SingleOff4" 42 "Mode4_SingleOff5" 43 "Mode4_SingleOff6" 44 "Mode4_SingleOff7" 45 "Mode4_SingleOff8" 46 "Mode4_SingleOff9" 47 "Mode4_SingleOff10" 48 "Mode4_SingleOff11" 49 "Mode4_SingleOff12";
VAL_ 103 DwnLoadDynLtgPrmForFrntRIGrp15Mode1 0 "Mode4_Off" 1 "Mode4_On" 2 "Mode4_GradualOn" 3 "Mode4_GradualOff" 4 "Mode4_ForwardWipingOn" 5 "Mode4_BackwardWipingOn" 6 "Mode4_OutwardWipingOn" 7 "Mode4_InwardWipingOn" 8 "Mode4_ForwardWipingOff" 9 "Mode4_BackwardWipingOff" 10 "Mode4_OutwardWipingOff" 11 "Mode4_InwardWipingOff" 12 "Mode4_ForwardScanning" 13 "Mode4_BackwardScanning" 14 "Mode4_BreathOn" 15 "Mode4_BreathOff" 16 "Mode4_1stHalfONand2ndHalfOFF" 17 "Mode4_HalfOFFHalfON" 18 "Mode4_HalfDimmingONHalfOFF" 19 "Mode4_HalfDimmingONHalfON" 20 "Mode4_HalfOFFHalfDimmingON" 21 "Mode4_HalfONHalfDimmingON" 22 "Mode4_HalfDimmingOFFHalfOFF" 23 "Mode4_HalfDimmingOFFHalfON" 24 "Mode4_HalfOFFHalfDimmingOFF" 25 "Mode4_HalfONHalfDimmingOFF" 26 "Mode4_SingleOn1" 27 "Mode4_SingleOn2" 28 "Mode4_SingleOn3" 29 "Mode4_SingleOn4" 30 "Mode4_SingleOn5" 31 "Mode4_SingleOn6" 32 "Mode4_SingleOn7" 33 "Mode4_SingleOn8" 34 "Mode4_SingleOn9" 35 "Mode4_SingleOn10" 36 "Mode4_SingleOn11" 37 "Mode4_SingleOn12" 38 "Mode4_SingleOff1" 39 "Mode4_SingleOff2" 40 "Mode4_SingleOff3" 41 "Mode4_SingleOff4" 42 "Mode4_SingleOff5" 43 "Mode4_SingleOff6" 44 "Mode4_SingleOff7" 45 "Mode4_SingleOff8" 46 "Mode4_SingleOff9" 47 "Mode4_SingleOff10" 48 "Mode4_SingleOff11" 49 "Mode4_SingleOff12";
VAL_ 103 DwnLoadDynLtgPrmForFrntRIGrp16Mode1 0 "Mode4_Off" 1 "Mode4_On" 2 "Mode4_GradualOn" 3 "Mode4_GradualOff" 4 "Mode4_ForwardWipingOn" 5 "Mode4_BackwardWipingOn" 6 "Mode4_OutwardWipingOn" 7 "Mode4_InwardWipingOn" 8 "Mode4_ForwardWipingOff" 9 "Mode4_BackwardWipingOff" 10 "Mode4_OutwardWipingOff" 11 "Mode4_InwardWipingOff" 12 "Mode4_ForwardScanning" 13 "Mode4_BackwardScanning" 14 "Mode4_BreathOn" 15 "Mode4_BreathOff" 16 "Mode4_1stHalfONand2ndHalfOFF" 17 "Mode4_HalfOFFHalfON" 18 "Mode4_HalfDimmingONHalfOFF" 19 "Mode4_HalfDimmingONHalfON" 20 "Mode4_HalfOFFHalfDimmingON" 21 "Mode4_HalfONHalfDimmingON" 22 "Mode4_HalfDimmingOFFHalfOFF" 23 "Mode4_HalfDimmingOFFHalfON" 24 "Mode4_HalfOFFHalfDimmingOFF" 25 "Mode4_HalfONHalfDimmingOFF" 26 "Mode4_SingleOn1" 27 "Mode4_SingleOn2" 28 "Mode4_SingleOn3" 29 "Mode4_SingleOn4" 30 "Mode4_SingleOn5" 31 "Mode4_SingleOn6" 32 "Mode4_SingleOn7" 33 "Mode4_SingleOn8" 34 "Mode4_SingleOn9" 35 "Mode4_SingleOn10" 36 "Mode4_SingleOn11" 37 "Mode4_SingleOn12" 38 "Mode4_SingleOff1" 39 "Mode4_SingleOff2" 40 "Mode4_SingleOff3" 41 "Mode4_SingleOff4" 42 "Mode4_SingleOff5" 43 "Mode4_SingleOff6" 44 "Mode4_SingleOff7" 45 "Mode4_SingleOff8" 46 "Mode4_SingleOff9" 47 "Mode4_SingleOff10" 48 "Mode4_SingleOff11" 49 "Mode4_SingleOff12";
VAL_ 103 DwnLoadDynLtgPrmForFrntRIGrp17Mode1 0 "Mode4_Off" 1 "Mode4_On" 2 "Mode4_GradualOn" 3 "Mode4_GradualOff" 4 "Mode4_ForwardWipingOn" 5 "Mode4_BackwardWipingOn" 6 "Mode4_OutwardWipingOn" 7 "Mode4_InwardWipingOn" 8 "Mode4_ForwardWipingOff" 9 "Mode4_BackwardWipingOff" 10 "Mode4_OutwardWipingOff" 11 "Mode4_InwardWipingOff" 12 "Mode4_ForwardScanning" 13 "Mode4_BackwardScanning" 14 "Mode4_BreathOn" 15 "Mode4_BreathOff" 16 "Mode4_1stHalfONand2ndHalfOFF" 17 "Mode4_HalfOFFHalfON" 18 "Mode4_HalfDimmingONHalfOFF" 19 "Mode4_HalfDimmingONHalfON" 20 "Mode4_HalfOFFHalfDimmingON" 21 "Mode4_HalfONHalfDimmingON" 22 "Mode4_HalfDimmingOFFHalfOFF" 23 "Mode4_HalfDimmingOFFHalfON" 24 "Mode4_HalfOFFHalfDimmingOFF" 25 "Mode4_HalfONHalfDimmingOFF" 26 "Mode4_SingleOn1" 27 "Mode4_SingleOn2" 28 "Mode4_SingleOn3" 29 "Mode4_SingleOn4" 30 "Mode4_SingleOn5" 31 "Mode4_SingleOn6" 32 "Mode4_SingleOn7" 33 "Mode4_SingleOn8" 34 "Mode4_SingleOn9" 35 "Mode4_SingleOn10" 36 "Mode4_SingleOn11" 37 "Mode4_SingleOn12" 38 "Mode4_SingleOff1" 39 "Mode4_SingleOff2" 40 "Mode4_SingleOff3" 41 "Mode4_SingleOff4" 42 "Mode4_SingleOff5" 43 "Mode4_SingleOff6" 44 "Mode4_SingleOff7" 45 "Mode4_SingleOff8" 46 "Mode4_SingleOff9" 47 "Mode4_SingleOff10" 48 "Mode4_SingleOff11" 49 "Mode4_SingleOff12";
VAL_ 103 DwnLoadDynLtgPrmForFrntRIGrp18Mode1 0 "Mode4_Off" 1 "Mode4_On" 2 "Mode4_GradualOn" 3 "Mode4_GradualOff" 4 "Mode4_ForwardWipingOn" 5 "Mode4_BackwardWipingOn" 6 "Mode4_OutwardWipingOn" 7 "Mode4_InwardWipingOn" 8 "Mode4_ForwardWipingOff" 9 "Mode4_BackwardWipingOff" 10 "Mode4_OutwardWipingOff" 11 "Mode4_InwardWipingOff" 12 "Mode4_ForwardScanning" 13 "Mode4_BackwardScanning" 14 "Mode4_BreathOn" 15 "Mode4_BreathOff" 16 "Mode4_1stHalfONand2ndHalfOFF" 17 "Mode4_HalfOFFHalfON" 18 "Mode4_HalfDimmingONHalfOFF" 19 "Mode4_HalfDimmingONHalfON" 20 "Mode4_HalfOFFHalfDimmingON" 21 "Mode4_HalfONHalfDimmingON" 22 "Mode4_HalfDimmingOFFHalfOFF" 23 "Mode4_HalfDimmingOFFHalfON" 24 "Mode4_HalfOFFHalfDimmingOFF" 25 "Mode4_HalfONHalfDimmingOFF" 26 "Mode4_SingleOn1" 27 "Mode4_SingleOn2" 28 "Mode4_SingleOn3" 29 "Mode4_SingleOn4" 30 "Mode4_SingleOn5" 31 "Mode4_SingleOn6" 32 "Mode4_SingleOn7" 33 "Mode4_SingleOn8" 34 "Mode4_SingleOn9" 35 "Mode4_SingleOn10" 36 "Mode4_SingleOn11" 37 "Mode4_SingleOn12" 38 "Mode4_SingleOff1" 39 "Mode4_SingleOff2" 40 "Mode4_SingleOff3" 41 "Mode4_SingleOff4" 42 "Mode4_SingleOff5" 43 "Mode4_SingleOff6" 44 "Mode4_SingleOff7" 45 "Mode4_SingleOff8" 46 "Mode4_SingleOff9" 47 "Mode4_SingleOff10" 48 "Mode4_SingleOff11" 49 "Mode4_SingleOff12";
VAL_ 103 DwnLoadDynLtgPrmForFrntRIGrp19Mode1 0 "Mode4_Off" 1 "Mode4_On" 2 "Mode4_GradualOn" 3 "Mode4_GradualOff" 4 "Mode4_ForwardWipingOn" 5 "Mode4_BackwardWipingOn" 6 "Mode4_OutwardWipingOn" 7 "Mode4_InwardWipingOn" 8 "Mode4_ForwardWipingOff" 9 "Mode4_BackwardWipingOff" 10 "Mode4_OutwardWipingOff" 11 "Mode4_InwardWipingOff" 12 "Mode4_ForwardScanning" 13 "Mode4_BackwardScanning" 14 "Mode4_BreathOn" 15 "Mode4_BreathOff" 16 "Mode4_1stHalfONand2ndHalfOFF" 17 "Mode4_HalfOFFHalfON" 18 "Mode4_HalfDimmingONHalfOFF" 19 "Mode4_HalfDimmingONHalfON" 20 "Mode4_HalfOFFHalfDimmingON" 21 "Mode4_HalfONHalfDimmingON" 22 "Mode4_HalfDimmingOFFHalfOFF" 23 "Mode4_HalfDimmingOFFHalfON" 24 "Mode4_HalfOFFHalfDimmingOFF" 25 "Mode4_HalfONHalfDimmingOFF" 26 "Mode4_SingleOn1" 27 "Mode4_SingleOn2" 28 "Mode4_SingleOn3" 29 "Mode4_SingleOn4" 30 "Mode4_SingleOn5" 31 "Mode4_SingleOn6" 32 "Mode4_SingleOn7" 33 "Mode4_SingleOn8" 34 "Mode4_SingleOn9" 35 "Mode4_SingleOn10" 36 "Mode4_SingleOn11" 37 "Mode4_SingleOn12" 38 "Mode4_SingleOff1" 39 "Mode4_SingleOff2" 40 "Mode4_SingleOff3" 41 "Mode4_SingleOff4" 42 "Mode4_SingleOff5" 43 "Mode4_SingleOff6" 44 "Mode4_SingleOff7" 45 "Mode4_SingleOff8" 46 "Mode4_SingleOff9" 47 "Mode4_SingleOff10" 48 "Mode4_SingleOff11" 49 "Mode4_SingleOff12";
VAL_ 103 DwnLoadDynLtgPrmForFrntRIGrp20Mode1 0 "Mode4_Off" 1 "Mode4_On" 2 "Mode4_GradualOn" 3 "Mode4_GradualOff" 4 "Mode4_ForwardWipingOn" 5 "Mode4_BackwardWipingOn" 6 "Mode4_OutwardWipingOn" 7 "Mode4_InwardWipingOn" 8 "Mode4_ForwardWipingOff" 9 "Mode4_BackwardWipingOff" 10 "Mode4_OutwardWipingOff" 11 "Mode4_InwardWipingOff" 12 "Mode4_ForwardScanning" 13 "Mode4_BackwardScanning" 14 "Mode4_BreathOn" 15 "Mode4_BreathOff" 16 "Mode4_1stHalfONand2ndHalfOFF" 17 "Mode4_HalfOFFHalfON" 18 "Mode4_HalfDimmingONHalfOFF" 19 "Mode4_HalfDimmingONHalfON" 20 "Mode4_HalfOFFHalfDimmingON" 21 "Mode4_HalfONHalfDimmingON" 22 "Mode4_HalfDimmingOFFHalfOFF" 23 "Mode4_HalfDimmingOFFHalfON" 24 "Mode4_HalfOFFHalfDimmingOFF" 25 "Mode4_HalfONHalfDimmingOFF" 26 "Mode4_SingleOn1" 27 "Mode4_SingleOn2" 28 "Mode4_SingleOn3" 29 "Mode4_SingleOn4" 30 "Mode4_SingleOn5" 31 "Mode4_SingleOn6" 32 "Mode4_SingleOn7" 33 "Mode4_SingleOn8" 34 "Mode4_SingleOn9" 35 "Mode4_SingleOn10" 36 "Mode4_SingleOn11" 37 "Mode4_SingleOn12" 38 "Mode4_SingleOff1" 39 "Mode4_SingleOff2" 40 "Mode4_SingleOff3" 41 "Mode4_SingleOff4" 42 "Mode4_SingleOff5" 43 "Mode4_SingleOff6" 44 "Mode4_SingleOff7" 45 "Mode4_SingleOff8" 46 "Mode4_SingleOff9" 47 "Mode4_SingleOff10" 48 "Mode4_SingleOff11" 49 "Mode4_SingleOff12";
VAL_ 103 DwnLoadDynLtgPrmForFrntRIGrp21Mode1 0 "Mode4_Off" 1 "Mode4_On" 2 "Mode4_GradualOn" 3 "Mode4_GradualOff" 4 "Mode4_ForwardWipingOn" 5 "Mode4_BackwardWipingOn" 6 "Mode4_OutwardWipingOn" 7 "Mode4_InwardWipingOn" 8 "Mode4_ForwardWipingOff" 9 "Mode4_BackwardWipingOff" 10 "Mode4_OutwardWipingOff" 11 "Mode4_InwardWipingOff" 12 "Mode4_ForwardScanning" 13 "Mode4_BackwardScanning" 14 "Mode4_BreathOn" 15 "Mode4_BreathOff" 16 "Mode4_1stHalfONand2ndHalfOFF" 17 "Mode4_HalfOFFHalfON" 18 "Mode4_HalfDimmingONHalfOFF" 19 "Mode4_HalfDimmingONHalfON" 20 "Mode4_HalfOFFHalfDimmingON" 21 "Mode4_HalfONHalfDimmingON" 22 "Mode4_HalfDimmingOFFHalfOFF" 23 "Mode4_HalfDimmingOFFHalfON" 24 "Mode4_HalfOFFHalfDimmingOFF" 25 "Mode4_HalfONHalfDimmingOFF" 26 "Mode4_SingleOn1" 27 "Mode4_SingleOn2" 28 "Mode4_SingleOn3" 29 "Mode4_SingleOn4" 30 "Mode4_SingleOn5" 31 "Mode4_SingleOn6" 32 "Mode4_SingleOn7" 33 "Mode4_SingleOn8" 34 "Mode4_SingleOn9" 35 "Mode4_SingleOn10" 36 "Mode4_SingleOn11" 37 "Mode4_SingleOn12" 38 "Mode4_SingleOff1" 39 "Mode4_SingleOff2" 40 "Mode4_SingleOff3" 41 "Mode4_SingleOff4" 42 "Mode4_SingleOff5" 43 "Mode4_SingleOff6" 44 "Mode4_SingleOff7" 45 "Mode4_SingleOff8" 46 "Mode4_SingleOff9" 47 "Mode4_SingleOff10" 48 "Mode4_SingleOff11" 49 "Mode4_SingleOff12";
VAL_ 103 DwnLoadDynLtgPrmForFrntRIGrp22Mode1 0 "Mode4_Off" 1 "Mode4_On" 2 "Mode4_GradualOn" 3 "Mode4_GradualOff" 4 "Mode4_ForwardWipingOn" 5 "Mode4_BackwardWipingOn" 6 "Mode4_OutwardWipingOn" 7 "Mode4_InwardWipingOn" 8 "Mode4_ForwardWipingOff" 9 "Mode4_BackwardWipingOff" 10 "Mode4_OutwardWipingOff" 11 "Mode4_InwardWipingOff" 12 "Mode4_ForwardScanning" 13 "Mode4_BackwardScanning" 14 "Mode4_BreathOn" 15 "Mode4_BreathOff" 16 "Mode4_1stHalfONand2ndHalfOFF" 17 "Mode4_HalfOFFHalfON" 18 "Mode4_HalfDimmingONHalfOFF" 19 "Mode4_HalfDimmingONHalfON" 20 "Mode4_HalfOFFHalfDimmingON" 21 "Mode4_HalfONHalfDimmingON" 22 "Mode4_HalfDimmingOFFHalfOFF" 23 "Mode4_HalfDimmingOFFHalfON" 24 "Mode4_HalfOFFHalfDimmingOFF" 25 "Mode4_HalfONHalfDimmingOFF" 26 "Mode4_SingleOn1" 27 "Mode4_SingleOn2" 28 "Mode4_SingleOn3" 29 "Mode4_SingleOn4" 30 "Mode4_SingleOn5" 31 "Mode4_SingleOn6" 32 "Mode4_SingleOn7" 33 "Mode4_SingleOn8" 34 "Mode4_SingleOn9" 35 "Mode4_SingleOn10" 36 "Mode4_SingleOn11" 37 "Mode4_SingleOn12" 38 "Mode4_SingleOff1" 39 "Mode4_SingleOff2" 40 "Mode4_SingleOff3" 41 "Mode4_SingleOff4" 42 "Mode4_SingleOff5" 43 "Mode4_SingleOff6" 44 "Mode4_SingleOff7" 45 "Mode4_SingleOff8" 46 "Mode4_SingleOff9" 47 "Mode4_SingleOff10" 48 "Mode4_SingleOff11" 49 "Mode4_SingleOff12";
VAL_ 103 DwnLoadDynLtgPrmForFrntRIGrp23Mode1 0 "Mode4_Off" 1 "Mode4_On" 2 "Mode4_GradualOn" 3 "Mode4_GradualOff" 4 "Mode4_ForwardWipingOn" 5 "Mode4_BackwardWipingOn" 6 "Mode4_OutwardWipingOn" 7 "Mode4_InwardWipingOn" 8 "Mode4_ForwardWipingOff" 9 "Mode4_BackwardWipingOff" 10 "Mode4_OutwardWipingOff" 11 "Mode4_InwardWipingOff" 12 "Mode4_ForwardScanning" 13 "Mode4_BackwardScanning" 14 "Mode4_BreathOn" 15 "Mode4_BreathOff" 16 "Mode4_1stHalfONand2ndHalfOFF" 17 "Mode4_HalfOFFHalfON" 18 "Mode4_HalfDimmingONHalfOFF" 19 "Mode4_HalfDimmingONHalfON" 20 "Mode4_HalfOFFHalfDimmingON" 21 "Mode4_HalfONHalfDimmingON" 22 "Mode4_HalfDimmingOFFHalfOFF" 23 "Mode4_HalfDimmingOFFHalfON" 24 "Mode4_HalfOFFHalfDimmingOFF" 25 "Mode4_HalfONHalfDimmingOFF" 26 "Mode4_SingleOn1" 27 "Mode4_SingleOn2" 28 "Mode4_SingleOn3" 29 "Mode4_SingleOn4" 30 "Mode4_SingleOn5" 31 "Mode4_SingleOn6" 32 "Mode4_SingleOn7" 33 "Mode4_SingleOn8" 34 "Mode4_SingleOn9" 35 "Mode4_SingleOn10" 36 "Mode4_SingleOn11" 37 "Mode4_SingleOn12" 38 "Mode4_SingleOff1" 39 "Mode4_SingleOff2" 40 "Mode4_SingleOff3" 41 "Mode4_SingleOff4" 42 "Mode4_SingleOff5" 43 "Mode4_SingleOff6" 44 "Mode4_SingleOff7" 45 "Mode4_SingleOff8" 46 "Mode4_SingleOff9" 47 "Mode4_SingleOff10" 48 "Mode4_SingleOff11" 49 "Mode4_SingleOff12";
VAL_ 103 DwnLoadDynLtgPrmForFrntRIGrp24Mode1 0 "Mode4_Off" 1 "Mode4_On" 2 "Mode4_GradualOn" 3 "Mode4_GradualOff" 4 "Mode4_ForwardWipingOn" 5 "Mode4_BackwardWipingOn" 6 "Mode4_OutwardWipingOn" 7 "Mode4_InwardWipingOn" 8 "Mode4_ForwardWipingOff" 9 "Mode4_BackwardWipingOff" 10 "Mode4_OutwardWipingOff" 11 "Mode4_InwardWipingOff" 12 "Mode4_ForwardScanning" 13 "Mode4_BackwardScanning" 14 "Mode4_BreathOn" 15 "Mode4_BreathOff" 16 "Mode4_1stHalfONand2ndHalfOFF" 17 "Mode4_HalfOFFHalfON" 18 "Mode4_HalfDimmingONHalfOFF" 19 "Mode4_HalfDimmingONHalfON" 20 "Mode4_HalfOFFHalfDimmingON" 21 "Mode4_HalfONHalfDimmingON" 22 "Mode4_HalfDimmingOFFHalfOFF" 23 "Mode4_HalfDimmingOFFHalfON" 24 "Mode4_HalfOFFHalfDimmingOFF" 25 "Mode4_HalfONHalfDimmingOFF" 26 "Mode4_SingleOn1" 27 "Mode4_SingleOn2" 28 "Mode4_SingleOn3" 29 "Mode4_SingleOn4" 30 "Mode4_SingleOn5" 31 "Mode4_SingleOn6" 32 "Mode4_SingleOn7" 33 "Mode4_SingleOn8" 34 "Mode4_SingleOn9" 35 "Mode4_SingleOn10" 36 "Mode4_SingleOn11" 37 "Mode4_SingleOn12" 38 "Mode4_SingleOff1" 39 "Mode4_SingleOff2" 40 "Mode4_SingleOff3" 41 "Mode4_SingleOff4" 42 "Mode4_SingleOff5" 43 "Mode4_SingleOff6" 44 "Mode4_SingleOff7" 45 "Mode4_SingleOff8" 46 "Mode4_SingleOff9" 47 "Mode4_SingleOff10" 48 "Mode4_SingleOff11" 49 "Mode4_SingleOff12";
VAL_ 103 TelmBookClimaReqHmiCmptmtTSpSpcl 0 "NormalLowHigh_Normal" 1 "NormalLowHigh_Low" 2 "NormalLowHigh_High";
VAL_ 103 TelmBookClimaReqOnOffNoReq 0 "NoReqOnOff_Norequest" 1 "NoReqOnOff_On" 2 "NoReqOnOff_Off";
VAL_ 103 WinOpenClsGlbReqFromTelmWinOpenClsGlbSts 0 "WinOpenClsGlbReqFromTelm_Idle" 1 "WinOpenClsGlbReqFromTelm_Open" 2 "WinOpenClsGlbReqFromTelm_Close";
VAL_ 560 AudWarnActv 0 "NoYesCrit1_NotVld1" 1 "NoYesCrit1_No" 2 "NoYesCrit1_Yes" 3 "NoYesCrit1_NotVld2";
VAL_ 560 BevPwrCtrl 0 "Boolean_FALSE" 1 "Boolean_TRUE";
VAL_ 560 CopilotSeatOccupySts 0 "ActvnAvl3_Idle" 1 "ActvnAvl3_Actvn" 2 "ActvnAvl3_Deactvn";
VAL_ 560 DrvSeatOccupySts 0 "ActvnAvl3_Idle" 1 "ActvnAvl3_Actvn" 2 "ActvnAvl3_Deactvn";
VAL_ 560 HMIAirCdnrAutDrySet 0 "OnOff1_Off" 1 "OnOff1_On";
VAL_ 560 HmiPM25PopUpSet 0 "OnOff1_Off" 1 "OnOff1_On";
VAL_ 560 SteerSetgPen 0 "IdPen_ProfUkwn" 1 "IdPen_Prof1" 2 "IdPen_Prof2" 3 "IdPen_Prof3" 4 "IdPen_Prof4" 5 "IdPen_Prof5" 6 "IdPen_Prof6" 7 "IdPen_Prof7" 8 "IdPen_Prof8" 9 "IdPen_Prof9" 10 "IdPen_Prof10" 11 "IdPen_Prof11" 12 "IdPen_Prof12" 13 "IdPen_Prof13" 14 "IdPen_Resd14" 15 "IdPen_ProfAll";
VAL_ 560 SteerSetgSteerAsscLvl 0 "SteerAsscLvl_Ukwn" 1 "SteerAsscLvl_Lvl1" 2 "SteerAsscLvl_Lvl2" 3 "SteerAsscLvl_Lvl3" 4 "SteerAsscLvl_Lvl4" 5 "SteerAsscLvl_Resd5" 6 "SteerAsscLvl_Resd6" 7 "SteerAsscLvl_Resd7";
VAL_ 560 SteerSetgSteerMod 0 "SteerMod_Ukwn" 1 "SteerMod_Mod1" 2 "SteerMod_Mod2" 3 "SteerMod_Mod3" 4 "SteerMod_Mod4" 5 "SteerMod_Resd5" 6 "SteerMod_Resd6" 7 "SteerMod_Resd7";
VAL_ 560 WiprReAutReq 0 "OnOff1_Off" 1 "OnOff1_On";
VAL_ 368 AutEgyRgnLvlSet 0 "EgyRgnLvlAct_Low" 1 "EgyRgnLvlAct_Mid" 2 "EgyRgnLvlAct_High" 3 "EgyRgnLvlAct_Reserved1" 4 "EgyRgnLvlAct_Reserved2" 5 "EgyRgnLvlAct_Auto" 6 "EgyRgnLvlAct_Off" 7 "EgyRgnLvlAct_NoReq";
VAL_ 368 FaceRecognitionIndcrFromDHU 0 "OnOff1_Off" 1 "OnOff1_On";
VAL_ 368 GestureDetn 0 "Detn10_Unknown" 1 "Detn10_OpenSunroof" 2 "Detn10_closeSunroof" 3 "Detn10_LiUpFrntPassReadLamp" 4 "Detn10_TurnOffFrntPassReadLamp" 5 "Detn10_LstOne_AnswerPhone" 6 "Detn10_NexOnet_RfusePhone" 7 "Detn10_VolUp" 8 "Detn10_VolDwn" 9 "Detn10_MapZoom" 10 "Detn10_GlbPreview";
VAL_ 368 LnchModSwt 0 "OnOffNoReq_NoReq" 1 "OnOffNoReq_On" 2 "OnOffNoReq_Off";
VAL_ 368 LvlgSwtSetReqLvlgSwtSetReq 0 "LvlgSwtSetReq_Level0" 1 "LvlgSwtSetReq_Level1" 2 "LvlgSwtSetReq_Level2" 3 "LvlgSwtSetReq_Level3" 4 "LvlgSwtSetReq_Level4" 5 "LvlgSwtSetReq_Level5";
VAL_ 368 PrpsnMaxEvMod 0 "OnOff1_Off" 1 "OnOff1_On";
VAL_ 368 RainSnsrSnvtyHMIReq 0 "WipgSpdIntlFromHmi_Posn0" 1 "WipgSpdIntlFromHmi_Posn1" 2 "WipgSpdIntlFromHmi_Posn2" 3 "WipgSpdIntlFromHmi_Posn3" 4 "WipgSpdIntlFromHmi_Posn4" 5 "WipgSpdIntlFromHmi_Posn5" 6 "WipgSpdIntlFromHmi_Posn6" 7 "WipgSpdIntlFromHmi_Posn7";
VAL_ 368 SecLeSeatTarPosnCmdReqTarPosnCmd1 0 "TarPosnCmd1_Idle" 1 "TarPosnCmd1_MoveReq" 2 "TarPosnCmd1_StopReq";
VAL_ 368 SecRiSeatTarPosnCmdReqTarPosnCmd1 0 "TarPosnCmd1_Idle" 1 "TarPosnCmd1_MoveReq" 2 "TarPosnCmd1_StopReq";
VAL_ 259 ConfCurrSpd 0 "ConfPath_init" 1 "ConfPath_valid" 2 "ConfPath_invalid" 3 "ConfPath_reserved";
VAL_ 259 ConfPath 0 "ConfPath_init" 1 "ConfPath_valid" 2 "ConfPath_invalid" 3 "ConfPath_reserved";
VAL_ 259 DchrgnInSwtCtrl 0 "OnOffNoReq_NoReq" 1 "OnOffNoReq_On" 2 "OnOffNoReq_Off";
VAL_ 259 DrvrCrsCtrlFctDeactvnReq 0 "OnOff1_Off" 1 "OnOff1_On";
VAL_ 259 DrvrCrsCtrlFctReActvReq 0 "OnOff1_Off" 1 "OnOff1_On";
VAL_ 259 DrvrCrsCtrlFctSeld 0 "DrvrCrsCtrlFctSeldTyp_Off" 1 "DrvrCrsCtrlFctSeldTyp_SpdLimFct_Main_Swt" 2 "DrvrCrsCtrlFctSeldTyp_SpdLimFct_Resu" 3 "DrvrCrsCtrlFctSeldTyp_CrsCtrlFct_Main_Swt" 4 "DrvrCrsCtrlFctSeldTyp_CrsCtrlFct_Resu" 5 "DrvrCrsCtrlFctSeldTyp_AccFct_Main_Swt" 6 "DrvrCrsCtrlFctSeldTyp_AccFct_Resu" 7 "DrvrCrsCtrlFctSeldTyp_OffRoadCrsCtrlFc";
VAL_ 259 EPedlModCtrlSt 0 "OnOff1_Off" 1 "OnOff1_On";
VAL_ 259 ESCLvlSwt 0 "DrvrPfmncLvl2_Ukwn" 1 "DrvrPfmncLvl2_DrvrLvl1" 2 "DrvrPfmncLvl2_DrvrLvl2" 3 "DrvrPfmncLvl2_DrvrLvl3" 4 "DrvrPfmncLvl2_DrvrLvl4" 5 "DrvrPfmncLvl2_DrvrLvl5";
VAL_ 259 FuLvlRawActvSideGenQF 0 "GenQf1_UndefindDataAccur" 1 "GenQf1_TmpUndefdData" 2 "GenQf1_DataAccurNotWithinSpcn" 3 "GenQf1_AccurData";
VAL_ 259 FuLvlRawPasSideGenQF 0 "GenQf1_UndefindDataAccur" 1 "GenQf1_TmpUndefdData" 2 "GenQf1_DataAccurNotWithinSpcn" 3 "GenQf1_AccurData";
VAL_ 259 HmiMaxEvMod 0 "OnOff1_Off" 1 "OnOff1_On";
VAL_ 259 HMIThermoTankDlyCls 0 "OnOff1_Off" 1 "OnOff1_On";
VAL_ 259 HornWarnReq 0 "OnOff1_Off" 1 "OnOff1_On";
VAL_ 259 IAMSMod 0 "OnOff1_Off" 1 "OnOff1_On";
VAL_ 259 KickTailgateSig 0 "Boolean_FALSE" 1 "Boolean_TRUE";
VAL_ 259 LiFlashWarnReq 0 "OnOff1_Off" 1 "OnOff1_On";
VAL_ 259 LvngCratuDetdSts 0 "Detected_Unknown" 1 "Detected_Undetected" 2 "Detected_Detected" 3 "Detected_Reserved";
VAL_ 259 MirrTarPosnCmdReqTarPosnCmd1 0 "TarPosnCmd1_Idle" 1 "TarPosnCmd1_MoveReq" 2 "TarPosnCmd1_StopReq";
VAL_ 259 PasEntryEnaReq1 0 "OnOff1_Off" 1 "OnOff1_On";
VAL_ 259 RemHvStrtActvReq 0 "OnOffNoReq_NoReq" 1 "OnOffNoReq_On" 2 "OnOffNoReq_Off";
VAL_ 259 RoadCondLvl 0 "RoadCondLvl_Invalid" 1 "RoadCondLvl_light" 2 "RoadCondLvl_slightly_heavy" 3 "RoadCondLvl_very_heay" 4 "RoadCondLvl_extremly_heavy";
VAL_ 259 WinOpenLDACReq 0 "OnOff1_Off" 1 "OnOff1_On";
VAL_ 624 MmedHdPwrMod 0 "MmedMaiPwrMod_IHUStateSleep" 1 "MmedMaiPwrMod_IHUStateStandby" 2 "MmedMaiPwrMod_IHUStatePartial" 3 "MmedMaiPwrMod_IHUStateOn";
VAL_ 624 MobDevBtnPanicReq 0 "OnOffNoReq_NoReq" 1 "OnOffNoReq_On" 2 "OnOffNoReq_Off";
VAL_ 80 CnclBookTrvlReq 0 "ReqSts1_NotReqd" 1 "ReqSts1_Reqd";
VAL_ 80 ErsCmdRecErsCmd 0 "ErsCmd_ErsCmdNotSet" 1 "ErsCmd_ErsCmdOn" 2 "ErsCmd_ErsCmdOff";
VAL_ 1168 CarSharingMde 0 "Boolean_FALSE" 1 "Boolean_TRUE";
VAL_ 1168 LongTiRunngModCampMod 0 "OnOff1_Off" 1 "OnOff1_On";
VAL_ 1168 LongTiRunngModGameMod 0 "OnOff1_Off" 1 "OnOff1_On";
VAL_ 1168 LongTiRunngModMonrbyOMS 0 "MonrbyOMS_NoUserInside" 1 "MonrbyOMS_UserInside";
VAL_ 1168 LongTiRunngModPanelTouched 0 "PanelTouched_NoTouch" 1 "PanelTouched_Touched";
VAL_ 1168 LongTiRunngModParkComfortMod 0 "OnOff1_Off" 1 "OnOff1_On";
VAL_ 1168 LongTiRunngModPetMod 0 "OnOff1_Off" 1 "OnOff1_On";
VAL_ 1168 LongTiRunngModReserved1 0 "OnOff1_Off" 1 "OnOff1_On";
VAL_ 1168 LongTiRunngModReserved2 0 "OnOff1_Off" 1 "OnOff1_On";
VAL_ 1168 LongTiRunngModReserved3 0 "OnOff1_Off" 1 "OnOff1_On";
VAL_ 1168 LongTiRunngModReserved4 0 "OnOff1_Off" 1 "OnOff1_On";
VAL_ 1168 LongTiRunngModReserved5 0 "OnOff1_Off" 1 "OnOff1_On";
VAL_ 1168 LongTiRunngModReserved6 0 "OnOff1_Off" 1 "OnOff1_On";
VAL_ 1168 LongTiRunngModReserved7 0 "OnOff1_Off" 1 "OnOff1_On";
VAL_ 1168 LongTiRunngModReserved8 0 "OnOff1_Off" 1 "OnOff1_On";
VAL_ 1168 LongTiRunngModRestMod 0 "OnOff1_Off" 1 "OnOff1_On";
VAL_ 1168 LongTiRunngModTheaterMod 0 "OnOff1_Off" 1 "OnOff1_On";
VAL_ 1168 UnlckRemReq 0 "UnlckRemCfg1_UnlckCen" 1 "UnlckRemCfg1_UnlckStep2";
VAL_ 435 HznPosnLRMessageType 0 "MessageType_SystemSpecific" 1 "MessageType_POSITION" 2 "MessageType_SEGMENT" 3 "MessageType_STUB" 4 "MessageType_PROFILESHORT" 5 "MessageType_PROFILELONG" 6 "MessageType_METADATA" 7 "MessageType_Reserved";
VAL_ 435 HznProfLongLRControlPoint 0 "Boolean_FALSE" 1 "Boolean_TRUE";
VAL_ 435 HznProfLongLRMessageType 0 "MessageType_SystemSpecific" 1 "MessageType_POSITION" 2 "MessageType_SEGMENT" 3 "MessageType_STUB" 4 "MessageType_PROFILESHORT" 5 "MessageType_PROFILELONG" 6 "MessageType_METADATA" 7 "MessageType_Reserved";
VAL_ 435 HznProfLongLRRetransmission 0 "Boolean_FALSE" 1 "Boolean_TRUE";
VAL_ 435 HznProfLongLRUpdate 0 "Boolean_FALSE" 1 "Boolean_TRUE";
VAL_ 435 ShowTypOfDTESet 0 "ShowTyp1_NoReq" 1 "ShowTyp1_NormalType" 2 "ShowTyp1_DynamicType";
VAL_ 464 BackRestSideSpprtAdjmtRowFirstDrvr 0 "SwtHozlSts1_Idle" 1 "SwtHozlSts1_Fwd" 2 "SwtHozlSts1_Backw";
VAL_ 464 BackRestSideSpprtAdjmtRowFirstPass 0 "SwtHozlSts1_Idle" 1 "SwtHozlSts1_Fwd" 2 "SwtHozlSts1_Backw";
VAL_ 464 CushSideSpprtAdjmtRowFirstDrvr 0 "SwtVertSts1_Idle" 1 "SwtVertSts1_Up" 2 "SwtVertSts1_Dwn";
VAL_ 464 CushSideSpprtAdjmtRowFirstPass 0 "SwtVertSts1_Idle" 1 "SwtVertSts1_Up" 2 "SwtVertSts1_Dwn";
VAL_ 464 DiagcComActv 0 "YesNo2_No" 1 "YesNo2_Yes";
VAL_ 464 DiagcExtCom 0 "YesNo2_No" 1 "YesNo2_Yes";
VAL_ 464 DrvrSeatDispMassgFctMassgInten 0 "MassgIntenLvl_IntenLo" 1 "MassgIntenLvl_IntenNorm" 2 "MassgIntenLvl_IntenHi" 3 "MassgIntenLvl_Off";
VAL_ 464 DrvrSeatDispMassgFctMassgProg 0 "MassgProgTyp_Prog1" 1 "MassgProgTyp_Prog2" 2 "MassgProgTyp_Prog3" 3 "MassgProgTyp_Prog4" 4 "MassgProgTyp_Prog5" 5 "MassgProgTyp_Prog6" 6 "MassgProgTyp_Prog7" 7 "MassgProgTyp_Prog8";
VAL_ 464 DrvrSeatDispMassgFctOnOffl2 0 "OnOffl2_Off" 1 "OnOffl2_On" 2 "OnOffl2_Idle";
VAL_ 464 DrvrSeatDispSpplFct 0 "SeatActvSpplFct1_NotAvl" 1 "SeatActvSpplFct1_LumExtnAndLumHei" 2 "SeatActvSpplFct1_BackBlster" 3 "SeatActvSpplFct1_CushExtn" 4 "SeatActvSpplFct1_HdrestHeiAndHdrestTilt" 5 "SeatActvSpplFct1_MassgFct" 6 "SeatActvSpplFct1_ShoulderFct" 7 "SeatActvSpplFct1_LegrestFct";
VAL_ 464 HMIIonizerAirCdnr 0 "OnOff1_Off" 1 "OnOff1_On";
VAL_ 464 LumHeiAdjmtRowFirstDrvr 0 "SwtVertSts1_Idle" 1 "SwtVertSts1_Up" 2 "SwtVertSts1_Dwn";
VAL_ 464 LumHeiAdjmtRowFirstPass 0 "SwtVertSts1_Idle" 1 "SwtVertSts1_Up" 2 "SwtVertSts1_Dwn";
VAL_ 464 LumLenAdjmtRowFirstDrvr 0 "SwtHozlSts1_Idle" 1 "SwtHozlSts1_Fwd" 2 "SwtHozlSts1_Backw";
VAL_ 464 LumLenAdjmtRowFirstPass 0 "SwtHozlSts1_Idle" 1 "SwtHozlSts1_Fwd" 2 "SwtHozlSts1_Backw";
VAL_ 464 PassSeatDispMassgFctMassgInten 0 "MassgIntenLvl_IntenLo" 1 "MassgIntenLvl_IntenNorm" 2 "MassgIntenLvl_IntenHi" 3 "MassgIntenLvl_Off";
VAL_ 464 PassSeatDispMassgFctMassgProg 0 "MassgProgTyp_Prog1" 1 "MassgProgTyp_Prog2" 2 "MassgProgTyp_Prog3" 3 "MassgProgTyp_Prog4" 4 "MassgProgTyp_Prog5" 5 "MassgProgTyp_Prog6" 6 "MassgProgTyp_Prog7" 7 "MassgProgTyp_Prog8";
VAL_ 464 PassSeatDispMassgFctOnOffl2 0 "OnOffl2_Off" 1 "OnOffl2_On" 2 "OnOffl2_Idle";
VAL_ 464 PassSeatDispSpplFct 0 "SeatActvSpplFct1_NotAvl" 1 "SeatActvSpplFct1_LumExtnAndLumHei" 2 "SeatActvSpplFct1_BackBlster" 3 "SeatActvSpplFct1_CushExtn" 4 "SeatActvSpplFct1_HdrestHeiAndHdrestTilt" 5 "SeatActvSpplFct1_MassgFct" 6 "SeatActvSpplFct1_ShoulderFct" 7 "SeatActvSpplFct1_LegrestFct";
VAL_ 464 SteerWhlHeatngAutStrtReq 0 "OnOff1_Off" 1 "OnOff1_On";
VAL_ 464 SunCurtCtrlReq 0 "OnOffNoReq_NoReq" 1 "OnOffNoReq_On" 2 "OnOffNoReq_Off";
VAL_ 464 SunRoofCtrlReq 0 "OnOffNoReq_NoReq" 1 "OnOffNoReq_On" 2 "OnOffNoReq_Off";
VAL_ 464 TelmBookChrgnTyp 0 "TelmBookChrgnTyp_Idle" 1 "TelmBookChrgnTyp_Off" 2 "TelmBookChrgnTyp_SingleBooking" 3 "TelmBookChrgnTyp_CyclicBooking" 4 "TelmBookChrgnTyp_PlugInBooking";
VAL_ 464 WirelschrgActvReqFromHmi 0 "OnOff1_Off" 1 "OnOff1_On";
VAL_ 311 ExtrMirrAdjHmiReq 0 "MirrDirReqTyp_Idle" 1 "MirrDirReqTyp_Up" 2 "MirrDirReqTyp_Down" 3 "MirrDirReqTyp_Left" 4 "MirrDirReqTyp_Right";
VAL_ 311 ExtrMirrFoldHmiReq 0 "PsdNotPsd1_NotPsd" 1 "PsdNotPsd1_Psd";
VAL_ 311 ExtrMirrSelnHmiReq 0 "idle" 1 "left" 2 "right";
VAL_ 311 HmiAC 0 "HmiCmptmtCoolgReq_Off" 1 "HmiCmptmtCoolgReq_Auto";
VAL_ 311 HmiElecFrntDefrstReq 0 "OnOffNoReq_NoReq" 1 "OnOffNoReq_On" 2 "OnOffNoReq_Off";
VAL_ 311 HmiElecReMirrDefrstReq 0 "OnOffNoReq_NoReq" 1 "OnOffNoReq_On" 2 "OnOffNoReq_Off";
VAL_ 311 HmiElecReWinDefrstReq 0 "OnOffNoReq_NoReq" 1 "OnOffNoReq_On" 2 "OnOffNoReq_Off";
VAL_ 311 IdleChrgCtrl 0 "PsdNotPsd_NotPsd" 1 "PsdNotPsd_Psd";
VAL_ 311 PwrCnsAvgIndcdPwrCnsUnit 0 "PwrCnsUnit_KWhPer100Km" 1 "PwrCnsUnit_KWhPer100Mile";
VAL_ 311 RstTrip1 0 "RstTrip1_Idle" 1 "RstTrip1_ManualResetAll" 2 "RstTrip1_MaximumResetAll" 3 "RstTrip1_RstTripCompterDataRstAEC" 4 "RstTrip1_RstTripCompterDataRstAFC" 5 "RstTrip1_RstTripCompterDataRstAVS" 6 "RstTrip1_RstTripCompterDataRstEDT" 7 "RstTrip1_RstTripCompterDataRstALL" 8 "RstTrip1_RstTripCompterDataManRst" 9 "RstTrip1_RstTripCompterDataRstTrip" 10 "RstTrip1_Reserve1" 11 "RstTrip1_Reserve2" 12 "RstTrip1_Reserve3" 13 "RstTrip1_Reserve4" 14 "RstTrip1_Reserve5" 15 "RstTrip1_Reserve6";
VAL_ 311 RstTrip2 0 "RstTrip2_Idle" 1 "RstTrip2_NewTripRestting" 2 "RstTrip2_FuelfillORchargReset" 3 "RstTrip2_ManualReset" 4 "RstTrip2_MaximumReset" 5 "RstTrip2_Reserve1" 6 "RstTrip2_Reserve2" 7 "RstTrip2_Reserve3";
VAL_ 311 SaveSetgToMemPrmnt 0 "OffOnAut1_Off" 1 "OffOnAut1_On" 2 "OffOnAut1_Aut";
VAL_ 311 SunRoofAndCurtIninSwt 0 "PsdNotPsd1_NotPsd" 1 "PsdNotPsd1_Psd";
VAL_ 311 TrunkOpenHmiReq 0 "DoorOpenerIdle" 1 "DoorOpenerOpen" 2 "DoorOpenerCls" 3 "DoorOpenerStop";
VAL_ 311 WinOpenDrvrReq 0 "WinAndRoofAndCurtPosnTyp_PosnUkwn" 1 "WinAndRoofAndCurtPosnTyp_ClsFull" 2 "WinAndRoofAndCurtPosnTyp_PercOpen4" 3 "WinAndRoofAndCurtPosnTyp_PercOpen8" 4 "WinAndRoofAndCurtPosnTyp_PercOpen12" 5 "WinAndRoofAndCurtPosnTyp_PercOpen16" 6 "WinAndRoofAndCurtPosnTyp_PercOpen20" 7 "WinAndRoofAndCurtPosnTyp_PercOpen24" 8 "WinAndRoofAndCurtPosnTyp_PercOpen28" 9 "WinAndRoofAndCurtPosnTyp_PercOpen32" 10 "WinAndRoofAndCurtPosnTyp_PercOpen36" 11 "WinAndRoofAndCurtPosnTyp_PercOpen40" 12 "WinAndRoofAndCurtPosnTyp_PercOpen44" 13 "WinAndRoofAndCurtPosnTyp_PercOpen48" 14 "WinAndRoofAndCurtPosnTyp_PercOpen52" 15 "WinAndRoofAndCurtPosnTyp_PercOpen56" 16 "WinAndRoofAndCurtPosnTyp_PercOpen60" 17 "WinAndRoofAndCurtPosnTyp_PercOpen64" 18 "WinAndRoofAndCurtPosnTyp_PercOpen68" 19 "WinAndRoofAndCurtPosnTyp_PercOpen72" 20 "WinAndRoofAndCurtPosnTyp_PercOpen76" 21 "WinAndRoofAndCurtPosnTyp_PercOpen80" 22 "WinAndRoofAndCurtPosnTyp_PercOpen84" 23 "WinAndRoofAndCurtPosnTyp_PercOpen88" 24 "WinAndRoofAndCurtPosnTyp_PercOpen92" 25 "WinAndRoofAndCurtPosnTyp_PercOpen96" 26 "WinAndRoofAndCurtPosnTyp_OpenFull" 27 "WinAndRoofAndCurtPosnTyp_Resd1" 28 "WinAndRoofAndCurtPosnTyp_Resd2" 29 "WinAndRoofAndCurtPosnTyp_Resd3" 30 "WinAndRoofAndCurtPosnTyp_Resd4" 31 "WinAndRoofAndCurtPosnTyp_Movg";
VAL_ 311 WinOpenPassReq 0 "WinAndRoofAndCurtPosnTyp_PosnUkwn" 1 "WinAndRoofAndCurtPosnTyp_ClsFull" 2 "WinAndRoofAndCurtPosnTyp_PercOpen4" 3 "WinAndRoofAndCurtPosnTyp_PercOpen8" 4 "WinAndRoofAndCurtPosnTyp_PercOpen12" 5 "WinAndRoofAndCurtPosnTyp_PercOpen16" 6 "WinAndRoofAndCurtPosnTyp_PercOpen20" 7 "WinAndRoofAndCurtPosnTyp_PercOpen24" 8 "WinAndRoofAndCurtPosnTyp_PercOpen28" 9 "WinAndRoofAndCurtPosnTyp_PercOpen32" 10 "WinAndRoofAndCurtPosnTyp_PercOpen36" 11 "WinAndRoofAndCurtPosnTyp_PercOpen40" 12 "WinAndRoofAndCurtPosnTyp_PercOpen44" 13 "WinAndRoofAndCurtPosnTyp_PercOpen48" 14 "WinAndRoofAndCurtPosnTyp_PercOpen52" 15 "WinAndRoofAndCurtPosnTyp_PercOpen56" 16 "WinAndRoofAndCurtPosnTyp_PercOpen60" 17 "WinAndRoofAndCurtPosnTyp_PercOpen64" 18 "WinAndRoofAndCurtPosnTyp_PercOpen68" 19 "WinAndRoofAndCurtPosnTyp_PercOpen72" 20 "WinAndRoofAndCurtPosnTyp_PercOpen76" 21 "WinAndRoofAndCurtPosnTyp_PercOpen80" 22 "WinAndRoofAndCurtPosnTyp_PercOpen84" 23 "WinAndRoofAndCurtPosnTyp_PercOpen88" 24 "WinAndRoofAndCurtPosnTyp_PercOpen92" 25 "WinAndRoofAndCurtPosnTyp_PercOpen96" 26 "WinAndRoofAndCurtPosnTyp_OpenFull" 27 "WinAndRoofAndCurtPosnTyp_Resd1" 28 "WinAndRoofAndCurtPosnTyp_Resd2" 29 "WinAndRoofAndCurtPosnTyp_Resd3" 30 "WinAndRoofAndCurtPosnTyp_Resd4" 31 "WinAndRoofAndCurtPosnTyp_Movg";
VAL_ 311 WinOpenReLeReq 0 "WinAndRoofAndCurtPosnTyp_PosnUkwn" 1 "WinAndRoofAndCurtPosnTyp_ClsFull" 2 "WinAndRoofAndCurtPosnTyp_PercOpen4" 3 "WinAndRoofAndCurtPosnTyp_PercOpen8" 4 "WinAndRoofAndCurtPosnTyp_PercOpen12" 5 "WinAndRoofAndCurtPosnTyp_PercOpen16" 6 "WinAndRoofAndCurtPosnTyp_PercOpen20" 7 "WinAndRoofAndCurtPosnTyp_PercOpen24" 8 "WinAndRoofAndCurtPosnTyp_PercOpen28" 9 "WinAndRoofAndCurtPosnTyp_PercOpen32" 10 "WinAndRoofAndCurtPosnTyp_PercOpen36" 11 "WinAndRoofAndCurtPosnTyp_PercOpen40" 12 "WinAndRoofAndCurtPosnTyp_PercOpen44" 13 "WinAndRoofAndCurtPosnTyp_PercOpen48" 14 "WinAndRoofAndCurtPosnTyp_PercOpen52" 15 "WinAndRoofAndCurtPosnTyp_PercOpen56" 16 "WinAndRoofAndCurtPosnTyp_PercOpen60" 17 "WinAndRoofAndCurtPosnTyp_PercOpen64" 18 "WinAndRoofAndCurtPosnTyp_PercOpen68" 19 "WinAndRoofAndCurtPosnTyp_PercOpen72" 20 "WinAndRoofAndCurtPosnTyp_PercOpen76" 21 "WinAndRoofAndCurtPosnTyp_PercOpen80" 22 "WinAndRoofAndCurtPosnTyp_PercOpen84" 23 "WinAndRoofAndCurtPosnTyp_PercOpen88" 24 "WinAndRoofAndCurtPosnTyp_PercOpen92" 25 "WinAndRoofAndCurtPosnTyp_PercOpen96" 26 "WinAndRoofAndCurtPosnTyp_OpenFull" 27 "WinAndRoofAndCurtPosnTyp_Resd1" 28 "WinAndRoofAndCurtPosnTyp_Resd2" 29 "WinAndRoofAndCurtPosnTyp_Resd3" 30 "WinAndRoofAndCurtPosnTyp_Resd4" 31 "WinAndRoofAndCurtPosnTyp_Movg";
VAL_ 311 WinOpenReRiReq 0 "WinAndRoofAndCurtPosnTyp_PosnUkwn" 1 "WinAndRoofAndCurtPosnTyp_ClsFull" 2 "WinAndRoofAndCurtPosnTyp_PercOpen4" 3 "WinAndRoofAndCurtPosnTyp_PercOpen8" 4 "WinAndRoofAndCurtPosnTyp_PercOpen12" 5 "WinAndRoofAndCurtPosnTyp_PercOpen16" 6 "WinAndRoofAndCurtPosnTyp_PercOpen20" 7 "WinAndRoofAndCurtPosnTyp_PercOpen24" 8 "WinAndRoofAndCurtPosnTyp_PercOpen28" 9 "WinAndRoofAndCurtPosnTyp_PercOpen32" 10 "WinAndRoofAndCurtPosnTyp_PercOpen36" 11 "WinAndRoofAndCurtPosnTyp_PercOpen40" 12 "WinAndRoofAndCurtPosnTyp_PercOpen44" 13 "WinAndRoofAndCurtPosnTyp_PercOpen48" 14 "WinAndRoofAndCurtPosnTyp_PercOpen52" 15 "WinAndRoofAndCurtPosnTyp_PercOpen56" 16 "WinAndRoofAndCurtPosnTyp_PercOpen60" 17 "WinAndRoofAndCurtPosnTyp_PercOpen64" 18 "WinAndRoofAndCurtPosnTyp_PercOpen68" 19 "WinAndRoofAndCurtPosnTyp_PercOpen72" 20 "WinAndRoofAndCurtPosnTyp_PercOpen76" 21 "WinAndRoofAndCurtPosnTyp_PercOpen80" 22 "WinAndRoofAndCurtPosnTyp_PercOpen84" 23 "WinAndRoofAndCurtPosnTyp_PercOpen88" 24 "WinAndRoofAndCurtPosnTyp_PercOpen92" 25 "WinAndRoofAndCurtPosnTyp_PercOpen96" 26 "WinAndRoofAndCurtPosnTyp_OpenFull" 27 "WinAndRoofAndCurtPosnTyp_Resd1" 28 "WinAndRoofAndCurtPosnTyp_Resd2" 29 "WinAndRoofAndCurtPosnTyp_Resd3" 30 "WinAndRoofAndCurtPosnTyp_Resd4" 31 "WinAndRoofAndCurtPosnTyp_Movg";
VAL_ 311 Zone1SettingsZoneStatus 0 "OnOff1_Off" 1 "OnOff1_On";
VAL_ 311 Zone2SettingsZoneStatus 0 "OnOff1_Off" 1 "OnOff1_On";
VAL_ 311 Zone3SettingsZoneStatus 0 "OnOff1_Off" 1 "OnOff1_On";
VAL_ 66 DChaEngStsCtrl 0 "IdleEnaDis_Idle" 1 "IdleEnaDis_Ena" 2 "IdleEnaDis_Dis";
VAL_ 66 HVPwrDwnRstReq 0 "OnOff1_Off" 1 "OnOff1_On";
VAL_ 66 ReadLiOpenReqFrontLeft 0 "OnOffNoReq_NoReq" 1 "OnOffNoReq_On" 2 "OnOffNoReq_Off";
VAL_ 66 ReadLiOpenReqFrontRight 0 "OnOffNoReq_NoReq" 1 "OnOffNoReq_On" 2 "OnOffNoReq_Off";
VAL_ 66 ReadLiOpenReqSecondRowLeft 0 "OnOffNoReq_NoReq" 1 "OnOffNoReq_On" 2 "OnOffNoReq_Off";
VAL_ 66 ReadLiOpenReqSecondRowRight 0 "OnOffNoReq_NoReq" 1 "OnOffNoReq_On" 2 "OnOffNoReq_Off";
VAL_ 66 ReadLiOpenReqThirdRowLeft 0 "OnOffNoReq_NoReq" 1 "OnOffNoReq_On" 2 "OnOffNoReq_Off";
VAL_ 66 ReadLiOpenReqThirdRowRight 0 "OnOffNoReq_NoReq" 1 "OnOffNoReq_On" 2 "OnOffNoReq_Off";
VAL_ 66 TopPosTrFromHmi 0 "PosPerc1_NoReq" 1 "PosPerc1_0to20PercTopPos" 2 "PosPerc1_21to40PercTopPos" 3 "PosPerc1_41to60PercTopPos" 4 "PosPerc1_61to80PercTopPos" 5 "PosPerc1_81to100PercTopPos";
VAL_ 66 UsrSpeechSts 0 "OnOff1_Off" 1 "OnOff1_On";
VAL_ 66 WinOpenAppReqWinOpenClsGlbSts 0 "WinOpenClsGlbReqFromTelm_Idle" 1 "WinOpenClsGlbReqFromTelm_Open" 2 "WinOpenClsGlbReqFromTelm_Close";
VAL_ 272 BookTrvlClimaActvReq 0 "OnOffNoReq_NoReq" 1 "OnOffNoReq_On" 2 "OnOffNoReq_Off";
VAL_ 272 CarFindrHornLiReqFromTelm 0 "CarFindrHornLiReqFromTelm_NoReq" 1 "CarFindrHornLiReqFromTelm_HornReq" 2 "CarFindrHornLiReqFromTelm_LiReq" 3 "CarFindrHornLiReqFromTelm_HornLiReq";
VAL_ 272 CbnOverHeatProtnEnaFromTelm 0 "OnOff1_Off" 1 "OnOff1_On";
VAL_ 272 ChrgLidTelmLockgReq 0 "ReqSts1_NotReqd" 1 "ReqSts1_Reqd";
VAL_ 272 ClimaRqrd1 0 "OnOffNoReq_NoReq" 1 "OnOffNoReq_On" 2 "OnOffNoReq_Off";
VAL_ 272 ClimaTmrStsTelmRqrd 0 "OnOff1_Off" 1 "OnOff1_On";
VAL_ 272 EmgyAsscTrigSts 0 "AfsStsReq_Inactive" 1 "AfsStsReq_AutomaticallySet" 2 "AfsStsReq_ManuallySet" 3 "AfsStsReq_Fault";
VAL_ 272 EngForbidReqFromTelm 0 "ReqSts1_NotReqd" 1 "ReqSts1_Reqd";
VAL_ 272 EngPermitReqFromTelm 0 "ReqSts1_NotReqd" 1 "ReqSts1_Reqd";
VAL_ 272 ExtrLiShowActvnReq 0 "OnOff1_Off" 1 "OnOff1_On";
VAL_ 272 ExtrLiShowFileTxReq 0 "OnOff1_Off" 1 "OnOff1_On";
VAL_ 272 TelmThermoTankReq1 0 "Req_NoReq" 1 "Req_off" 2 "Req_Coolg" 3 "Req_Heatlg";
SIG_GROUP_ 66 ApproachReq 1 : ApproachReqData1 ApproachReqData10 ApproachReqData11 ApproachReqData12 ApproachReqData13 ApproachReqData14 ApproachReqData15 ApproachReqData16 ApproachReqData2 ApproachReqData3 ApproachReqData4 ApproachReqData5 ApproachReqData6 ApproachReqData7 ApproachReqData8 ApproachReqData9;
SIG_GROUP_ 74 BLEKeySearchResp 1 : BLEKeySearchRespData1 BLEKeySearchRespData10 BLEKeySearchRespData11 BLEKeySearchRespData12 BLEKeySearchRespData13 BLEKeySearchRespData14 BLEKeySearchRespData15 BLEKeySearchRespData16 BLEKeySearchRespData2 BLEKeySearchRespData3 BLEKeySearchRespData4 BLEKeySearchRespData5 BLEKeySearchRespData6 BLEKeySearchRespData7 BLEKeySearchRespData8 BLEKeySearchRespData9;
SIG_GROUP_ 80 DKDataFromTelm 1 : DKDataFromTelmAcknowledgment DKDataFromTelmDKDataByte1 DKDataFromTelmDKDataByte2 DKDataFromTelmDKDataByte3 DKDataFromTelmDKDataByte4 DKDataFromTelmDKDataByte5 DKDataFromTelmDKDataByte6 DKDataFromTelmHeader;
SIG_GROUP_ 560 DrvrHdPosnDetn 1 : DrvrHdPosnDetnX DrvrHdPosnDetnY DrvrHdPosnDetnZ;
SIG_GROUP_ 464 DrvrSeatDispMassgFct 1 : DrvrSeatDispMassgFctMassgInten DrvrSeatDispMassgFctMassgProg DrvrSeatDispMassgFctOnOffl2;
SIG_GROUP_ 99 DwnLoadDynLtgPrmForFrntRIGrp1 1 : DwnLoadDynLtgPrmForFrntRIGrp1ContinueTime DwnLoadDynLtgPrmForFrntRIGrp1HighBrightness DwnLoadDynLtgPrmForFrntRIGrp1LowBrightness DwnLoadDynLtgPrmForFrntRIGrp1Mode1 DwnLoadDynLtgPrmForFrntRIGrp1OffsetTime DwnLoadDynLtgPrmForFrntRIGrp1Timestamp;
SIG_GROUP_ 99 DwnLoadDynLtgPrmForFrntRIGrp10 1 : DwnLoadDynLtgPrmForFrntRIGrp10ContinueTime DwnLoadDynLtgPrmForFrntRIGrp10HighBrightness DwnLoadDynLtgPrmForFrntRIGrp10LowBrightness DwnLoadDynLtgPrmForFrntRIGrp10Mode1 DwnLoadDynLtgPrmForFrntRIGrp10OffsetTime DwnLoadDynLtgPrmForFrntRIGrp10Timestamp;
SIG_GROUP_ 99 DwnLoadDynLtgPrmForFrntRIGrp11 1 : DwnLoadDynLtgPrmForFrntRIGrp11ContinueTime DwnLoadDynLtgPrmForFrntRIGrp11HighBrightness DwnLoadDynLtgPrmForFrntRIGrp11LowBrightness DwnLoadDynLtgPrmForFrntRIGrp11Mode1 DwnLoadDynLtgPrmForFrntRIGrp11OffsetTime DwnLoadDynLtgPrmForFrntRIGrp11Timestamp;
SIG_GROUP_ 99 DwnLoadDynLtgPrmForFrntRIGrp12 1 : DwnLoadDynLtgPrmForFrntRIGrp12ContinueTime DwnLoadDynLtgPrmForFrntRIGrp12HighBrightness DwnLoadDynLtgPrmForFrntRIGrp12LowBrightness DwnLoadDynLtgPrmForFrntRIGrp12Mode1 DwnLoadDynLtgPrmForFrntRIGrp12OffsetTime DwnLoadDynLtgPrmForFrntRIGrp12Timestamp;
SIG_GROUP_ 103 DwnLoadDynLtgPrmForFrntRIGrp13 1 : DwnLoadDynLtgPrmForFrntRIGrp13ContinueTime DwnLoadDynLtgPrmForFrntRIGrp13HighBrightness DwnLoadDynLtgPrmForFrntRIGrp13LowBrightness DwnLoadDynLtgPrmForFrntRIGrp13Mode1 DwnLoadDynLtgPrmForFrntRIGrp13OffsetTime DwnLoadDynLtgPrmForFrntRIGrp13Timestamp;
SIG_GROUP_ 103 DwnLoadDynLtgPrmForFrntRIGrp14 1 : DwnLoadDynLtgPrmForFrntRIGrp14ContinueTime DwnLoadDynLtgPrmForFrntRIGrp14HighBrightness DwnLoadDynLtgPrmForFrntRIGrp14LowBrightness DwnLoadDynLtgPrmForFrntRIGrp14Mode1 DwnLoadDynLtgPrmForFrntRIGrp14OffsetTime DwnLoadDynLtgPrmForFrntRIGrp14Timestamp;
SIG_GROUP_ 103 DwnLoadDynLtgPrmForFrntRIGrp15 1 : DwnLoadDynLtgPrmForFrntRIGrp15ContinueTime DwnLoadDynLtgPrmForFrntRIGrp15HighBrightness DwnLoadDynLtgPrmForFrntRIGrp15LowBrightness DwnLoadDynLtgPrmForFrntRIGrp15Mode1 DwnLoadDynLtgPrmForFrntRIGrp15OffsetTime DwnLoadDynLtgPrmForFrntRIGrp15Timestamp;
SIG_GROUP_ 103 DwnLoadDynLtgPrmForFrntRIGrp16 1 : DwnLoadDynLtgPrmForFrntRIGrp16ContinueTime DwnLoadDynLtgPrmForFrntRIGrp16HighBrightness DwnLoadDynLtgPrmForFrntRIGrp16LowBrightness DwnLoadDynLtgPrmForFrntRIGrp16Mode1 DwnLoadDynLtgPrmForFrntRIGrp16OffsetTime DwnLoadDynLtgPrmForFrntRIGrp16Timestamp;
SIG_GROUP_ 103 DwnLoadDynLtgPrmForFrntRIGrp17 1 : DwnLoadDynLtgPrmForFrntRIGrp17ContinueTime DwnLoadDynLtgPrmForFrntRIGrp17HighBrightness DwnLoadDynLtgPrmForFrntRIGrp17LowBrightness DwnLoadDynLtgPrmForFrntRIGrp17Mode1 DwnLoadDynLtgPrmForFrntRIGrp17OffsetTime DwnLoadDynLtgPrmForFrntRIGrp17Timestamp;
SIG_GROUP_ 103 DwnLoadDynLtgPrmForFrntRIGrp18 1 : DwnLoadDynLtgPrmForFrntRIGrp18ContinueTime DwnLoadDynLtgPrmForFrntRIGrp18HighBrightness DwnLoadDynLtgPrmForFrntRIGrp18LowBrightness DwnLoadDynLtgPrmForFrntRIGrp18Mode1 DwnLoadDynLtgPrmForFrntRIGrp18OffsetTime DwnLoadDynLtgPrmForFrntRIGrp18Timestamp;
SIG_GROUP_ 103 DwnLoadDynLtgPrmForFrntRIGrp19 1 : DwnLoadDynLtgPrmForFrntRIGrp19ContinueTime DwnLoadDynLtgPrmForFrntRIGrp19HighBrightness DwnLoadDynLtgPrmForFrntRIGrp19LowBrightness DwnLoadDynLtgPrmForFrntRIGrp19Mode1 DwnLoadDynLtgPrmForFrntRIGrp19OffsetTime DwnLoadDynLtgPrmForFrntRIGrp19Timestamp;
SIG_GROUP_ 99 DwnLoadDynLtgPrmForFrntRIGrp2 1 : DwnLoadDynLtgPrmForFrntRIGrp2ContinueTime DwnLoadDynLtgPrmForFrntRIGrp2HighBrightness DwnLoadDynLtgPrmForFrntRIGrp2LowBrightness DwnLoadDynLtgPrmForFrntRIGrp2Mode1 DwnLoadDynLtgPrmForFrntRIGrp2OffsetTime DwnLoadDynLtgPrmForFrntRIGrp2Timestamp;
SIG_GROUP_ 103 DwnLoadDynLtgPrmForFrntRIGrp20 1 : DwnLoadDynLtgPrmForFrntRIGrp20ContinueTime DwnLoadDynLtgPrmForFrntRIGrp20HighBrightness DwnLoadDynLtgPrmForFrntRIGrp20LowBrightness DwnLoadDynLtgPrmForFrntRIGrp20Mode1 DwnLoadDynLtgPrmForFrntRIGrp20OffsetTime DwnLoadDynLtgPrmForFrntRIGrp20Timestamp;
SIG_GROUP_ 103 DwnLoadDynLtgPrmForFrntRIGrp21 1 : DwnLoadDynLtgPrmForFrntRIGrp21ContinueTime DwnLoadDynLtgPrmForFrntRIGrp21HighBrightness DwnLoadDynLtgPrmForFrntRIGrp21LowBrightness DwnLoadDynLtgPrmForFrntRIGrp21Mode1 DwnLoadDynLtgPrmForFrntRIGrp21OffsetTime DwnLoadDynLtgPrmForFrntRIGrp21Timestamp;
SIG_GROUP_ 103 DwnLoadDynLtgPrmForFrntRIGrp22 1 : DwnLoadDynLtgPrmForFrntRIGrp22ContinueTime DwnLoadDynLtgPrmForFrntRIGrp22HighBrightness DwnLoadDynLtgPrmForFrntRIGrp22LowBrightness DwnLoadDynLtgPrmForFrntRIGrp22Mode1 DwnLoadDynLtgPrmForFrntRIGrp22OffsetTime DwnLoadDynLtgPrmForFrntRIGrp22Timestamp;
SIG_GROUP_ 103 DwnLoadDynLtgPrmForFrntRIGrp23 1 : DwnLoadDynLtgPrmForFrntRIGrp23ContinueTime DwnLoadDynLtgPrmForFrntRIGrp23HighBrightness DwnLoadDynLtgPrmForFrntRIGrp23LowBrightness DwnLoadDynLtgPrmForFrntRIGrp23Mode1 DwnLoadDynLtgPrmForFrntRIGrp23OffsetTime DwnLoadDynLtgPrmForFrntRIGrp23Timestamp;
SIG_GROUP_ 103 DwnLoadDynLtgPrmForFrntRIGrp24 1 : DwnLoadDynLtgPrmForFrntRIGrp24ContinueTime DwnLoadDynLtgPrmForFrntRIGrp24HighBrightness DwnLoadDynLtgPrmForFrntRIGrp24LowBrightness DwnLoadDynLtgPrmForFrntRIGrp24Mode1 DwnLoadDynLtgPrmForFrntRIGrp24OffsetTime DwnLoadDynLtgPrmForFrntRIGrp24Timestamp;
SIG_GROUP_ 99 DwnLoadDynLtgPrmForFrntRIGrp3 1 : DwnLoadDynLtgPrmForFrntRIGrp3ContinueTime DwnLoadDynLtgPrmForFrntRIGrp3HighBrightness DwnLoadDynLtgPrmForFrntRIGrp3LowBrightness DwnLoadDynLtgPrmForFrntRIGrp3Mode1 DwnLoadDynLtgPrmForFrntRIGrp3OffsetTime DwnLoadDynLtgPrmForFrntRIGrp3Timestamp;
SIG_GROUP_ 99 DwnLoadDynLtgPrmForFrntRIGrp4 1 : DwnLoadDynLtgPrmForFrntRIGrp4ContinueTime DwnLoadDynLtgPrmForFrntRIGrp4HighBrightness DwnLoadDynLtgPrmForFrntRIGrp4LowBrightness DwnLoadDynLtgPrmForFrntRIGrp4Mode1 DwnLoadDynLtgPrmForFrntRIGrp4OffsetTime DwnLoadDynLtgPrmForFrntRIGrp4Timestamp;
SIG_GROUP_ 99 DwnLoadDynLtgPrmForFrntRIGrp5 1 : DwnLoadDynLtgPrmForFrntRIGrp5ContinueTime DwnLoadDynLtgPrmForFrntRIGrp5HighBrightness DwnLoadDynLtgPrmForFrntRIGrp5LowBrightness DwnLoadDynLtgPrmForFrntRIGrp5Mode1 DwnLoadDynLtgPrmForFrntRIGrp5OffsetTime DwnLoadDynLtgPrmForFrntRIGrp5Timestamp;
SIG_GROUP_ 99 DwnLoadDynLtgPrmForFrntRIGrp6 1 : DwnLoadDynLtgPrmForFrntRIGrp6ContinueTime DwnLoadDynLtgPrmForFrntRIGrp6HighBrightness DwnLoadDynLtgPrmForFrntRIGrp6LowBrightness DwnLoadDynLtgPrmForFrntRIGrp6Mode1 DwnLoadDynLtgPrmForFrntRIGrp6OffsetTime DwnLoadDynLtgPrmForFrntRIGrp6Timestamp;
SIG_GROUP_ 99 DwnLoadDynLtgPrmForFrntRIGrp7 1 : DwnLoadDynLtgPrmForFrntRIGrp7ContinueTime DwnLoadDynLtgPrmForFrntRIGrp7HighBrightness DwnLoadDynLtgPrmForFrntRIGrp7LowBrightness DwnLoadDynLtgPrmForFrntRIGrp7Mode1 DwnLoadDynLtgPrmForFrntRIGrp7OffsetTime DwnLoadDynLtgPrmForFrntRIGrp7Timestamp;
SIG_GROUP_ 99 DwnLoadDynLtgPrmForFrntRIGrp8 1 : DwnLoadDynLtgPrmForFrntRIGrp8ContinueTime DwnLoadDynLtgPrmForFrntRIGrp8HighBrightness DwnLoadDynLtgPrmForFrntRIGrp8LowBrightness DwnLoadDynLtgPrmForFrntRIGrp8Mode1 DwnLoadDynLtgPrmForFrntRIGrp8OffsetTime DwnLoadDynLtgPrmForFrntRIGrp8Timestamp;
SIG_GROUP_ 99 DwnLoadDynLtgPrmForFrntRIGrp9 1 : DwnLoadDynLtgPrmForFrntRIGrp9ContinueTime DwnLoadDynLtgPrmForFrntRIGrp9HighBrightness DwnLoadDynLtgPrmForFrntRIGrp9LowBrightness DwnLoadDynLtgPrmForFrntRIGrp9Mode1 DwnLoadDynLtgPrmForFrntRIGrp9OffsetTime DwnLoadDynLtgPrmForFrntRIGrp9Timestamp;
SIG_GROUP_ 80 ErsCmdRec 1 : ErsCmdRecErsCmd ErsCmdRecErsRunTime;
SIG_GROUP_ 259 FuLvlRawActvSide 1 : FuLvlRawActvSideFuLvlValFromFuTbl FuLvlRawActvSideGenQF;
SIG_GROUP_ 259 FuLvlRawPasSide 1 : FuLvlRawPasSideFuLvlValFromFuTbl FuLvlRawPasSideGenQF;
SIG_GROUP_ 435 HznPosnLR 1 : HznPosnLRCurrentLane HznPosnLRCyclicCounter HznPosnLRMessageType HznPosnLROffset HznPosnLRPathIndex HznPosnLRPositionAge HznPosnLRPositionConfidence HznPosnLRPositionIndex HznPosnLRPositionProbability HznPosnLRRelativeHeading HznPosnLRSpeed;
SIG_GROUP_ 435 HznProfLongLR 1 : HznProfLongLRControlPoint HznProfLongLRCyclicCounter HznProfLongLRMessageType HznProfLongLROffset HznProfLongLRPathIndex HznProfLongLRProfileType HznProfLongLRRetransmission HznProfLongLRUpdate HznProfLongLRValue;
SIG_GROUP_ 1168 LongTiRunngMod 1 : LongTiRunngModCampMod LongTiRunngModGameMod LongTiRunngModMonrbyOMS LongTiRunngModPanelTouched LongTiRunngModParkComfortMod LongTiRunngModPetMod LongTiRunngModReserved1 LongTiRunngModReserved2 LongTiRunngModReserved3 LongTiRunngModReserved4 LongTiRunngModReserved5 LongTiRunngModReserved6 LongTiRunngModReserved7 LongTiRunngModReserved8 LongTiRunngModRestMod LongTiRunngModTheaterMod;
SIG_GROUP_ 368 LvlgSwtSetReq 1 : LvlgSwtSetReqChks LvlgSwtSetReqCntr LvlgSwtSetReqLvlgSwtSetReq;
SIG_GROUP_ 259 MirrTarPosnCmdReq 1 : MirrTarPosnCmdReqDrvrMirrAdjLeRi MirrTarPosnCmdReqDrvrMirrAdjUpDwn MirrTarPosnCmdReqPassMirrAdjLeRi MirrTarPosnCmdReqPassMirrAdjUpDwn MirrTarPosnCmdReqTarPosnCmd1;
SIG_GROUP_ 74 NFCAndBLEKeyEnaSts 1 : NFCAndBLEKeyEnaStsData1 NFCAndBLEKeyEnaStsData10 NFCAndBLEKeyEnaStsData11 NFCAndBLEKeyEnaStsData12 NFCAndBLEKeyEnaStsData13 NFCAndBLEKeyEnaStsData14 NFCAndBLEKeyEnaStsData15 NFCAndBLEKeyEnaStsData16 NFCAndBLEKeyEnaStsData2 NFCAndBLEKeyEnaStsData3 NFCAndBLEKeyEnaStsData4 NFCAndBLEKeyEnaStsData5 NFCAndBLEKeyEnaStsData6 NFCAndBLEKeyEnaStsData7 NFCAndBLEKeyEnaStsData8 NFCAndBLEKeyEnaStsData9;
SIG_GROUP_ 74 NFCKeySearchResp 1 : NFCKeySearchRespData1 NFCKeySearchRespData10 NFCKeySearchRespData11 NFCKeySearchRespData12 NFCKeySearchRespData13 NFCKeySearchRespData14 NFCKeySearchRespData15 NFCKeySearchRespData16 NFCKeySearchRespData2 NFCKeySearchRespData3 NFCKeySearchRespData4 NFCKeySearchRespData5 NFCKeySearchRespData6 NFCKeySearchRespData7 NFCKeySearchRespData8 NFCKeySearchRespData9;
SIG_GROUP_ 464 PassSeatDispMassgFct 1 : PassSeatDispMassgFctMassgInten PassSeatDispMassgFctMassgProg PassSeatDispMassgFctOnOffl2;
SIG_GROUP_ 560 PassSideHdPosnDetn 1 : PassSideHdPosnDetnX PassSideHdPosnDetnY PassSideHdPosnDetnZ;
SIG_GROUP_ 1168 PosnBrief 1 : PosnBriefPosnLat PosnBriefPosnLgt;
SIG_GROUP_ 311 PwrCnsAvgIndcd 1 : PwrCnsAvgIndcdEcoDrvInfo1 PwrCnsAvgIndcdPwrCnsUnit;
SIG_GROUP_ 66 ReadLiOpenReq 1 : ReadLiOpenReqFrontLeft ReadLiOpenReqFrontRight ReadLiOpenReqSecondRowLeft ReadLiOpenReqSecondRowRight ReadLiOpenReqThirdRowLeft ReadLiOpenReqThirdRowRight;
SIG_GROUP_ 66 RKEAndNFCReqSts 1 : RKEAndNFCReqStsData1 RKEAndNFCReqStsData10 RKEAndNFCReqStsData11 RKEAndNFCReqStsData12 RKEAndNFCReqStsData13 RKEAndNFCReqStsData14 RKEAndNFCReqStsData15 RKEAndNFCReqStsData16 RKEAndNFCReqStsData2 RKEAndNFCReqStsData3 RKEAndNFCReqStsData4 RKEAndNFCReqStsData5 RKEAndNFCReqStsData6 RKEAndNFCReqStsData7 RKEAndNFCReqStsData8 RKEAndNFCReqStsData9;
SIG_GROUP_ 368 SecLeSeatTarPosnCmdReq 1 : SecLeSeatTarPosnCmdReqSeatBackrTargPosAg SecLeSeatTarPosnCmdReqSeatFrntExtenTargPosPerc SecLeSeatTarPosnCmdReqSeatFrntHeiTargPosPerc SecLeSeatTarPosnCmdReqSeatLenTargPosPerc SecLeSeatTarPosnCmdReqTarPosnCmd1;
SIG_GROUP_ 368 SecRiSeatTarPosnCmdReq 1 : SecRiSeatTarPosnCmdReqSeatBackrTargPosAg SecRiSeatTarPosnCmdReqSeatFrntExtenTargPosPerc SecRiSeatTarPosnCmdReqSeatFrntHeiTargPosPerc SecRiSeatTarPosnCmdReqSeatLenTargPosPerc SecRiSeatTarPosnCmdReqTarPosnCmd1;
SIG_GROUP_ 560 SteerSetg 1 : SteerSetgPen SteerSetgSteerAsscLvl SteerSetgSteerMod;
SIG_GROUP_ 103 TelmBookClimaReq 1 : TelmBookClimaReqHmiCmptmtTSpSpcl TelmBookClimaReqOnOffNoReq TelmBookClimaReqTempRange;
SIG_GROUP_ 99 TelmBookSeatHeatClimalReq 1 : TelmBookSeatHeatClimalReqDrvHeatClimaLvl TelmBookSeatHeatClimalReqPassHeatClimaLvl TelmBookSeatHeatClimalReqSecLeHeatClimaLvl TelmBookSeatHeatClimalReqSecRiHeatClimaLvl TelmBookSeatHeatClimalReqThrdLeHeatClimaLvl TelmBookSeatHeatClimalReqThrdRiHeatClimaLvl;
SIG_GROUP_ 99 TelmBookSeatVentnClimalReq 1 : TelmBookSeatVentnClimalReqDrvVentnClimaLvl TelmBookSeatVentnClimalReqPassVentnClimaLvl TelmBookSeatVentnClimalReqSecLeVentnClimaLvl TelmBookSeatVentnClimalReqSecRiVentnClimaLvl TelmBookSeatVentnClimalReqThrdLeVentnClimaLvl TelmBookSeatVentnClimalReqThrdRiVentnClimaL;
SIG_GROUP_ 99 TelmClimaTSet 1 : TelmClimaTSetHmiCmptmtTSpSpcl TelmClimaTSetTempRange;
SIG_GROUP_ 66 WinOpenAppReq 1 : WinOpenAppReqWindowOpenValue WinOpenAppReqWinOpenClsGlbSts;
SIG_GROUP_ 103 WinOpenClsGlbReqFromTelm 1 : WinOpenClsGlbReqFromTelmWindowOpenValue WinOpenClsGlbReqFromTelmWinOpenClsGlbSts;
SIG_GROUP_ 311 Zone1Settings 1 : Zone1SettingsBlue Zone1SettingsGreen Zone1SettingsIntensity Zone1SettingsRed Zone1SettingsZoneStatus;
SIG_GROUP_ 311 Zone2Settings 1 : Zone2SettingsBlue Zone2SettingsGreen Zone2SettingsIntensity Zone2SettingsRed Zone2SettingsZoneStatus;
SIG_GROUP_ 311 Zone3Settings 1 : Zone3SettingsBlue Zone3SettingsGreen Zone3SettingsIntensity Zone3SettingsRed Zone3SettingsZoneStatus;
